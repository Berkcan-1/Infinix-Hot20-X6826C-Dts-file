/dts-v1/;

/ {

	fragment@0 {
		target = <0xffffffff>;

		__overlay__ {

			reserve-memory-scp_share {
				compatible = "mediatek,reserve-memory-scp_share";
				no-map;
				size = <0x00 0xd00000>;
				alignment = <0x00 0x1000000>;
				alloc-ranges = <0x00 0x40000000 0x00 0x50000000>;
			};
		};
	};

	fragment@1 {
		target = <0xffffffff>;

		__overlay__ {
			atag,videolfb-fb_base_l = "~`P";
			atag,videolfb-fb_base_h = <0x00>;
			atag,videolfb-islcmfound = <0x01>;
			atag,videolfb-islcm_inited = <0x00>;
			atag,videolfb-fps = <0x1770>;
			atag,videolfb-vramSize = <0x17e8000>;
			atag,videolfb-lcmname = "hx83112b_fhdp_dsi_cmd_auo_rt5081_drv";
		};
	};

	fragment@2 {
		target = <0xffffffff>;

		__overlay__ {
			pmic = <0xffffffff>;
			cam0_enable_sensor = "s5kjn1_mipi_raw s5kjn1ext2_mipi_raw";
			cam1_enable_sensor = "s5k4h7sub_mipi_raw gc08a3_mipi_raw";
			cam2_enable_sensor = "fake_serial_yuv";
			camera_input_gpio = <0xffffffff 0x15 0x00>;
		};
	};

	fragment@3 {
		target = <0xffffffff>;

		__overlay__ {

			camera_af_hw_node {
				compatible = "mediatek,camera_af_lens";
				camaf_m1_pmic-supply = <0xffffffff>;
				phandle = <0x43>;
			};

			flashlights_aw36515 {
				compatible = "mediatek,flashlights_aw36515";
				pinctrl-names = "aw36515default\0aw36515hwen_high\0aw36515hwen_low";
				pinctrl-0 = <0x01>;
				pinctrl-1 = <0x02>;
				pinctrl-2 = <0x03>;
				status = "okay";
				phandle = <0x44>;
			};

			flashlights_ocp81375 {
				compatible = "mediatek,flashlights_ocp81375";
				pinctrl-names = "ocp81375default\0ocp81375hwen_high\0ocp81375hwen_low";
				pinctrl-0 = <0x04>;
				pinctrl-1 = <0x05>;
				pinctrl-2 = <0x06>;
				status = "okay";
				phandle = <0x45>;
			};

			led@0 {
				compatible = "mediatek,red";
				led_mode = <0x00>;
				data = <0x01>;
				pwm_config = <0x00 0x00 0x00 0x00 0x00>;
				phandle = <0x46>;
			};

			led@1 {
				compatible = "mediatek,green";
				led_mode = <0x00>;
				data = <0x01>;
				pwm_config = <0x00 0x00 0x00 0x00 0x00>;
				phandle = <0x47>;
			};

			led@2 {
				compatible = "mediatek,blue";
				led_mode = <0x03>;
				data = <0x02>;
				pwm_config = <0x00 0x00 0x00 0x00 0x00>;
				phandle = <0x48>;
			};

			led@3 {
				compatible = "mediatek,jogball-backlight";
				led_mode = <0x00>;
				data = <0x01>;
				pwm_config = <0x00 0x00 0x00 0x00 0x00>;
				phandle = <0x49>;
			};

			led@4 {
				compatible = "mediatek,keyboard-backlight";
				led_mode = <0x00>;
				data = <0x01>;
				pwm_config = <0x00 0x00 0x00 0x00 0x00>;
				phandle = <0x4a>;
			};

			led@5 {
				compatible = "mediatek,button-backlight";
				led_mode = <0x00>;
				data = <0x01>;
				pwm_config = <0x00 0x00 0x00 0x00 0x00>;
				phandle = <0x4b>;
			};

			led@6 {
				compatible = "mediatek,lcd-backlight";
				led_mode = <0x05>;
				data = <0x01>;
				pwm_config = <0x01 0x00 0x00 0x00 0x00>;
				phandle = <0x4c>;
			};

			vibrator@0 {
				compatible = "mediatek,vibrator";
				vib_timer = <0x19>;
				vib_limit = <0x09>;
				vib_vol = <0x0b>;
				phandle = <0x4d>;
			};

			tran_audio {
				compatible = "tran_audio,audio";
				extamp_gpio = <0xffffffff 0xa6 0x00>;
				dual_speaker_gpio = <0xffffffff 0x97 0x00>;
				extamp_mode = <0x02>;
				extamp_speech_mode = <0x02>;
				receiver_mode = <0x06>;
				extamp_fm_mode = <0x06>;
				phandle = <0x4e>;
			};

			fingerprint {
				compatible = "tran_fp";
				interrupt-parent = <0xffffffff>;
				interrupts = <0x07 0x01 0x07 0x00>;
				debounce = <0x07 0x00>;
				pinctrl-names = "tran_fp_default\0tran_fp_pin_irq\0tran_fp_irq_pull_down\0tran_fp_reset_high\0tran_fp_reset_low";
				pinctrl-0 = <0x07>;
				pinctrl-1 = <0x08>;
				pinctrl-2 = <0x09>;
				pinctrl-3 = <0x0a>;
				pinctrl-4 = <0x0b>;
				status = "okay";
				phandle = <0x4f>;
			};
		};
	};

	fragment@4 {
		target = <0xffffffff>;

		__overlay__ {

			fingerprint@0 {
				compatible = "tran_fp";
				reg = <0x00>;
				spi-max-frequency = <0x19bfcc0>;
				interrupt-parent = <0xffffffff>;
				interrupts = <0x07 0x01 0x07 0x00>;
				debounce = <0x07 0x00>;
				irq-gpio = <0x07>;
				irq-gpio-std = <0xffffffff 0x07 0x00>;
				reset-gpio = <0x06>;
				reset-gpio-std = <0xffffffff 0x06 0x00>;
				tran,gpio_pwr = <0x9f>;
				tran,gpio_pwr-std = <0xffffffff 0x9f 0x00>;
				pinctrl-names = "tran_fp_default\0tran_fp_pin_irq\0tran_fp_irq_pull_down\0tran_fp_reset_high\0tran_fp_reset_low";
				pinctrl-0 = <0x07>;
				pinctrl-1 = <0x08>;
				pinctrl-2 = <0x09>;
				pinctrl-3 = <0x0a>;
				pinctrl-4 = <0x0b>;
				status = "okay";
			};
		};
	};

	fragment@5 {
		target = <0xffffffff>;

		__overlay__ {

			fingerprint_default {
				phandle = <0x07>;
			};

			gpio7_eint {
				phandle = <0x08>;

				pins_cmd_dat {
					pinmux = <0x700>;
					slew-rate = <0x00>;
					bias-disable;
				};
			};

			gpio7_eint_pull_down {
				phandle = <0x09>;

				pins_cmd_dat {
					pinmux = <0x700>;
					slew-rate = <0x00>;
					bias-pull-down = <0x00>;
					output-low;
				};
			};

			rst_out_one {
				phandle = <0x0a>;

				pins_cmd_dat {
					pinmux = <0x600>;
					slew-rate = <0x01>;
					bias-disable;
					output-high;
				};
			};

			rst_out_zero {
				phandle = <0x0b>;

				pins_cmd_dat {
					pinmux = <0x600>;
					slew-rate = <0x01>;
					bias-disable;
					output-low;
				};
			};
		};
	};

	fragment@6 {
		target = <0xffffffff>;

		__overlay__ {
			clock-frequency = <0x61a80>;

			mtk-usb@60 {
				compatible = "mediatek,mtk-usb";
				reg = <0x60>;
				status = "okay";
			};
		};
	};

	fragment@7 {
		target = <0xffffffff>;

		__overlay__ {
			status = "okay";

			nfc_nxp@28 {
				compatible = "nxp,pn544";
				reg = <0x28>;
				nxp,pn544-irq = <0xffffffff 0x1d 0x00>;
				nxp,pn544-ven = <0xffffffff 0x1e 0x00>;
				nxp,pn544-fw-dwnld = <0xffffffff 0x25 0x00>;
			};

			irq_nfc {
				compatible = "mediatek,irq_nfc-eint";
				interrupt-parent = <0xffffffff>;
				interrupts = <0x1d 0x04 0x1d 0x00>;
				status = "okay";
				phandle = <0x50>;
			};
		};
	};

	fragment@8 {
		target = <0xffffffff>;

		__overlay__ {
			accdet-mic-vol = <0x06>;
			headset-mode-setting = <0x500 0x500 0x01 0x1f0 0x800 0x800 0x20 0x44>;
			accdet-plugout-debounce = <0x01>;
			accdet-mic-mode = <0x01>;
			headset-eint-level-pol = <0x08>;
			headset-three-key-threshold = <0x00 0x50 0xdc 0x190>;
			headset-three-key-threshold-CDD = <0x00 0x79 0xc0 0x258>;
			headset-four-key-threshold = <0x00 0x3a 0x79 0xc0 0x190>;
			status = "okay";
		};
	};

	fragment@9 {
		target = <0xffffffff>;

		__overlay__ {
			pinctrl-names = "default";
			pinctrl-0 = <0x0c>;
		};
	};

	fragment@10 {
		target = <0xffffffff>;

		__overlay__ {

			kpdgpiodefault {
				phandle = <0x0c>;

				pins_cmd_dat {
					pinmux = <0x5d01>;
					bias-pull-up = <0x66>;
					input-enable;
					input-schmitt-enable;
				};
			};
		};
	};

	fragment@11 {
		target = <0xffffffff>;

		__overlay__ {

			consys_default {
				phandle = <0x0d>;
			};

			gpslna@0 {
				phandle = <0x0e>;

				pins_cmd_dat {
					pinmux = <0x5b00>;
					slew-rate = <0x00>;
					bias-disable;
					output-low;
				};
			};

			gpslna@1 {
				phandle = <0x0f>;

				pins_cmd_dat {
					pinmux = <0x5b00>;
					slew-rate = <0x01>;
					output-high;
				};
			};

			gpslna@2 {
				phandle = <0x10>;

				pins_cmd_dat {
					pinmux = <0x5b00>;
					slew-rate = <0x01>;
					output-low;
				};
			};

			fmgpio@3 {
				phandle = <0x11>;

				pins_cmd_dat {
					pinmux = <0x5c00>;
					slew-rate = <0x01>;
					output-high;
				};
			};

			fmgpio@4 {
				phandle = <0x12>;

				pins_cmd_dat {
					pinmux = <0x5c00>;
					slew-rate = <0x01>;
					output-low;
				};
			};
		};
	};

	fragment@12 {
		target = <0xffffffff>;

		__overlay__ {
			pinctrl-names = "default\0gps_lna_state_init\0gps_lna_state_oh\0gps_lna_state_ol\0fm_gpio_func_1\0fm_gpio_func_0";
			pinctrl-0 = <0x0d>;
			pinctrl-1 = <0x0e>;
			pinctrl-2 = <0x0f>;
			pinctrl-3 = <0x10>;
			pinctrl-4 = <0x11>;
			pinctrl-5 = <0x12>;
			status = "okay";
		};
	};

	fragment@13 {
		target = <0xffffffff>;

		__overlay__ {
			pinctrl-names = "irtx_gpio_led_default\0irtx_gpio_led_set";
			pinctrl-0 = <0x13>;
			pinctrl-1 = <0x14>;
			status = "okay";
		};
	};

	fragment@14 {
		target = <0xffffffff>;

		__overlay__ {

			irtx_gpio_led_def@gpio12 {
				phandle = <0x13>;

				pins_cmd_dat {
					pinmux = <0xc00>;
					slew-rate = <0x01>;
					bias-disable;
					output-low;
					input-schmitt-enable = <0x00>;
				};
			};

			irtx_gpio_led_set@gpio12 {
				phandle = <0x14>;

				pins_cmd_dat {
					pinmux = <0xc01>;
					slew-rate = <0x01>;
					output-high;
				};
			};
		};
	};

	fragment@15 {
		target = <0xffffffff>;

		__overlay__ {

			lcd_bias_enp1_gpio {
				phandle = <0x15>;

				pins_cmd_dat {
					pinmux = <0x9900>;
					slew-rate = <0x01>;
					output-high;
				};
			};

			lcd_bias_enp0_gpio {
				phandle = <0x16>;

				pins_cmd_dat {
					pinmux = <0x9900>;
					slew-rate = <0x01>;
					output-low;
				};
			};

			lcd_bias_enn1_gpio {
				phandle = <0x17>;

				pins_cmd_dat {
					pinmux = <0x9800>;
					slew-rate = <0x01>;
					output-high;
				};
			};

			lcd_bias_enn0_gpio {
				phandle = <0x18>;

				pins_cmd_dat {
					pinmux = <0x9800>;
					slew-rate = <0x01>;
					output-low;
				};
			};

			lcm_rst_out1_gpio {
				phandle = <0x19>;

				pins_cmd_dat {
					pinmux = <0x2d00>;
					slew-rate = <0x01>;
					output-high;
				};
			};

			lcm_rst_out0_gpio {
				phandle = <0x1a>;

				pins_cmd_dat {
					pinmux = <0x2d00>;
					slew-rate = <0x01>;
					output-low;
				};
			};

			lcm_dsi_te {
				phandle = <0x1b>;

				pins_cmd_dat {
					pinmux = <0x2c01>;
				};
			};
		};
	};

	fragment@16 {
		target = <0xffffffff>;

		__overlay__ {
			pinctrl-names = "lcd_bias_enp1_gpio\0lcd_bias_enp0_gpio\0lcd_bias_enn1_gpio\0lcd_bias_enn0_gpio\0lcm_rst_out1_gpio\0lcm_rst_out0_gpio\0mode_te_te";
			pinctrl-0 = <0x15>;
			pinctrl-1 = <0x16>;
			pinctrl-2 = <0x17>;
			pinctrl-3 = <0x18>;
			pinctrl-4 = <0x19>;
			pinctrl-5 = <0x1a>;
			pinctrl-6 = <0x1b>;
			status = "okay";
		};
	};

	fragment@17 {
		target = <0xffffffff>;

		__overlay__ {

			otg_iddig {
				compatible = "mediatek,usb_iddig_bi_eint";
				interrupt-parent = <0xffffffff>;
				interrupts = <0x29 0x02 0x29 0x00>;
				debounce = <0xfa00>;
				status = "okay";
				phandle = <0x51>;
			};

			tran_battery {
				compatible = "tran,chg_fun";
				enable_pcb_tml;
				pcb_temp_step_one = <0xa028>;
				pcb_cur_step_one = <0xc8>;
				pcb_temp_step_two = <0xabe0>;
				pcb_cur_step_two = <0x1f4>;
				pcb_min_chg_cur = <0xf4240>;
				jeita_below_t0_chg_cur = <0x00>;
				jeita_t0_to_t1_chg_cur = <0xf4240>;
				jeita_t2_to_t3_chg_cur = <0x1e8480>;
				jeita_t3_to_t4_chg_cur = <0x1e8480>;
				jeita_above_t4_chg_cur = <0x00>;
				jeita_below_t0_input_cur = <0x16e360>;
				jeita_t0_to_t1_input_cur = <0x16e360>;
				jeita_t2_to_t3_input_cur = <0x200b20>;
				jeita_t3_to_t4_input_cur = <0x200b20>;
				jeita_above_t4_input_cur = <0xf4240>;
				md_pa_temp_thres = <0xd6d8>;
				md_pa_temp_thres_minus_x_degree = <0xcb20>;
				phandle = <0x52>;
			};

			tran_battery_aging {
				compatible = "tran,chg_aging";
				battery_aging_module0 = <0x00>;
				battery_aging_module1 = <0x00>;
				battery_aging_module2 = <0x00>;
				battery_aging_module3 = <0x00>;
				phandle = <0x53>;
			};
		};
	};

	fragment@18 {
		target = <0xffffffff>;

		__overlay__ {
			charger = <0xffffffff>;
			id-gpios = <0xffffffff 0x29 0x00>;
			fake_typec_otg_detect;
			io-channels = <0xffffffff 0x04>;
			io-channel-names = "AUX_CHG";
			pinctrl-names = "otg_dcp_init\0otg_dcp_low\0otg_dcp_high";
			pinctrl-0 = <0x1c>;
			pinctrl-1 = <0x1d>;
			pinctrl-2 = <0x1e>;
		};
	};

	fragment@19 {
		target = <0xffffffff>;

		__overlay__ {
			compatible = "mediatek,charger";
			algorithm_name = "SwitchCharging";
			enable_sw_jeita;
			enable_pe_plus;
			enable_pe_2;
			enable_hvdcp20;
			enable_tc30;
			power_path_support;
			disable_topoff_ir_comp;
			r_bat_comp = <0x14>;
			v_comp_max = <0x4e20>;
			disable_pd_dual;
			multi_battery_cv;
			battery_cv = <0x43e6d0 0x43e6d0 0x43e6d0 0x43e6d0>;
			max_charger_voltage = <0x632ea0>;
			min_charger_voltage = <0x4630c0>;
			min_charger_voltage_1 = <0x432380>;
			min_charger_voltage_2 = <0x401640>;
			max_dmivr_charger_current = <0x155cc0>;
			usb_charger_current_suspend = <0x00>;
			usb_charger_current_unconfigured = <0x11170>;
			usb_charger_current_configured = <0x7a120>;
			usb_charger_current = <0x7a120>;
			ac_charger_current = <0x2191c0>;
			ac_charger_input_current = <0x1e8480>;
			non_std_ac_charger_current = <0x124f80>;
			charging_host_charger_current = <0x16e360>;
			apple_1_0a_charger_current = <0x9eb10>;
			apple_2_1a_charger_current = "\0\f5";
			ta_ac_charger_current = <0x2dc6c0>;
			jeita_temp_above_t4_cv = <0x3e8fa0 0x3e8fa0 0x3e8fa0 0x3e8fa0>;
			jeita_temp_t3_to_t4_cv = <0x3e8fa0 0x3e8fa0 0x3e8fa0 0x3e8fa0>;
			jeita_temp_t2_to_t3_cv = <0x43e6d0 0x43e6d0 0x43e6d0 0x43e6d0>;
			jeita_temp_t1_to_t2_cv = <0x43e6d0 0x43e6d0 0x43e6d0 0x43e6d0>;
			jeita_temp_t0_to_t1_cv = <0x43e6d0 0x43e6d0 0x43e6d0 0x43e6d0>;
			jeita_temp_below_t0_cv = <0x43e6d0 0x43e6d0 0x43e6d0 0x43e6d0>;
			temp_t4_thres = <0x37>;
			temp_t4_thres_minus_x_degree = <0x33>;
			temp_t3_thres = <0x2d>;
			temp_t3_thres_minus_x_degree = <0x2c>;
			temp_t2_thres = <0x0f>;
			temp_t2_thres_plus_x_degree = <0x10>;
			temp_t1_thres = <0x01>;
			temp_t1_thres_plus_x_degree = <0x01>;
			temp_t0_thres = <0x01>;
			temp_t0_thres_plus_x_degree = <0x01>;
			temp_neg_10_thres = <0x02>;
			enable_min_charge_temp;
			min_charge_temp = <0x00>;
			min_charge_temp_plus_x_degree = <0x01>;
			max_charge_temp = <0x35>;
			max_charge_temp_minus_x_degree = <0x34>;
			ta_9v_support;
			pe_ichg_level_threshold = <0xf4240>;
			ta_ac_12v_input_current = <0x30d400>;
			ta_ac_9v_input_current = <0x200b20>;
			ta_ac_7v_input_current = <0x1e8480>;
			pe20_ichg_level_threshold = <0xf4240>;
			ta_start_battery_soc = <0x00>;
			ta_stop_battery_soc = <0x5a>;
			high_temp_to_leave_pe40 = <0x2e>;
			high_temp_to_enter_pe40 = <0x27>;
			low_temp_to_leave_pe40 = <0x0a>;
			low_temp_to_enter_pe40 = <0x10>;
			pe40_single_charger_input_current = <0x2dc6c0>;
			pe40_single_charger_current = <0x2dc6c0>;
			pe40_dual_charger_input_current = <0x2dc6c0>;
			pe40_dual_charger_chg1_current = <0x1e8480>;
			pe40_dual_charger_chg2_current = <0x1e8480>;
			pe40_stop_battery_soc = <0x50>;
			pe40_r_cable_1a_lower = <0x206>;
			pe40_r_cable_2a_lower = <0x17f>;
			pe40_r_cable_3a_lower = <0xf5>;
			chg1_ta_ac_charger_current = <0x16e360>;
			chg2_ta_ac_charger_current = <0x16e360>;
			slave_mivr_diff = <0x186a0>;
			dual_polling_ieoc = <0x6ddd0>;
			cable_imp_threshold = <0x2bb>;
			vbat_cable_imp_threshold = <0x3b8260>;
			bif_threshold1 = <0x40d990>;
			bif_threshold2 = <0x419ce0>;
			bif_cv_under_threshold2 = <0x43e6d0>;
			pd_vbus_low_bound = <0x4c4b40>;
			pd_vbus_upper_bound = <0x4c4b40>;
			pd_ichg_level_threshold = <0xf4240>;
			pd_stop_battery_soc = <0x50>;
			ibus_err = <0x0e>;
			vsys_watt = <0x4c4b40>;
			max_charging_time = <0x11940>;
		};
	};

	fragment@20 {
		target = <0xffffffff>;

		__overlay__ {
			compatible = "mediatek,lk_charger";
			enable_anime;
			enable_pe_plus;
			enable_pd20_reset;
			power_path_support;
			max_charger_voltage = <0x632ea0>;
			fast_charge_voltage = <0x2625a0>;
			usb_charger_current = <0x7a120>;
			ac_charger_current = <0x16e360>;
			ac_charger_input_current = <0x16e360>;
			non_std_ac_charger_current = <0x7a120>;
			charging_host_charger_current = <0x16e360>;
			ta_ac_charger_current = <0x2dc6c0>;
			pd_charger_current = <0x7a120>;
			cur_threshold = <0x7a120>;
			temp_t4_threshold = <0x32>;
			temp_t3_threshold = <0x2d>;
			temp_t2_threshold = <0x0f>;
			temp_t1_threshold = <0x00>;
		};
	};

	fragment@21 {
		target = <0xffffffff>;

		__overlay__ {

			rt-swchg@53 {
				compatible = "richtek,swchg";
				reg = <0x53>;
				status = "okay";
				rt,intr_gpio_num = <0x09>;
				rt,intr_gpio = <0xffffffff 0x09 0x00>;
				hvdcp20_dp_gpio = <0xffffffff 0xa0 0x00>;
				tc30_dm_gpio = <0xffffffff 0xb3 0x00>;
				led_ctl_gpio = <0xffffffff 0xa5 0x00>;

				rt9471 {
					charger_name = "primary_chg";
					chg_alias_name = "rt9471_chg";
					rm-slave-addr = [53];
					rm-name = "rt9471";
					interrupt-names = "wdt\0chg_mivr\0vac_ov\0otg_fault\0chg_rdy\0chg_done\0aicc_done\0pe_done\0chg_tout\0ieoc\0rechg\0chg_batov";
					vac_ovp = <0xd59f80>;
					mivr = <0x432380>;
					aicr = <0x7a120>;
					cv = <0x43e6d0>;
					ichg = <0x16e360>;
					ieoc = <0x30d40>;
					safe_tmr = <0x0a>;
					wdt = <0x28>;
					mivr_track = <0x00>;
					en_safe_tmr;
					en_te;
					en_qon_rst;
				};
			};
		};
	};

	fragment@22 {
		target = <0xffffffff>;

		__overlay__ {

			touch@0 {
				compatible = "mediatek,cap_touch_2";
				reg = <0x00>;
				spi-max-frequency = <0x7a1200>;
				status = "okay";
				omnivision,irq-on-state = <0x00>;
				omnivision,power-delay-ms = <0xc8>;
				omnivision,reset-on-state = <0x00>;
				omnivision,reset-active-ms = <0x14>;
				omnivision,reset-delay-ms = <0xc8>;
				omnivision,byte-delay-us = <0x00>;
				omnivision,ubl-max-freq = <0x7a1200>;
				omnivision,ubl-byte-delay-us = <0x14>;
				omnivision,spi-mode = <0x03>;
				omnivision,block-delay-us = <0x00>;
				pt7_hi_limits_row_01 = <0x26>;
				pt7_hi_limits_cols_01 = <0x26>;
				pt7_hi_limits_01 = <0x5dc 0x5dc 0x5dc 0x5dc 0x5dc 0x5dc 0x5dc 0x5dc 0x5dc 0x5dc 0x5dc 0x5dc 0x5dc 0x5dc 0x5dc 0x5dc 0x5dc 0x5dc 0x5dc 0x5dc 0x5dc 0x5dc 0x5dc 0x5dc 0x5dc 0x5dc 0x5dc 0x5dc 0x5dc 0x5dc 0x5dc 0x5dc 0x5dc 0x5dc 0x5dc 0x5dc 0x5dc 0x5dc 0x5dc 0x5dc 0x5dc 0x5dc 0x5dc 0x5dc 0x5dc 0x5dc 0x5dc 0x5dc 0x5dc 0x5dc 0x5dc 0x5dc 0x5dc 0x5dc 0x5dc 0x5dc 0x5dc 0x5dc 0x5dc 0x5dc 0x5dc 0x5dc 0x5dc 0x5dc 0x5dc 0x5dc 0x5dc 0x5dc 0x5dc 0x5dc 0x5dc 0x5dc 0x5dc 0x5dc 0x5dc 0x5dc 0x5dc 0x5dc 0x5dc 0x5dc 0x5dc 0x5dc 0x5dc 0x5dc 0x5dc 0x5dc 0x5dc 0x5dc 0x5dc 0x5dc 0x5dc 0x5dc 0x5dc 0x5dc 0x5dc 0x5dc 0x5dc 0x5dc 0x5dc 0x5dc 0x5dc 0x5dc 0x5dc 0x5dc 0x5dc 0x5dc 0x5dc 0x5dc 0x5dc 0x5dc 0x5dc 0x5dc 0x5dc 0x5dc 0x5dc 0x5dc 0x5dc 0x5dc 0x5dc 0x5dc 0x5dc 0x5dc 0x5dc 0x5dc 0x5dc 0x5dc 0x5dc 0x5dc 0x5dc 0x5dc 0x5dc 0x5dc 0x5dc 0x5dc 0x5dc 0x5dc 0x5dc 0x5dc 0x5dc 0x5dc 0x5dc 0x5dc 0x5dc 0x5dc 0x5dc 0x5dc 0x5dc 0x5dc 0x5dc 0x5dc 0x5dc 0x5dc 0x5dc 0x5dc 0x5dc 0x5dc 0x5dc 0x5dc 0x5dc 0x5dc 0x5dc 0x5dc 0x5dc 0x5dc 0x5dc 0x5dc 0x5dc 0x5dc 0x5dc 0x5dc 0x5dc 0x5dc 0x5dc 0x5dc 0x5dc 0x5dc 0x5dc 0x5dc 0x5dc 0x5dc 0x5dc 0x5dc 0x5dc 0x5dc 0x5dc 0x5dc 0x5dc 0x5dc 0x5dc 0x5dc 0x5dc 0x5dc 0x5dc 0x5dc 0x5dc 0x5dc 0x5dc 0x5dc 0x5dc 0x5dc 0x5dc 0x5dc 0x5dc 0x5dc 0x5dc 0x5dc 0x5dc 0x5dc 0x5dc 0x5dc 0x5dc 0x5dc 0x5dc 0x5dc 0x5dc 0x5dc 0x5dc 0x5dc 0x5dc 0x5dc 0x5dc 0x5dc 0x5dc 0x5dc 0x5dc 0x5dc 0x5dc 0x5dc 0x5dc 0x5dc 0x5dc 0x5dc 0x5dc 0x5dc 0x5dc 0x5dc 0x5dc 0x5dc 0x5dc 0x5dc 0x5dc 0x5dc 0x5dc 0x5dc 0x5dc 0x5dc 0x5dc 0x5dc 0x5dc 0x5dc 0x5dc 0x5dc 0x5dc 0x5dc 0x5dc 0x5dc 0x5dc 0x5dc 0x5dc 0x5dc 0x5dc 0x5dc 0x5dc 0x5dc 0x5dc 0x5dc 0x5dc 0x5dc 0x5dc 0x5dc 0x5dc 0x5dc 0x5dc 0x5dc 0x5dc 0x5dc 0x5dc 0x5dc 0x5dc 0x5dc 0x5dc 0x5dc 0x5dc 0x5dc 0x5dc 0x5dc 0x5dc 0x5dc 0x5dc 0x5dc 0x5dc 0x5dc 0x5dc 0x5dc 0x5dc 0x5dc 0x5dc 0x5dc 0x5dc 0x5dc 0x5dc 0x5dc 0x5dc 0x5dc 0x5dc 0x5dc 0x5dc 0x5dc 0x5dc 0x5dc 0x5dc 0x5dc 0x5dc 0x5dc 0x5dc 0x5dc 0x5dc 0x5dc 0x5dc 0x5dc 0x5dc 0x5dc 0x5dc 0x5dc 0x5dc 0x5dc 0x5dc 0x5dc 0x5dc 0x5dc 0x5dc 0x5dc 0x5dc 0x5dc 0x5dc 0x5dc 0x5dc 0x5dc 0x5dc 0x5dc 0x5dc 0x5dc 0x5dc 0x5dc 0x5dc 0x5dc 0x5dc 0x5dc 0x5dc 0x5dc 0x5dc 0x5dc 0x5dc 0x5dc 0x5dc 0x5dc 0x5dc 0x5dc 0x5dc 0x5dc 0x5dc 0x5dc 0x5dc 0x5dc 0x5dc 0x5dc 0x5dc 0x5dc 0x5dc 0x5dc 0x5dc 0x5dc 0x5dc 0x5dc 0x5dc 0x5dc 0x5dc 0x5dc 0x5dc 0x5dc 0x5dc 0x5dc 0x5dc 0x5dc 0x5dc 0x5dc 0x5dc 0x5dc 0x5dc 0x5dc 0x5dc 0x5dc 0x5dc 0x5dc 0x5dc 0x5dc 0x5dc 0x5dc 0x5dc 0x5dc 0x5dc 0x5dc 0x5dc 0x5dc 0x5dc 0x5dc 0x5dc 0x5dc 0x5dc 0x5dc 0x5dc 0x5dc 0x5dc 0x5dc 0x5dc 0x5dc 0x5dc 0x5dc 0x5dc 0x5dc 0x5dc 0x5dc 0x5dc 0x5dc 0x5dc 0x5dc 0x5dc 0x5dc 0x5dc 0x5dc 0x5dc 0x5dc 0x5dc 0x5dc 0x5dc 0x5dc 0x5dc 0x5dc 0x5dc 0x5dc 0x5dc 0x5dc 0x5dc 0x5dc 0x5dc 0x5dc 0x5dc 0x5dc 0x5dc 0x5dc 0x5dc 0x5dc 0x5dc 0x5dc 0x5dc 0x5dc 0x5dc 0x5dc 0x5dc 0x5dc 0x5dc 0x5dc 0x5dc 0x5dc 0x5dc 0x5dc 0x5dc 0x5dc 0x5dc 0x5dc 0x5dc 0x5dc 0x5dc 0x5dc 0x5dc 0x5dc 0x5dc 0x5dc 0x5dc 0x5dc 0x5dc 0x5dc 0x5dc 0x5dc 0x5dc 0x5dc 0x5dc 0x5dc 0x5dc 0x5dc 0x5dc 0x5dc 0x5dc 0x5dc 0x5dc 0x5dc 0x5dc 0x5dc 0x5dc 0x5dc 0x5dc 0x5dc 0x5dc 0x5dc 0x5dc 0x5dc 0x5dc 0x5dc 0x5dc 0x5dc 0x5dc 0x5dc 0x5dc 0x5dc 0x5dc 0x5dc 0x5dc 0x5dc 0x5dc 0x5dc 0x5dc 0x5dc 0x5dc 0x5dc 0x5dc 0x5dc 0x5dc 0x5dc 0x5dc 0x5dc 0x5dc 0x5dc 0x5dc 0x5dc 0x5dc 0x5dc 0x5dc 0x5dc 0x5dc 0x5dc 0x5dc 0x5dc 0x5dc 0x5dc 0x5dc 0x5dc 0x5dc 0x5dc 0x5dc 0x5dc 0x5dc 0x5dc 0x5dc 0x5dc 0x5dc 0x5dc 0x5dc 0x5dc 0x5dc 0x5dc 0x5dc 0x5dc 0x5dc 0x5dc 0x5dc 0x5dc 0x5dc 0x5dc 0x5dc 0x5dc 0x5dc 0x5dc 0x5dc 0x5dc 0x5dc 0x5dc 0x5dc 0x5dc 0x5dc 0x5dc 0x5dc 0x5dc 0x5dc 0x5dc 0x5dc 0x5dc 0x5dc 0x5dc 0x5dc 0x5dc 0x5dc 0x5dc 0x5dc 0x5dc 0x5dc 0x5dc 0x5dc 0x5dc 0x5dc 0x5dc 0x5dc 0x5dc 0x5dc 0x5dc 0x5dc 0x5dc 0x5dc 0x5dc 0x5dc 0x5dc 0x5dc 0x5dc 0x5dc 0x5dc 0x5dc 0x5dc 0x5dc 0x5dc 0x5dc 0x5dc 0x5dc 0x5dc 0x5dc 0x5dc 0x5dc 0x5dc 0x5dc 0x5dc 0x5dc 0x5dc 0x5dc 0x5dc 0x5dc 0x5dc 0x5dc 0x5dc 0x5dc 0x5dc 0x5dc 0x5dc 0x5dc 0x5dc 0x5dc 0x5dc 0x5dc 0x5dc 0x5dc 0x5dc 0x5dc 0x5dc 0x5dc 0x5dc 0x5dc 0x5dc 0x5dc 0x5dc 0x5dc 0x5dc 0x5dc 0x5dc 0x5dc 0x5dc 0x5dc 0x5dc 0x5dc 0x5dc 0x5dc 0x5dc 0x5dc 0x5dc 0x5dc 0x5dc 0x5dc 0x5dc 0x5dc 0x5dc 0x5dc 0x5dc 0x5dc 0x5dc 0x5dc 0x5dc 0x5dc 0x5dc 0x5dc 0x5dc 0x5dc 0x5dc 0x5dc 0x5dc 0x5dc 0x5dc 0x5dc 0x5dc 0x5dc 0x5dc 0x5dc 0x5dc 0x5dc 0x5dc 0x5dc 0x5dc 0x5dc 0x5dc 0x5dc 0x5dc 0x5dc 0x5dc 0x5dc 0x5dc 0x5dc 0x5dc 0x5dc 0x5dc 0x5dc 0x5dc 0x5dc 0x5dc 0x5dc 0x5dc 0x5dc 0x5dc 0x5dc 0x5dc 0x5dc 0x5dc 0x5dc 0x5dc 0x5dc 0x5dc 0x5dc 0x5dc 0x5dc 0x5dc 0x5dc 0x5dc 0x5dc 0x5dc 0x5dc 0x5dc 0x5dc 0x5dc 0x5dc 0x5dc 0x5dc 0x5dc 0x5dc 0x5dc 0x5dc 0x5dc 0x5dc 0x5dc 0x5dc 0x5dc 0x5dc 0x5dc 0x5dc 0x5dc 0x5dc 0x5dc 0x5dc 0x5dc 0x5dc 0x5dc 0x5dc 0x5dc 0x5dc 0x5dc 0x5dc 0x5dc 0x5dc 0x5dc 0x5dc 0x5dc 0x5dc 0x5dc 0x5dc 0x5dc 0x5dc 0x5dc 0x5dc 0x5dc 0x5dc 0x5dc 0x5dc 0x5dc 0x5dc 0x5dc 0x5dc 0x5dc 0x5dc 0x5dc 0x5dc 0x5dc 0x5dc 0x5dc 0x5dc 0x5dc 0x5dc 0x5dc 0x5dc 0x5dc 0x5dc 0x5dc 0x5dc 0x5dc 0x5dc 0x5dc 0x5dc 0x5dc 0x5dc 0x5dc 0x5dc 0x5dc 0x5dc 0x5dc 0x5dc 0x5dc 0x5dc 0x5dc 0x5dc 0x5dc 0x5dc 0x5dc 0x5dc 0x5dc 0x5dc 0x5dc 0x5dc 0x5dc 0x5dc 0x5dc 0x5dc 0x5dc 0x5dc 0x5dc 0x5dc 0x5dc 0x5dc 0x5dc 0x5dc 0x5dc 0x5dc 0x5dc 0x5dc 0x5dc 0x5dc 0x5dc 0x5dc 0x5dc 0x5dc 0x5dc 0x5dc 0x5dc 0x5dc 0x5dc 0x5dc 0x5dc 0x5dc 0x5dc 0x5dc 0x5dc 0x5dc 0x5dc 0x5dc 0x5dc 0x5dc 0x5dc 0x5dc 0x5dc 0x5dc 0x5dc 0x5dc 0x5dc 0x5dc 0x5dc 0x5dc 0x5dc 0x5dc 0x5dc 0x5dc 0x5dc 0x5dc 0x5dc 0x5dc 0x5dc 0x5dc 0x5dc 0x5dc 0x5dc 0x5dc 0x5dc 0x5dc 0x5dc 0x5dc 0x5dc 0x5dc 0x5dc 0x5dc 0x5dc 0x5dc 0x5dc 0x5dc 0x5dc 0x5dc 0x5dc 0x5dc 0x5dc 0x5dc 0x5dc 0x5dc 0x5dc 0x5dc 0x5dc 0x5dc 0x5dc 0x5dc 0x5dc 0x5dc 0x5dc 0x5dc 0x5dc 0x5dc 0x5dc 0x5dc 0x5dc 0x5dc 0x5dc 0x5dc 0x5dc 0x5dc 0x5dc 0x5dc 0x5dc 0x5dc 0x5dc 0x5dc 0x5dc 0x5dc 0x5dc 0x5dc 0x5dc 0x5dc 0x5dc 0x5dc 0x5dc 0x5dc 0x5dc 0x5dc 0x5dc 0x5dc 0x5dc 0x5dc 0x5dc 0x5dc 0x5dc 0x5dc 0x5dc 0x5dc 0x5dc 0x5dc 0x5dc 0x5dc 0x5dc 0x5dc 0x5dc 0x5dc 0x5dc 0x5dc 0x5dc 0x5dc 0x5dc 0x5dc 0x5dc 0x5dc 0x5dc 0x5dc 0x5dc 0x5dc 0x5dc 0x5dc 0x5dc 0x5dc 0x5dc 0x5dc 0x5dc 0x5dc 0x5dc 0x5dc 0x5dc 0x5dc 0x5dc 0x5dc 0x5dc 0x5dc 0x5dc 0x5dc 0x5dc 0x5dc 0x5dc 0x5dc 0x5dc 0x5dc 0x5dc 0x5dc 0x5dc 0x5dc 0x5dc 0x5dc 0x5dc 0x5dc 0x5dc 0x5dc 0x5dc 0x5dc 0x5dc 0x5dc 0x5dc 0x5dc 0x5dc 0x5dc 0x5dc 0x5dc 0x5dc 0x5dc 0x5dc 0x5dc 0x5dc 0x5dc 0x5dc 0x5dc 0x5dc 0x5dc 0x5dc 0x5dc 0x5dc 0x5dc 0x5dc 0x5dc 0x5dc 0x5dc 0x5dc 0x5dc 0x5dc 0x5dc 0x5dc 0x5dc 0x5dc 0x5dc 0x5dc 0x5dc 0x5dc 0x5dc 0x5dc 0x5dc 0x5dc 0x5dc 0x5dc 0x5dc 0x5dc 0x5dc 0x5dc 0x5dc 0x5dc 0x5dc 0x5dc 0x5dc 0x5dc 0x5dc 0x5dc 0x5dc 0x5dc 0x5dc 0x5dc 0x5dc 0x5dc 0x5dc 0x5dc 0x5dc 0x5dc 0x5dc 0x5dc 0x5dc 0x5dc 0x5dc 0x5dc 0x5dc 0x5dc 0x5dc 0x5dc 0x5dc 0x5dc 0x5dc 0x5dc 0x5dc 0x5dc 0x5dc 0x5dc 0x5dc 0x5dc 0x5dc 0x5dc 0x5dc 0x5dc 0x5dc 0x5dc 0x5dc 0x5dc 0x5dc 0x5dc 0x5dc 0x5dc 0x5dc 0x5dc 0x5dc 0x5dc 0x5dc 0x5dc 0x5dc 0x5dc 0x5dc 0x5dc 0x5dc 0x5dc 0x5dc 0x5dc 0x5dc 0x5dc 0x5dc 0x5dc 0x5dc 0x5dc 0x5dc 0x5dc 0x5dc 0x5dc 0x5dc 0x5dc 0x5dc 0x5dc 0x5dc 0x5dc 0x5dc 0x5dc 0x5dc 0x5dc 0x5dc 0x5dc 0x5dc 0x5dc 0x5dc 0x5dc 0x5dc 0x5dc 0x5dc 0x5dc 0x5dc 0x5dc 0x5dc 0x5dc 0x5dc 0x5dc 0x5dc 0x5dc 0x5dc 0x5dc 0x5dc 0x5dc 0x5dc 0x5dc 0x5dc 0x5dc 0x5dc 0x5dc 0x5dc 0x5dc 0x5dc 0x5dc 0x3a98 0x5dc 0x5dc 0x5dc 0x5dc 0x5dc 0x5dc 0x5dc 0x3a98 0x3a98 0x5dc 0x5dc 0x5dc 0x5dc 0x5dc 0x5dc 0x5dc 0x3a98 0x5dc 0x5dc 0x5dc 0x5dc 0x5dc 0x5dc 0x01 0x1f4 0x5dc 0x5dc 0x5dc 0x5dc 0x5dc 0x5dc 0x5dc 0x5dc 0x5dc 0x5dc 0x5dc 0x5dc 0x5dc 0x5dc 0x5dc 0x5dc 0x5dc 0x5dc 0x5dc 0x5dc 0x5dc 0x5dc 0x5dc 0x5dc 0x5dc 0x5dc 0x5dc 0x5dc 0x5dc 0x5dc 0x5dc 0x5dc 0x5dc 0x5dc 0x5dc 0x5dc 0x5dc 0x5dc 0x5dc 0x5dc 0x5dc 0x5dc 0x5dc 0x5dc 0x5dc 0x5dc 0x5dc 0x5dc 0x5dc 0x5dc 0x5dc 0x5dc 0x5dc 0x5dc 0x5dc 0x5dc 0x5dc 0x5dc 0x5dc 0x5dc 0x5dc 0x5dc 0x5dc 0x5dc 0x5dc 0x5dc 0x5dc 0x5dc 0x5dc 0x5dc 0x5dc 0x5dc 0x5dc 0x5dc 0x5dc 0x5dc 0x5dc 0x5dc 0x5dc 0x5dc 0x5dc 0x5dc 0x5dc 0x5dc 0x5dc 0x5dc 0x5dc 0x5dc 0x5dc 0x5dc 0x5dc 0x5dc 0x5dc 0x5dc 0x5dc 0x5dc 0x5dc 0x5dc 0x5dc 0x5dc 0x5dc 0x5dc 0x5dc 0x5dc 0x5dc 0x5dc 0x5dc 0x5dc 0x5dc 0x5dc 0x5dc 0x5dc 0x5dc 0x5dc 0x5dc 0x5dc 0x5dc 0x5dc 0x5dc 0x5dc 0x5dc 0x5dc 0x5dc 0x5dc 0x5dc 0x5dc 0x5dc 0x5dc 0x5dc 0x5dc 0x5dc 0x5dc 0x5dc 0x5dc 0x5dc 0x5dc 0x5dc 0x5dc 0x5dc 0x5dc 0x5dc 0x5dc 0x5dc 0x5dc 0x5dc 0x5dc 0x5dc 0x5dc 0x5dc 0x5dc 0x5dc 0x5dc 0x5dc 0x5dc 0x5dc 0x5dc 0x5dc 0x5dc 0x5dc 0x5dc 0x5dc 0x5dc 0x5dc 0x5dc 0x5dc 0x5dc 0x5dc 0x5dc 0x5dc 0x5dc 0x5dc 0x5dc 0x5dc 0x5dc 0x5dc 0x5dc 0x5dc 0x5dc 0x5dc 0x5dc 0x5dc 0x5dc 0x5dc 0x5dc 0x5dc 0x5dc 0x5dc 0x5dc 0x5dc 0x5dc 0x5dc 0x5dc 0x5dc 0x5dc 0x5dc 0x5dc 0x5dc 0x5dc 0x5dc 0x5dc 0x5dc 0x5dc 0x5dc 0x5dc 0x5dc 0x5dc 0x5dc 0x5dc 0x5dc 0x5dc 0x5dc 0x5dc 0x5dc 0x5dc 0x5dc 0x5dc 0x5dc 0x5dc 0x5dc 0x5dc 0x5dc 0x5dc 0x5dc 0x5dc 0x5dc 0x5dc 0x5dc 0x5dc 0x5dc 0x5dc 0x5dc 0x5dc 0x5dc 0x5dc 0x5dc 0x5dc 0x5dc 0x5dc 0x5dc 0x5dc 0x5dc>;
				pt7_lo_limits_row_01 = <0x26>;
				pt7_lo_limits_cols_01 = <0x26>;
				pt7_lo_limits_01 = <0x1f4 0x1f4 0x1f4 0x1f4 0x1f4 0x1f4 0x1f4 0x1f4 0x1f4 0x1f4 0x1f4 0x1f4 0x1f4 0x1f4 0x1f4 0x1f4 0x1f4 0x1f4 0x1f4 0x1f4 0x1f4 0x1f4 0x1f4 0x1f4 0x1f4 0x1f4 0x1f4 0x1f4 0x1f4 0x1f4 0x1f4 0x1f4 0x1f4 0x1f4 0x1f4 0x1f4 0x1f4 0x1f4 0x1f4 0x1f4 0x1f4 0x1f4 0x1f4 0x1f4 0x1f4 0x1f4 0x1f4 0x1f4 0x1f4 0x1f4 0x1f4 0x1f4 0x1f4 0x1f4 0x1f4 0x1f4 0x1f4 0x1f4 0x1f4 0x1f4 0x1f4 0x1f4 0x1f4 0x1f4 0x1f4 0x1f4 0x1f4 0x1f4 0x1f4 0x1f4 0x1f4 0x1f4 0x1f4 0x1f4 0x1f4 0x1f4 0x1f4 0x1f4 0x1f4 0x1f4 0x1f4 0x1f4 0x1f4 0x1f4 0x1f4 0x1f4 0x1f4 0x1f4 0x1f4 0x1f4 0x1f4 0x1f4 0x1f4 0x1f4 0x1f4 0x1f4 0x1f4 0x1f4 0x1f4 0x1f4 0x1f4 0x1f4 0x1f4 0x1f4 0x1f4 0x1f4 0x1f4 0x1f4 0x1f4 0x1f4 0x1f4 0x1f4 0x1f4 0x1f4 0x1f4 0x1f4 0x1f4 0x1f4 0x1f4 0x1f4 0x1f4 0x1f4 0x1f4 0x1f4 0x1f4 0x1f4 0x1f4 0x1f4 0x1f4 0x1f4 0x1f4 0x1f4 0x1f4 0x1f4 0x1f4 0x1f4 0x1f4 0x1f4 0x1f4 0x1f4 0x1f4 0x1f4 0x1f4 0x1f4 0x1f4 0x1f4 0x1f4 0x1f4 0x1f4 0x1f4 0x1f4 0x1f4 0x1f4 0x1f4 0x1f4 0x1f4 0x1f4 0x1f4 0x1f4 0x1f4 0x1f4 0x1f4 0x1f4 0x1f4 0x1f4 0x1f4 0x1f4 0x1f4 0x1f4 0x1f4 0x1f4 0x1f4 0x1f4 0x1f4 0x1f4 0x1f4 0x1f4 0x1f4 0x1f4 0x1f4 0x1f4 0x1f4 0x1f4 0x1f4 0x1f4 0x1f4 0x1f4 0x1f4 0x1f4 0x1f4 0x1f4 0x1f4 0x1f4 0x1f4 0x1f4 0x1f4 0x1f4 0x1f4 0x1f4 0x1f4 0x1f4 0x1f4 0x1f4 0x1f4 0x1f4 0x1f4 0x1f4 0x1f4 0x1f4 0x1f4 0x1f4 0x1f4 0x1f4 0x1f4 0x1f4 0x1f4 0x1f4 0x1f4 0x1f4 0x1f4 0x1f4 0x1f4 0x1f4 0x1f4 0x1f4 0x1f4 0x1f4 0x1f4 0x1f4 0x1f4 0x1f4 0x1f4 0x1f4 0x1f4 0x1f4 0x1f4 0x1f4 0x1f4 0x1f4 0x1f4 0x1f4 0x1f4 0x1f4 0x1f4 0x1f4 0x1f4 0x1f4 0x1f4 0x1f4 0x1f4 0x1f4 0x1f4 0x1f4 0x1f4 0x1f4 0x1f4 0x1f4 0x1f4 0x1f4 0x1f4 0x1f4 0x1f4 0x1f4 0x1f4 0x1f4 0x1f4 0x1f4 0x1f4 0x1f4 0x1f4 0x1f4 0x1f4 0x1f4 0x1f4 0x1f4 0x1f4 0x1f4 0x1f4 0x1f4 0x1f4 0x1f4 0x1f4 0x1f4 0x1f4 0x1f4 0x1f4 0x1f4 0x1f4 0x1f4 0x1f4 0x1f4 0x1f4 0x1f4 0x1f4 0x1f4 0x1f4 0x1f4 0x1f4 0x1f4 0x1f4 0x1f4 0x1f4 0x1f4 0x1f4 0x1f4 0x1f4 0x1f4 0x1f4 0x1f4 0x1f4 0x1f4 0x1f4 0x1f4 0x1f4 0x1f4 0x1f4 0x1f4 0x1f4 0x1f4 0x1f4 0x1f4 0x1f4 0x1f4 0x1f4 0x1f4 0x1f4 0x1f4 0x1f4 0x1f4 0x1f4 0x1f4 0x1f4 0x1f4 0x1f4 0x1f4 0x1f4 0x1f4 0x1f4 0x1f4 0x1f4 0x1f4 0x1f4 0x1f4 0x1f4 0x1f4 0x1f4 0x1f4 0x1f4 0x1f4 0x1f4 0x1f4 0x1f4 0x1f4 0x1f4 0x1f4 0x1f4 0x1f4 0x1f4 0x1f4 0x1f4 0x1f4 0x1f4 0x1f4 0x1f4 0x1f4 0x1f4 0x1f4 0x1f4 0x1f4 0x1f4 0x1f4 0x1f4 0x1f4 0x1f4 0x1f4 0x1f4 0x1f4 0x1f4 0x1f4 0x1f4 0x1f4 0x1f4 0x1f4 0x1f4 0x1f4 0x1f4 0x1f4 0x1f4 0x1f4 0x1f4 0x1f4 0x1f4 0x1f4 0x1f4 0x1f4 0x1f4 0x1f4 0x1f4 0x1f4 0x1f4 0x1f4 0x1f4 0x1f4 0x1f4 0x1f4 0x1f4 0x1f4 0x1f4 0x1f4 0x1f4 0x1f4 0x1f4 0x1f4 0x1f4 0x1f4 0x1f4 0x1f4 0x1f4 0x1f4 0x1f4 0x1f4 0x1f4 0x1f4 0x1f4 0x1f4 0x1f4 0x1f4 0x1f4 0x1f4 0x1f4 0x1f4 0x1f4 0x1f4 0x1f4 0x1f4 0x1f4 0x1f4 0x1f4 0x1f4 0x1f4 0x1f4 0x1f4 0x1f4 0x1f4 0x1f4 0x1f4 0x1f4 0x1f4 0x1f4 0x1f4 0x1f4 0x1f4 0x1f4 0x1f4 0x1f4 0x1f4 0x1f4 0x1f4 0x1f4 0x1f4 0x1f4 0x1f4 0x1f4 0x1f4 0x1f4 0x1f4 0x1f4 0x1f4 0x1f4 0x1f4 0x1f4 0x1f4 0x1f4 0x1f4 0x1f4 0x1f4 0x1f4 0x1f4 0x1f4 0x1f4 0x1f4 0x1f4 0x1f4 0x1f4 0x1f4 0x1f4 0x1f4 0x1f4 0x1f4 0x1f4 0x1f4 0x1f4 0x1f4 0x1f4 0x1f4 0x1f4 0x1f4 0x1f4 0x1f4 0x1f4 0x1f4 0x1f4 0x1f4 0x1f4 0x1f4 0x1f4 0x1f4 0x1f4 0x1f4 0x1f4 0x1f4 0x1f4 0x1f4 0x1f4 0x1f4 0x1f4 0x1f4 0x1f4 0x1f4 0x1f4 0x1f4 0x1f4 0x1f4 0x1f4 0x1f4 0x1f4 0x1f4 0x1f4 0x1f4 0x1f4 0x1f4 0x1f4 0x1f4 0x1f4 0x1f4 0x1f4 0x1f4 0x1f4 0x1f4 0x1f4 0x1f4 0x1f4 0x1f4 0x1f4 0x1f4 0x1f4 0x1f4 0x1f4 0x1f4 0x1f4 0x1f4 0x1f4 0x1f4 0x1f4 0x1f4 0x1f4 0x1f4 0x1f4 0x1f4 0x1f4 0x1f4 0x1f4 0x1f4 0x1f4 0x1f4 0x1f4 0x1f4 0x1f4 0x1f4 0x1f4 0x1f4 0x1f4 0x1f4 0x1f4 0x1f4 0x1f4 0x1f4 0x1f4 0x1f4 0x1f4 0x1f4 0x1f4 0x1f4 0x1f4 0x1f4 0x1f4 0x1f4 0x1f4 0x1f4 0x1f4 0x1f4 0x1f4 0x1f4 0x1f4 0x1f4 0x1f4 0x1f4 0x1f4 0x1f4 0x1f4 0x1f4 0x1f4 0x1f4 0x1f4 0x1f4 0x1f4 0x1f4 0x1f4 0x1f4 0x1f4 0x1f4 0x1f4 0x1f4 0x1f4 0x1f4 0x1f4 0x1f4 0x1f4 0x1f4 0x1f4 0x1f4 0x1f4 0x1f4 0x1f4 0x1f4 0x1f4 0x1f4 0x1f4 0x1f4 0x1f4 0x1f4 0x1f4 0x1f4 0x1f4 0x1f4 0x1f4 0x1f4 0x1f4 0x1f4 0x1f4 0x1f4 0x1f4 0x1f4 0x1f4 0x1f4 0x1f4 0x1f4 0x1f4 0x1f4 0x1f4 0x1f4 0x1f4 0x1f4 0x1f4 0x1f4 0x1f4 0x1f4 0x1f4 0x1f4 0x1f4 0x1f4 0x1f4 0x1f4 0x1f4 0x1f4 0x1f4 0x1f4 0x1f4 0x1f4 0x1f4 0x1f4 0x1f4 0x1f4 0x1f4 0x1f4 0x1f4 0x1f4 0x1f4 0x1f4 0x1f4 0x1f4 0x1f4 0x1f4 0x1f4 0x1f4 0x1f4 0x1f4 0x1f4 0x1f4 0x1f4 0x1f4 0x1f4 0x1f4 0x1f4 0x1f4 0x1f4 0x1f4 0x1f4 0x1f4 0x1f4 0x1f4 0x1f4 0x1f4 0x1f4 0x1f4 0x1f4 0x1f4 0x1f4 0x1f4 0x1f4 0x1f4 0x1f4 0x1f4 0x1f4 0x1f4 0x1f4 0x1f4 0x1f4 0x1f4 0x1f4 0x1f4 0x1f4 0x1f4 0x1f4 0x1f4 0x1f4 0x1f4 0x1f4 0x1f4 0x1f4 0x1f4 0x1f4 0x1f4 0x1f4 0x1f4 0x1f4 0x1f4 0x1f4 0x1f4 0x1f4 0x1f4 0x1f4 0x1f4 0x1f4 0x1f4 0x1f4 0x1f4 0x1f4 0x1f4 0x1f4 0x1f4 0x1f4 0x1f4 0x1f4 0x1f4 0x1f4 0x1f4 0x1f4 0x1f4 0x1f4 0x1f4 0x1f4 0x1f4 0x1f4 0x1f4 0x1f4 0x1f4 0x1f4 0x1f4 0x1f4 0x1f4 0x1f4 0x1f4 0x1f4 0x1f4 0x1f4 0x1f4 0x1f4 0x1f4 0x1f4 0x1f4 0x1f4 0x1f4 0x1f4 0x1f4 0x1f4 0x1f4 0x1f4 0x1f4 0x1f4 0x1f4 0x1f4 0x1f4 0x1f4 0x1f4 0x1f4 0x1f4 0x1f4 0x1f4 0x1f4 0x1f4 0x1f4 0x1f4 0x1f4 0x1f4 0x1f4 0x1f4 0x1f4 0x1f4 0x1f4 0x1f4 0x1f4 0x1f4 0x1f4 0x1f4 0x1f4 0x1f4 0x1f4 0x1f4 0x1f4 0x1f4 0x1f4 0x1f4 0x1f4 0x1f4 0x1f4 0x1f4 0x1f4 0x1f4 0x1f4 0x1f4 0x1f4 0x1f4 0x1f4 0x1f4 0x1f4 0x1f4 0x1f4 0x1f4 0x1f4 0x1f4 0x1f4 0x1f4 0x1f4 0x1f4 0x1f4 0x1f4 0x1f4 0x1f4 0x1f4 0x1f4 0x1f4 0x1f4 0x1f4 0x1f4 0x1f4 0x1f4 0x1f4 0x1f4 0x1f4 0x1f4 0x1f4 0x1f4 0x1f4 0x1f4 0x1f4 0x1f4 0x1f4 0x1f4 0x1f4 0x1f4 0x1f4 0x1f4 0x1f4 0x1f4 0x1f4 0x1f4 0x1f4 0x1f4 0x1f4 0x1f4 0x1f4 0x1f4 0x1f4 0x1f4 0x1f4 0x1f4 0x1f4 0x1f4 0x1f4 0x1f4 0x1f4 0x1f4 0x1f4 0x1f4 0x1f4 0x1f4 0x1f4 0x1f4 0x1f4 0x1f4 0x1f4 0x1f4 0x1f4 0x1f4 0x1f4 0x1f4 0x1f4 0x1f4 0x1f4 0x1f4 0x1f4 0x1f4 0x1f4 0x1f4 0x1f4 0x1f4 0x1f4 0x1f4 0x1f4 0x1f4 0x1f4 0x1f4 0x1f4 0x1f4 0x1f4 0x1f4 0x1f4 0x1f4 0x1f4 0x1f4 0x1f4 0x1f4 0x1f4 0x1f4 0x1f4 0x1f4 0x1f4 0x1f4 0x1f4 0x1f4 0x1f4 0x1f4 0x1f4 0x1f4 0x1f4 0x1f4 0x1f4 0x1f4 0x1f4 0x1f4 0x1f4 0x1f4 0x1f4 0x1f4 0x1f4 0x1f4 0x1f4 0x1f4 0x1f4 0x1f4 0x1f4 0x1f4 0x1f4 0x1f4 0x1f4 0x1f4 0x1f4 0x1f4 0x1f4 0x1f4 0x1f4 0x1f4 0x1f4 0x1f4 0x1f4 0x1f4 0x1f4 0x1f4 0x1f4 0x1f4 0x1f4 0x1f4 0x1f4 0x1f4 0x1f4 0x1f4 0x1f4 0x1f4 0x1f4 0x1f4 0x1f4 0x1f4 0x1f4 0x1f4 0x1f4 0x1f4 0x1f4 0x1f4 0x1f4 0x1f4 0x1f4 0x1f4 0x1f4 0x1f4 0x1f4 0x1f4 0x1f4 0x1f4 0x1f4 0x1f4 0x1f4 0x1f4 0x1f4 0x1f4 0x1f4 0x1f4 0x1f4 0x1f4 0x1f4 0x1f4 0x1f4 0x1f4 0x1f4 0x1f4 0x1f4 0x1f4 0x1f4 0x1f4 0x1f4 0x1f4 0x1f4 0x1f4 0x1f4 0x1f4 0x1f4 0x1f4 0x1f4 0x1f4 0x1f4 0x1f4 0x1f4 0x1f4 0x1f4 0x1f4 0x1f4 0x1f4 0x1f4 0x1f4 0x1f4 0x1f4 0x1f4 0x1f4 0x1f4 0x1f4 0x1f4 0x1f4 0x1f4 0x1f4 0x1f4 0x1f4 0x1f4 0x1f4 0x1f4 0x1f4 0x1f4 0x1f4 0x1f4 0x1f4 0x1f4 0x1f4 0x1f4 0x1f4 0x1f4 0x1f4 0x1f4 0x1f4 0x1f4 0x1f4 0x1f4 0x1f4 0x1f4 0x1f4 0x1f4 0x1f4 0x1f4 0x1f4 0x1f4 0x1f4 0x1f4 0x1f4 0x1f4 0x1f4 0x1f4 0x1f4 0x1f4 0x1f4 0x1f4 0x1f4 0x1f4 0x1f4 0x1f4 0x1f4 0x1f4 0x1f4 0x1f4 0x1f4 0x1f4 0x1f4 0x1f4 0x1f4 0x1f4 0x1f4 0x1f4 0x1f4 0x1f4 0x1f4 0x1f4 0x1f4 0x1f4 0x1f4 0x1f4 0x1f4 0x1f4 0x1f4 0x1f4 0x1f4 0x1f4 0x1f4 0x1f4 0x1f4 0x1f4 0x1f4 0x1f4 0x1f4 0x1f4 0x1f4 0x1f4 0x1f4 0x1f4 0x1f4 0x1f4 0x1f4 0x1f4 0x1f4 0x1f4 0x1f4 0x1f4 0x1f4 0x1f4 0x1f4 0x1f4 0x1f4 0x1f4 0x1f4 0x1f4 0x1f4 0x1f4 0x1f4 0x1f4 0x1f4 0x1f4 0x1f4 0x1f4 0x1f4 0x1f4 0x1f4 0x1f4 0x1f4 0x1f4 0x1f4 0x1f4 0x1f4 0x1f4 0x1f4 0x1f4 0x1f4 0x1f4 0x14 0x1f4 0x1f4 0x1f4 0x1f4 0x1f4 0x1f4 0x1f4 0x14 0x14 0x1f4 0x1f4 0x1f4 0x1f4 0x1f4 0x1f4 0x1f4 0x14 0x1f4 0x1f4 0x1f4 0x1f4 0x1f4 0x1f4 0x1f4 0x1f4 0x1f4 0x1f4 0x1f4 0x1f4 0x1f4 0x1f4 0x1f4 0x1f4 0x1f4 0x1f4 0x1f4 0x1f4 0x1f4 0x1f4 0x1f4 0x1f4 0x1f4 0x1f4 0x1f4 0x1f4 0x1f4 0x1f4 0x1f4 0x1f4 0x1f4 0x1f4 0x1f4 0x1f4 0x1f4 0x1f4 0x1f4 0x1f4 0x1f4 0x1f4 0x1f4 0x1f4 0x1f4 0x1f4 0x1f4 0x1f4 0x1f4 0x1f4 0x1f4 0x1f4 0x1f4 0x1f4 0x1f4 0x1f4 0x1f4 0x1f4 0x1f4 0x1f4 0x1f4 0x1f4 0x1f4 0x1f4 0x1f4 0x1f4 0x1f4 0x1f4 0x1f4 0x1f4 0x1f4 0x1f4 0x1f4 0x1f4 0x1f4 0x1f4 0x1f4 0x1f4 0x1f4 0x1f4 0x1f4 0x1f4 0x1f4 0x1f4 0x1f4 0x1f4 0x1f4 0x1f4 0x1f4 0x1f4 0x1f4 0x1f4 0x1f4 0x1f4 0x1f4 0x1f4 0x1f4 0x1f4 0x1f4 0x1f4 0x1f4 0x1f4 0x1f4 0x1f4 0x1f4 0x1f4 0x1f4 0x1f4 0x1f4 0x1f4 0x1f4 0x1f4 0x1f4 0x1f4 0x1f4 0x1f4 0x1f4 0x1f4 0x1f4 0x1f4 0x1f4 0x1f4 0x1f4 0x1f4 0x1f4 0x1f4 0x1f4 0x1f4 0x1f4 0x1f4 0x1f4 0x1f4 0x1f4 0x1f4 0x1f4 0x1f4 0x1f4 0x1f4 0x1f4 0x1f4 0x1f4 0x1f4 0x1f4 0x1f4 0x1f4 0x1f4 0x1f4 0x1f4 0x1f4 0x1f4 0x1f4 0x1f4 0x1f4 0x1f4 0x1f4 0x1f4 0x1f4 0x1f4 0x1f4 0x1f4 0x1f4 0x1f4 0x1f4 0x1f4 0x1f4 0x1f4 0x1f4 0x1f4 0x1f4 0x1f4 0x1f4 0x1f4 0x1f4 0x1f4 0x1f4 0x1f4 0x1f4 0x1f4 0x1f4 0x1f4 0x1f4 0x1f4 0x1f4 0x1f4 0x1f4 0x1f4 0x1f4 0x1f4 0x1f4 0x1f4 0x1f4 0x1f4 0x1f4 0x1f4 0x1f4 0x1f4 0x1f4 0x1f4 0x1f4 0x1f4 0x1f4 0x1f4 0x1f4 0x1f4 0x1f4 0x1f4 0x1f4 0x1f4 0x1f4 0x1f4 0x1f4 0x1f4 0x1f4 0x1f4 0x1f4 0x1f4 0x1f4 0x1f4 0x1f4 0x1f4 0x1f4 0x1f4 0x1f4 0x1f4 0x1f4 0x1f4 0x1f4 0x1f4 0x1f4 0x1f4 0x1f4 0x1f4 0x1f4 0x1f4 0x1f4 0x1f4 0x1f4 0x1f4 0x1f4 0x1f4 0x1f4 0x1f4 0x1f4 0x1f4 0x1f4 0x1f4 0x1f4 0x1f4>;
				pt11_hi_limits_row_01 = <0x26>;
				pt11_hi_limits_cols_01 = <0x26>;
				pt11_hi_limits_01 = <0x50 0x50 0x50 0x50 0x50 0x50 0x50 0x50 0x50 0x50 0x50 0x50 0x50 0x50 0x50 0x50 0x50 0x50 0x50 0x50 0x50 0x50 0x50 0x50 0x50 0x50 0x50 0x50 0x50 0x50 0x50 0x50 0x50 0x50 0x50 0x50 0x50 0x50 0x50 0x50 0x50 0x50 0x50 0x50 0x50 0x50 0x50 0x50 0x50 0x50 0x50 0x50 0x50 0x50 0x50 0x50 0x50 0x50 0x50 0x50 0x50 0x50 0x50 0x50 0x50 0x50 0x50 0x50 0x50 0x50 0x50 0x50 0x50 0x50 0x50 0x50 0x50 0x50 0x50 0x50 0x50 0x50 0x50 0x50 0x50 0x50 0x50 0x50 0x50 0x50 0x50 0x50 0x50 0x50 0x50 0x50 0x50 0x50 0x50 0x50 0x50 0x50 0x50 0x50 0x50 0x50 0x50 0x50 0x50 0x50 0x50 0x50 0x50 0x50 0x50 0x50 0x50 0x50 0x50 0x50 0x50 0x50 0x50 0x50 0x50 0x50 0x50 0x50 0x50 0x50 0x50 0x50 0x50 0x50 0x50 0x50 0x50 0x50 0x50 0x50 0x50 0x50 0x50 0x50 0x50 0x50 0x50 0x50 0x50 0x50 0x50 0x50 0x50 0x50 0x50 0x50 0x50 0x50 0x50 0x50 0x50 0x50 0x50 0x50 0x50 0x50 0x50 0x50 0x50 0x50 0x50 0x50 0x50 0x50 0x50 0x50 0x50 0x50 0x50 0x50 0x50 0x50 0x50 0x50 0x50 0x50 0x50 0x50 0x50 0x50 0x50 0x50 0x50 0x50 0x50 0x50 0x50 0x50 0x50 0x50 0x50 0x50 0x50 0x50 0x50 0x50 0x50 0x50 0x50 0x50 0x50 0x50 0x50 0x50 0x50 0x50 0x50 0x50 0x50 0x50 0x50 0x50 0x50 0x50 0x50 0x50 0x50 0x50 0x50 0x50 0x50 0x50 0x50 0x50 0x50 0x50 0x50 0x50 0x50 0x50 0x50 0x50 0x50 0x50 0x50 0x50 0x50 0x50 0x50 0x50 0x50 0x50 0x50 0x50 0x50 0x50 0x50 0x50 0x50 0x50 0x50 0x50 0x50 0x50 0x50 0x50 0x50 0x50 0x50 0x50 0x50 0x50 0x50 0x50 0x50 0x50 0x50 0x50 0x50 0x50 0x50 0x50 0x50 0x50 0x50 0x50 0x50 0x50 0x50 0x50 0x50 0x50 0x50 0x50 0x50 0x50 0x50 0x50 0x50 0x50 0x50 0x50 0x50 0x50 0x50 0x50 0x50 0x50 0x50 0x50 0x50 0x50 0x50 0x50 0x50 0x50 0x50 0x50 0x50 0x50 0x50 0x50 0x50 0x50 0x50 0x50 0x50 0x50 0x50 0x50 0x50 0x50 0x50 0x50 0x50 0x50 0x50 0x50 0x50 0x50 0x50 0x50 0x50 0x50 0x50 0x50 0x50 0x50 0x50 0x50 0x50 0x50 0x50 0x50 0x50 0x50 0x50 0x50 0x50 0x50 0x50 0x50 0x50 0x50 0x50 0x50 0x50 0x50 0x50 0x50 0x50 0x50 0x50 0x50 0x50 0x50 0x50 0x50 0x50 0x50 0x50 0x50 0x50 0x50 0x50 0x50 0x50 0x50 0x50 0x50 0x50 0x50 0x50 0x50 0x50 0x50 0x50 0x50 0x50 0x50 0x50 0x50 0x50 0x50 0x50 0x50 0x50 0x50 0x50 0x50 0x50 0x50 0x50 0x50 0x50 0x50 0x50 0x50 0x50 0x50 0x50 0x50 0x50 0x50 0x50 0x50 0x50 0x50 0x50 0x50 0x50 0x50 0x50 0x50 0x50 0x50 0x50 0x50 0x50 0x50 0x50 0x50 0x50 0x50 0x50 0x50 0x50 0x50 0x50 0x50 0x50 0x50 0x50 0x50 0x50 0x50 0x50 0x50 0x50 0x50 0x50 0x50 0x50 0x50 0x50 0x50 0x50 0x50 0x50 0x50 0x50 0x50 0x50 0x50 0x50 0x50 0x50 0x50 0x50 0x50 0x50 0x50 0x50 0x50 0x50 0x50 0x50 0x50 0x50 0x50 0x50 0x50 0x50 0x50 0x50 0x50 0x50 0x50 0x50 0x50 0x50 0x50 0x50 0x50 0x50 0x50 0x50 0x50 0x50 0x50 0x50 0x50 0x50 0x50 0x50 0x50 0x50 0x50 0x50 0x50 0x50 0x50 0x50 0x50 0x50 0x50 0x50 0x50 0x50 0x50 0x50 0x50 0x50 0x50 0x50 0x50 0x50 0x50 0x50 0x50 0x50 0x50 0x50 0x50 0x50 0x50 0x50 0x50 0x50 0x50 0x50 0x50 0x50 0x50 0x50 0x50 0x50 0x50 0x50 0x50 0x50 0x50 0x50 0x50 0x50 0x50 0x50 0x50 0x50 0x50 0x50 0x50 0x50 0x50 0x50 0x50 0x50 0x50 0x50 0x50 0x50 0x50 0x50 0x50 0x50 0x50 0x50 0x50 0x50 0x50 0x50 0x50 0x50 0x50 0x50 0x50 0x50 0x50 0x50 0x50 0x50 0x50 0x50 0x50 0x50 0x50 0x50 0x50 0x50 0x50 0x50 0x50 0x50 0x50 0x50 0x50 0x50 0x50 0x50 0x50 0x50 0x50 0x50 0x50 0x50 0x50 0x50 0x50 0x50 0x50 0x50 0x50 0x50 0x50 0x50 0x50 0x50 0x50 0x50 0x50 0x50 0x50 0x50 0x50 0x50 0x50 0x50 0x50 0x50 0x50 0x50 0x50 0x50 0x50 0x50 0x50 0x50 0x50 0x50 0x50 0x50 0x50 0x50 0x50 0x50 0x50 0x50 0x50 0x50 0x50 0x50 0x50 0x50 0x50 0x50 0x50 0x50 0x50 0x50 0x50 0x50 0x50 0x50 0x50 0x50 0x50 0x50 0x50 0x50 0x50 0x50 0x50 0x50 0x50 0x50 0x50 0x50 0x50 0x50 0x50 0x50 0x50 0x50 0x50 0x50 0x50 0x50 0x50 0x50 0x50 0x50 0x50 0x50 0x50 0x50 0x50 0x50 0x50 0x50 0x50 0x50 0x50 0x50 0x50 0x50 0x50 0x50 0x50 0x50 0x50 0x50 0x50 0x50 0x50 0x50 0x50 0x50 0x50 0x50 0x50 0x50 0x50 0x50 0x50 0x50 0x50 0x50 0x50 0x50 0x50 0x50 0x50 0x50 0x50 0x50 0x50 0x50 0x50 0x50 0x50 0x50 0x50 0x50 0x50 0x50 0x50 0x50 0x50 0x50 0x50 0x50 0x50 0x50 0x50 0x50 0x50 0x50 0x50 0x50 0x50 0x50 0x50 0x50 0x50 0x50 0x50 0x50 0x50 0x50 0x50 0x50 0x50 0x50 0x50 0x50 0x50 0x50 0x50 0x50 0x50 0x50 0x50 0x50 0x50 0x50 0x50 0x50 0x50 0x50 0x50 0x50 0x50 0x50 0x50 0x50 0x50 0x50 0x50 0x50 0x50 0x50 0x50 0x50 0x50 0x50 0x50 0x50 0x50 0x50 0x50 0x50 0x50 0x50 0x50 0x50 0x50 0x50 0x50 0x50 0x50 0x50 0x50 0x50 0x50 0x50 0x50 0x50 0x50 0x50 0x50 0x50 0x50 0x50 0x50 0x50 0x50 0x50 0x50 0x50 0x50 0x50 0x50 0x50 0x50 0x50 0x50 0x50 0x50 0x50 0x50 0x50 0x50 0x50 0x50 0x50 0x50 0x50 0x50 0x50 0x50 0x50 0x50 0x50 0x50 0x50 0x50 0x50 0x50 0x50 0x50 0x50 0x50 0x50 0x50 0x50 0x50 0x50 0x50 0x50 0x50 0x50 0x50 0x50 0x50 0x50 0x50 0x50 0x50 0x50 0x50 0x50 0x50 0x50 0x50 0x50 0x50 0x50 0x50 0x50 0x50 0x50 0x50 0x50 0x50 0x50 0x50 0x50 0x50 0x50 0x50 0x50 0x50 0x50 0x50 0x50 0x50 0x50 0x50 0x50 0x50 0x50 0x50 0x50 0x50 0x50 0x50 0x50 0x50 0x50 0x50 0x50 0x50 0x50 0x50 0x50 0x50 0x50 0x50 0x50 0x50 0x50 0x50 0x50 0x50 0x50 0x50 0x50 0x50 0x50 0x50 0x50 0x50 0x50 0x50 0x50 0x50 0x50 0x50 0x50 0x50 0x50 0x50 0x50 0x50 0x50 0x50 0x50 0x50 0x50 0x50 0x50 0x50 0x50 0x50 0x50 0x50 0x50 0x50 0x50 0x50 0x50 0x50 0x50 0x50 0x50 0x50 0x50 0x50 0x50 0x50 0x50 0x50 0x50 0x50 0x50 0x50 0x50 0x50 0x50 0x50 0x50 0x50 0x50 0x50 0x50 0x50 0x50 0x50 0x50 0x50 0x50 0x50 0x50 0x50 0x50 0x50 0x50 0x50 0x50 0x50 0x50 0x50 0x50 0x50 0x50 0x50 0x50 0x50 0x50 0x50 0x50 0x50 0x50 0x50 0x50 0x50 0x50 0x50 0x50 0x50 0x50 0x50 0x50 0x50 0x50 0x50 0x50 0x50 0x50 0x50 0x50 0x50 0x50 0x50 0x50 0x50 0x50 0x50 0x50 0x50 0x50 0x50 0x50 0x50 0x50 0x50 0x50 0x50 0x50 0x50 0x50 0x50 0x50 0x50 0x50 0x50 0x50 0x50 0x50 0x50 0x50 0x50 0x50 0x50 0x50 0x50 0x50 0x50 0x50 0x50 0x50 0x50 0x50 0x50 0x50 0x50 0x50 0x50 0x50 0x50 0x50 0x50 0x50 0x50 0x50 0x50 0x50 0x50 0x50 0x50 0x50 0x50 0x50 0x50 0x50 0x50 0x50 0x50 0x50 0x50 0x50 0x50 0x50 0x50 0x50 0x50 0x50 0x50 0x50 0x50 0x50 0x50 0x50 0x50 0x50 0x50 0x50 0x50 0x50 0x50 0x50 0x50 0x50 0x50 0x50 0x50 0x50 0x50 0x50 0x50 0x50 0x50 0x50 0x50 0x50 0x50 0x50 0x50 0x50 0x50 0x50 0x50 0x50 0x50 0x50 0x50 0x50 0x50 0x50 0x50 0x50 0x50 0x50 0x50 0x50 0x50 0x50 0x50 0x50 0x50 0x50 0x50 0x50 0x50 0x50 0x50 0x50 0x50 0x50 0x50 0x50 0x50 0x50 0x50 0x50 0x50 0x50 0x50 0x50 0x50 0x50 0x50 0x50 0x50 0x50 0x50 0x50 0x50 0x50 0x50 0x50 0x50 0x50 0x50 0x50 0x50 0x50 0x50 0x50 0x50 0x50 0x50 0x50 0x50 0x50 0x50 0x50 0x50 0x50 0x50 0x50 0x50 0x50 0x50 0x50 0x50 0x50 0x50 0x50 0x50 0x50 0x50 0x50 0x50 0x50 0x50 0x50 0x50 0x50 0x50 0x50 0x50 0x50 0x50 0x50 0x50 0x50 0x50 0x50 0x50 0x50 0x50 0x50 0x50 0x50 0x50 0x50 0x50 0x50 0x50 0x50 0x50 0x50 0x50 0x50 0x50 0x50 0x50 0x50 0x50 0x50 0x50 0x50 0x50 0x50 0x50 0x50 0x50 0x50 0x50 0x50 0x50 0x50 0x50 0x50 0x50 0x50 0x50 0x50 0x50 0x50 0x50 0x50 0x50 0x50 0x50 0x50 0x50 0x50 0x50 0x50 0x50 0x50 0x50 0x50 0x50 0x50 0x50 0x50 0x50 0x50 0x50 0x50 0x50 0x50 0x50 0x50 0x50 0x50 0x50 0x50 0x50 0x50 0x50 0x50 0x50 0x50 0x50 0x50 0x50 0x50 0x50 0x50 0x50 0x50 0x50 0x50 0x50 0x50 0x50 0x50 0x50 0x50 0x50 0x50 0x50 0x50 0x50 0x50 0x50 0x50 0x50 0x50 0x50 0x50 0x50 0x50 0x50 0x50 0x50 0x50 0x50 0x50 0x50 0x50 0x50 0x50 0x50 0x50 0x50 0x50 0x50 0x50 0x50 0x50 0x50 0x50 0x50 0x50 0x50 0x50 0x50 0x50 0x50 0x50 0x50 0x50 0x50 0x50 0x50 0x50 0x50 0x50 0x50 0x50 0x50 0x50 0x50 0x50 0x50 0x50 0x50 0x50 0x50 0x50 0x50 0x50 0x50 0x50 0x50 0x50 0x50 0x50 0x50>;
				pt11_lo_limits_row_01 = <0x26>;
				pt11_lo_limits_cols_01 = <0x26>;
				pt11_lo_limits_01 = <0xffffffb0 0xffffffb0 0xffffffb0 0xffffffb0 0xffffffb0 0xffffffb0 0xffffffb0 0xffffffb0 0xffffffb0 0xffffffb0 0xffffffb0 0xffffffb0 0xffffffb0 0xffffffb0 0xffffffb0 0xffffffb0 0xffffffb0 0xffffffb0 0xffffffb0 0xffffffb0 0xffffffb0 0xffffffb0 0xffffffb0 0xffffffb0 0xffffffb0 0xffffffb0 0xffffffb0 0xffffffb0 0xffffffb0 0xffffffb0 0xffffffb0 0xffffffb0 0xffffffb0 0xffffffb0 0xffffffb0 0xffffffb0 0xffffffb0 0xffffffb0 0xffffffb0 0xffffffb0 0xffffffb0 0xffffffb0 0xffffffb0 0xffffffb0 0xffffffb0 0xffffffb0 0xffffffb0 0xffffffb0 0xffffffb0 0xffffffb0 0xffffffb0 0xffffffb0 0xffffffb0 0xffffffb0 0xffffffb0 0xffffffb0 0xffffffb0 0xffffffb0 0xffffffb0 0xffffffb0 0xffffffb0 0xffffffb0 0xffffffb0 0xffffffb0 0xffffffb0 0xffffffb0 0xffffffb0 0xffffffb0 0xffffffb0 0xffffffb0 0xffffffb0 0xffffffb0 0xffffffb0 0xffffffb0 0xffffffb0 0xffffffb0 0xffffffb0 0xffffffb0 0xffffffb0 0xffffffb0 0xffffffb0 0xffffffb0 0xffffffb0 0xffffffb0 0xffffffb0 0xffffffb0 0xffffffb0 0xffffffb0 0xffffffb0 0xffffffb0 0xffffffb0 0xffffffb0 0xffffffb0 0xffffffb0 0xffffffb0 0xffffffb0 0xffffffb0 0xffffffb0 0xffffffb0 0xffffffb0 0xffffffb0 0xffffffb0 0xffffffb0 0xffffffb0 0xffffffb0 0xffffffb0 0xffffffb0 0xffffffb0 0xffffffb0 0xffffffb0 0xffffffb0 0xffffffb0 0xffffffb0 0xffffffb0 0xffffffb0 0xffffffb0 0xffffffb0 0xffffffb0 0xffffffb0 0xffffffb0 0xffffffb0 0xffffffb0 0xffffffb0 0xffffffb0 0xffffffb0 0xffffffb0 0xffffffb0 0xffffffb0 0xffffffb0 0xffffffb0 0xffffffb0 0xffffffb0 0xffffffb0 0xffffffb0 0xffffffb0 0xffffffb0 0xffffffb0 0xffffffb0 0xffffffb0 0xffffffb0 0xffffffb0 0xffffffb0 0xffffffb0 0xffffffb0 0xffffffb0 0xffffffb0 0xffffffb0 0xffffffb0 0xffffffb0 0xffffffb0 0xffffffb0 0xffffffb0 0xffffffb0 0xffffffb0 0xffffffb0 0xffffffb0 0xffffffb0 0xffffffb0 0xffffffb0 0xffffffb0 0xffffffb0 0xffffffb0 0xffffffb0 0xffffffb0 0xffffffb0 0xffffffb0 0xffffffb0 0xffffffb0 0xffffffb0 0xffffffb0 0xffffffb0 0xffffffb0 0xffffffb0 0xffffffb0 0xffffffb0 0xffffffb0 0xffffffb0 0xffffffb0 0xffffffb0 0xffffffb0 0xffffffb0 0xffffffb0 0xffffffb0 0xffffffb0 0xffffffb0 0xffffffb0 0xffffffb0 0xffffffb0 0xffffffb0 0xffffffb0 0xffffffb0 0xffffffb0 0xffffffb0 0xffffffb0 0xffffffb0 0xffffffb0 0xffffffb0 0xffffffb0 0xffffffb0 0xffffffb0 0xffffffb0 0xffffffb0 0xffffffb0 0xffffffb0 0xffffffb0 0xffffffb0 0xffffffb0 0xffffffb0 0xffffffb0 0xffffffb0 0xffffffb0 0xffffffb0 0xffffffb0 0xffffffb0 0xffffffb0 0xffffffb0 0xffffffb0 0xffffffb0 0xffffffb0 0xffffffb0 0xffffffb0 0xffffffb0 0xffffffb0 0xffffffb0 0xffffffb0 0xffffffb0 0xffffffb0 0xffffffb0 0xffffffb0 0xffffffb0 0xffffffb0 0xffffffb0 0xffffffb0 0xffffffb0 0xffffffb0 0xffffffb0 0xffffffb0 0xffffffb0 0xffffffb0 0xffffffb0 0xffffffb0 0xffffffb0 0xffffffb0 0xffffffb0 0xffffffb0 0xffffffb0 0xffffffb0 0xffffffb0 0xffffffb0 0xffffffb0 0xffffffb0 0xffffffb0 0xffffffb0 0xffffffb0 0xffffffb0 0xffffffb0 0xffffffb0 0xffffffb0 0xffffffb0 0xffffffb0 0xffffffb0 0xffffffb0 0xffffffb0 0xffffffb0 0xffffffb0 0xffffffb0 0xffffffb0 0xffffffb0 0xffffffb0 0xffffffb0 0xffffffb0 0xffffffb0 0xffffffb0 0xffffffb0 0xffffffb0 0xffffffb0 0xffffffb0 0xffffffb0 0xffffffb0 0xffffffb0 0xffffffb0 0xffffffb0 0xffffffb0 0xffffffb0 0xffffffb0 0xffffffb0 0xffffffb0 0xffffffb0 0xffffffb0 0xffffffb0 0xffffffb0 0xffffffb0 0xffffffb0 0xffffffb0 0xffffffb0 0xffffffb0 0xffffffb0 0xffffffb0 0xffffffb0 0xffffffb0 0xffffffb0 0xffffffb0 0xffffffb0 0xffffffb0 0xffffffb0 0xffffffb0 0xffffffb0 0xffffffb0 0xffffffb0 0xffffffb0 0xffffffb0 0xffffffb0 0xffffffb0 0xffffffb0 0xffffffb0 0xffffffb0 0xffffffb0 0xffffffb0 0xffffffb0 0xffffffb0 0xffffffb0 0xffffffb0 0xffffffb0 0xffffffb0 0xffffffb0 0xffffffb0 0xffffffb0 0xffffffb0 0xffffffb0 0xffffffb0 0xffffffb0 0xffffffb0 0xffffffb0 0xffffffb0 0xffffffb0 0xffffffb0 0xffffffb0 0xffffffb0 0xffffffb0 0xffffffb0 0xffffffb0 0xffffffb0 0xffffffb0 0xffffffb0 0xffffffb0 0xffffffb0 0xffffffb0 0xffffffb0 0xffffffb0 0xffffffb0 0xffffffb0 0xffffffb0 0xffffffb0 0xffffffb0 0xffffffb0 0xffffffb0 0xffffffb0 0xffffffb0 0xffffffb0 0xffffffb0 0xffffffb0 0xffffffb0 0xffffffb0 0xffffffb0 0xffffffb0 0xffffffb0 0xffffffb0 0xffffffb0 0xffffffb0 0xffffffb0 0xffffffb0 0xffffffb0 0xffffffb0 0xffffffb0 0xffffffb0 0xffffffb0 0xffffffb0 0xffffffb0 0xffffffb0 0xffffffb0 0xffffffb0 0xffffffb0 0xffffffb0 0xffffffb0 0xffffffb0 0xffffffb0 0xffffffb0 0xffffffb0 0xffffffb0 0xffffffb0 0xffffffb0 0xffffffb0 0xffffffb0 0xffffffb0 0xffffffb0 0xffffffb0 0xffffffb0 0xffffffb0 0xffffffb0 0xffffffb0 0xffffffb0 0xffffffb0 0xffffffb0 0xffffffb0 0xffffffb0 0xffffffb0 0xffffffb0 0xffffffb0 0xffffffb0 0xffffffb0 0xffffffb0 0xffffffb0 0xffffffb0 0xffffffb0 0xffffffb0 0xffffffb0 0xffffffb0 0xffffffb0 0xffffffb0 0xffffffb0 0xffffffb0 0xffffffb0 0xffffffb0 0xffffffb0 0xffffffb0 0xffffffb0 0xffffffb0 0xffffffb0 0xffffffb0 0xffffffb0 0xffffffb0 0xffffffb0 0xffffffb0 0xffffffb0 0xffffffb0 0xffffffb0 0xffffffb0 0xffffffb0 0xffffffb0 0xffffffb0 0xffffffb0 0xffffffb0 0xffffffb0 0xffffffb0 0xffffffb0 0xffffffb0 0xffffffb0 0xffffffb0 0xffffffb0 0xffffffb0 0xffffffb0 0xffffffb0 0xffffffb0 0xffffffb0 0xffffffb0 0xffffffb0 0xffffffb0 0xffffffb0 0xffffffb0 0xffffffb0 0xffffffb0 0xffffffb0 0xffffffb0 0xffffffb0 0xffffffb0 0xffffffb0 0xffffffb0 0xffffffb0 0xffffffb0 0xffffffb0 0xffffffb0 0xffffffb0 0xffffffb0 0xffffffb0 0xffffffb0 0xffffffb0 0xffffffb0 0xffffffb0 0xffffffb0 0xffffffb0 0xffffffb0 0xffffffb0 0xffffffb0 0xffffffb0 0xffffffb0 0xffffffb0 0xffffffb0 0xffffffb0 0xffffffb0 0xffffffb0 0xffffffb0 0xffffffb0 0xffffffb0 0xffffffb0 0xffffffb0 0xffffffb0 0xffffffb0 0xffffffb0 0xffffffb0 0xffffffb0 0xffffffb0 0xffffffb0 0xffffffb0 0xffffffb0 0xffffffb0 0xffffffb0 0xffffffb0 0xffffffb0 0xffffffb0 0xffffffb0 0xffffffb0 0xffffffb0 0xffffffb0 0xffffffb0 0xffffffb0 0xffffffb0 0xffffffb0 0xffffffb0 0xffffffb0 0xffffffb0 0xffffffb0 0xffffffb0 0xffffffb0 0xffffffb0 0xffffffb0 0xffffffb0 0xffffffb0 0xffffffb0 0xffffffb0 0xffffffb0 0xffffffb0 0xffffffb0 0xffffffb0 0xffffffb0 0xffffffb0 0xffffffb0 0xffffffb0 0xffffffb0 0xffffffb0 0xffffffb0 0xffffffb0 0xffffffb0 0xffffffb0 0xffffffb0 0xffffffb0 0xffffffb0 0xffffffb0 0xffffffb0 0xffffffb0 0xffffffb0 0xffffffb0 0xffffffb0 0xffffffb0 0xffffffb0 0xffffffb0 0xffffffb0 0xffffffb0 0xffffffb0 0xffffffb0 0xffffffb0 0xffffffb0 0xffffffb0 0xffffffb0 0xffffffb0 0xffffffb0 0xffffffb0 0xffffffb0 0xffffffb0 0xffffffb0 0xffffffb0 0xffffffb0 0xffffffb0 0xffffffb0 0xffffffb0 0xffffffb0 0xffffffb0 0xffffffb0 0xffffffb0 0xffffffb0 0xffffffb0 0xffffffb0 0xffffffb0 0xffffffb0 0xffffffb0 0xffffffb0 0xffffffb0 0xffffffb0 0xffffffb0 0xffffffb0 0xffffffb0 0xffffffb0 0xffffffb0 0xffffffb0 0xffffffb0 0xffffffb0 0xffffffb0 0xffffffb0 0xffffffb0 0xffffffb0 0xffffffb0 0xffffffb0 0xffffffb0 0xffffffb0 0xffffffb0 0xffffffb0 0xffffffb0 0xffffffb0 0xffffffb0 0xffffffb0 0xffffffb0 0xffffffb0 0xffffffb0 0xffffffb0 0xffffffb0 0xffffffb0 0xffffffb0 0xffffffb0 0xffffffb0 0xffffffb0 0xffffffb0 0xffffffb0 0xffffffb0 0xffffffb0 0xffffffb0 0xffffffb0 0xffffffb0 0xffffffb0 0xffffffb0 0xffffffb0 0xffffffb0 0xffffffb0 0xffffffb0 0xffffffb0 0xffffffb0 0xffffffb0 0xffffffb0 0xffffffb0 0xffffffb0 0xffffffb0 0xffffffb0 0xffffffb0 0xffffffb0 0xffffffb0 0xffffffb0 0xffffffb0 0xffffffb0 0xffffffb0 0xffffffb0 0xffffffb0 0xffffffb0 0xffffffb0 0xffffffb0 0xffffffb0 0xffffffb0 0xffffffb0 0xffffffb0 0xffffffb0 0xffffffb0 0xffffffb0 0xffffffb0 0xffffffb0 0xffffffb0 0xffffffb0 0xffffffb0 0xffffffb0 0xffffffb0 0xffffffb0 0xffffffb0 0xffffffb0 0xffffffb0 0xffffffb0 0xffffffb0 0xffffffb0 0xffffffb0 0xffffffb0 0xffffffb0 0xffffffb0 0xffffffb0 0xffffffb0 0xffffffb0 0xffffffb0 0xffffffb0 0xffffffb0 0xffffffb0 0xffffffb0 0xffffffb0 0xffffffb0 0xffffffb0 0xffffffb0 0xffffffb0 0xffffffb0 0xffffffb0 0xffffffb0 0xffffffb0 0xffffffb0 0xffffffb0 0xffffffb0 0xffffffb0 0xffffffb0 0xffffffb0 0xffffffb0 0xffffffb0 0xffffffb0 0xffffffb0 0xffffffb0 0xffffffb0 0xffffffb0 0xffffffb0 0xffffffb0 0xffffffb0 0xffffffb0 0xffffffb0 0xffffffb0 0xffffffb0 0xffffffb0 0xffffffb0 0xffffffb0 0xffffffb0 0xffffffb0 0xffffffb0 0xffffffb0 0xffffffb0 0xffffffb0 0xffffffb0 0xffffffb0 0xffffffb0 0xffffffb0 0xffffffb0 0xffffffb0 0xffffffb0 0xffffffb0 0xffffffb0 0xffffffb0 0xffffffb0 0xffffffb0 0xffffffb0 0xffffffb0 0xffffffb0 0xffffffb0 0xffffffb0 0xffffffb0 0xffffffb0 0xffffffb0 0xffffffb0 0xffffffb0 0xffffffb0 0xffffffb0 0xffffffb0 0xffffffb0 0xffffffb0 0xffffffb0 0xffffffb0 0xffffffb0 0xffffffb0 0xffffffb0 0xffffffb0 0xffffffb0 0xffffffb0 0xffffffb0 0xffffffb0 0xffffffb0 0xffffffb0 0xffffffb0 0xffffffb0 0xffffffb0 0xffffffb0 0xffffffb0 0xffffffb0 0xffffffb0 0xffffffb0 0xffffffb0 0xffffffb0 0xffffffb0 0xffffffb0 0xffffffb0 0xffffffb0 0xffffffb0 0xffffffb0 0xffffffb0 0xffffffb0 0xffffffb0 0xffffffb0 0xffffffb0 0xffffffb0 0xffffffb0 0xffffffb0 0xffffffb0 0xffffffb0 0xffffffb0 0xffffffb0 0xffffffb0 0xffffffb0 0xffffffb0 0xffffffb0 0xffffffb0 0xffffffb0 0xffffffb0 0xffffffb0 0xffffffb0 0xffffffb0 0xffffffb0 0xffffffb0 0xffffffb0 0xffffffb0 0xffffffb0 0xffffffb0 0xffffffb0 0xffffffb0 0xffffffb0 0xffffffb0 0xffffffb0 0xffffffb0 0xffffffb0 0xffffffb0 0xffffffb0 0xffffffb0 0xffffffb0 0xffffffb0 0xffffffb0 0xffffffb0 0xffffffb0 0xffffffb0 0xffffffb0 0xffffffb0 0xffffffb0 0xffffffb0 0xffffffb0 0xffffffb0 0xffffffb0 0xffffffb0 0xffffffb0 0xffffffb0 0xffffffb0 0xffffffb0 0xffffffb0 0xffffffb0 0xffffffb0 0xffffffb0 0xffffffb0 0xffffffb0 0xffffffb0 0xffffffb0 0xffffffb0 0xffffffb0 0xffffffb0 0xffffffb0 0xffffffb0 0xffffffb0 0xffffffb0 0xffffffb0 0xffffffb0 0xffffffb0 0xffffffb0 0xffffffb0 0xffffffb0 0xffffffb0 0xffffffb0 0xffffffb0 0xffffffb0 0xffffffb0 0xffffffb0 0xffffffb0 0xffffffb0 0xffffffb0 0xffffffb0 0xffffffb0 0xffffffb0 0xffffffb0 0xffffffb0 0xffffffb0 0xffffffb0 0xffffffb0 0xffffffb0 0xffffffb0 0xffffffb0 0xffffffb0 0xffffffb0 0xffffffb0 0xffffffb0 0xffffffb0 0xffffffb0 0xffffffb0 0xffffffb0 0xffffffb0 0xffffffb0 0xffffffb0 0xffffffb0 0xffffffb0 0xffffffb0 0xffffffb0 0xffffffb0 0xffffffb0 0xffffffb0 0xffffffb0 0xffffffb0 0xffffffb0 0xffffffb0 0xffffffb0 0xffffffb0 0xffffffb0 0xffffffb0 0xffffffb0 0xffffffb0 0xffffffb0 0xffffffb0 0xffffffb0 0xffffffb0 0xffffffb0 0xffffffb0 0xffffffb0 0xffffffb0 0xffffffb0 0xffffffb0 0xffffffb0 0xffffffb0 0xffffffb0 0xffffffb0 0xffffffb0 0xffffffb0 0xffffffb0 0xffffffb0 0xffffffb0 0xffffffb0 0xffffffb0 0xffffffb0 0xffffffb0 0xffffffb0 0xffffffb0 0xffffffb0 0xffffffb0 0xffffffb0 0xffffffb0 0xffffffb0 0xffffffb0 0xffffffb0 0xffffffb0 0xffffffb0 0xffffffb0 0xffffffb0 0xffffffb0 0xffffffb0 0xffffffb0 0xffffffb0 0xffffffb0 0xffffffb0 0xffffffb0 0xffffffb0 0xffffffb0 0xffffffb0 0xffffffb0 0xffffffb0 0xffffffb0 0xffffffb0 0xffffffb0 0xffffffb0 0xffffffb0 0xffffffb0 0xffffffb0 0xffffffb0 0xffffffb0 0xffffffb0 0xffffffb0 0xffffffb0 0xffffffb0 0xffffffb0 0xffffffb0 0xffffffb0 0xffffffb0 0xffffffb0 0xffffffb0 0xffffffb0 0xffffffb0 0xffffffb0 0xffffffb0 0xffffffb0 0xffffffb0 0xffffffb0 0xffffffb0 0xffffffb0 0xffffffb0 0xffffffb0 0xffffffb0 0xffffffb0 0xffffffb0 0xffffffb0 0xffffffb0 0xffffffb0 0xffffffb0 0xffffffb0 0xffffffb0 0xffffffb0 0xffffffb0 0xffffffb0 0xffffffb0 0xffffffb0 0xffffffb0 0xffffffb0 0xffffffb0 0xffffffb0 0xffffffb0 0xffffffb0 0xffffffb0 0xffffffb0 0xffffffb0 0xffffffb0 0xffffffb0 0xffffffb0 0xffffffb0 0xffffffb0 0xffffffb0 0xffffffb0 0xffffffb0 0xffffffb0 0xffffffb0 0xffffffb0 0xffffffb0 0xffffffb0 0xffffffb0 0xffffffb0 0xffffffb0 0xffffffb0 0xffffffb0 0xffffffb0 0xffffffb0 0xffffffb0 0xffffffb0 0xffffffb0 0xffffffb0 0xffffffb0 0xffffffb0 0xffffffb0 0xffffffb0 0xffffffb0 0xffffffb0 0xffffffb0 0xffffffb0 0xffffffb0 0xffffffb0 0xffffffb0 0xffffffb0 0xffffffb0 0xffffffb0 0xffffffb0 0xffffffb0 0xffffffb0 0xffffffb0 0xffffffb0 0xffffffb0 0xffffffb0 0xffffffb0 0xffffffb0 0xffffffb0 0xffffffb0 0xffffffb0 0xffffffb0 0xffffffb0 0xffffffb0 0xffffffb0 0xffffffb0 0xffffffb0 0xffffffb0 0xffffffb0 0xffffffb0 0xffffffb0 0xffffffb0 0xffffffb0 0xffffffb0 0xffffffb0 0xffffffb0 0xffffffb0 0xffffffb0 0xffffffb0 0xffffffb0 0xffffffb0 0xffffffb0 0xffffffb0 0xffffffb0 0xffffffb0 0xffffffb0 0xffffffb0 0xffffffb0 0xffffffb0 0xffffffb0 0xffffffb0 0xffffffb0 0xffffffb0 0xffffffb0 0xffffffb0 0xffffffb0 0xffffffb0 0xffffffb0 0xffffffb0 0xffffffb0 0xffffffb0 0xffffffb0 0xffffffb0 0xffffffb0 0xffffffb0 0xffffffb0 0xffffffb0 0xffffffb0 0xffffffb0 0xffffffb0 0xffffffb0 0xffffffb0 0xffffffb0 0xffffffb0 0xffffffb0 0xffffffb0 0xffffffb0 0xffffffb0 0xffffffb0 0xffffffb0 0xffffffb0 0xffffffb0 0xffffffb0 0xffffffb0 0xffffffb0 0xffffffb0 0xffffffb0 0xffffffb0 0xffffffb0 0xffffffb0 0xffffffb0 0xffffffb0 0xffffffb0 0xffffffb0 0xffffffb0 0xffffffb0 0xffffffb0 0xffffffb0 0xffffffb0 0xffffffb0 0xffffffb0 0xffffffb0 0xffffffb0 0xffffffb0 0xffffffb0 0xffffffb0 0xffffffb0 0xffffffb0 0xffffffb0 0xffffffb0 0xffffffb0 0xffffffb0 0xffffffb0 0xffffffb0 0xffffffb0 0xffffffb0 0xffffffb0 0xffffffb0 0xffffffb0 0xffffffb0 0xffffffb0 0xffffffb0 0xffffffb0 0xffffffb0 0xffffffb0 0xffffffb0 0xffffffb0 0xffffffb0 0xffffffb0 0xffffffb0 0xffffffb0 0xffffffb0 0xffffffb0 0xffffffb0 0xffffffb0 0xffffffb0 0xffffffb0 0xffffffb0 0xffffffb0 0xffffffb0 0xffffffb0 0xffffffb0 0xffffffb0 0xffffffb0 0xffffffb0 0xffffffb0 0xffffffb0 0xffffffb0 0xffffffb0 0xffffffb0 0xffffffb0 0xffffffb0 0xffffffb0 0xffffffb0 0xffffffb0 0xffffffb0 0xffffffb0 0xffffffb0 0xffffffb0 0xffffffb0 0xffffffb0 0xffffffb0 0xffffffb0 0xffffffb0 0xffffffb0 0xffffffb0 0xffffffb0 0xffffffb0 0xffffffb0 0xffffffb0 0xffffffb0 0xffffffb0 0xffffffb0 0xffffffb0 0xffffffb0 0xffffffb0 0xffffffb0 0xffffffb0 0xffffffb0 0xffffffb0 0xffffffb0 0xffffffb0 0xffffffb0 0xffffffb0 0xffffffb0 0xffffffb0 0xffffffb0 0xffffffb0 0xffffffb0 0xffffffb0 0xffffffb0 0xffffffb0 0xffffffb0 0xffffffb0 0xffffffb0 0xffffffb0 0xffffffb0 0xffffffb0 0xffffffb0 0xffffffb0 0xffffffb0 0xffffffb0 0xffffffb0 0xffffffb0 0xffffffb0 0xffffffb0 0xffffffb0 0xffffffb0 0xffffffb0 0xffffffb0 0xffffffb0 0xffffffb0 0xffffffb0 0xffffffb0 0xffffffb0 0xffffffb0 0xffffffb0 0xffffffb0 0xffffffb0 0xffffffb0 0xffffffb0 0xffffffb0 0xffffffb0 0xffffffb0 0xffffffb0 0xffffffb0 0xffffffb0 0xffffffb0 0xffffffb0 0xffffffb0 0xffffffb0 0xffffffb0 0xffffffb0 0xffffffb0 0xffffffb0 0xffffffb0 0xffffffb0 0xffffffb0 0xffffffb0 0xffffffb0 0xffffffb0 0xffffffb0 0xffffffb0 0xffffffb0 0xffffffb0 0xffffffb0 0xffffffb0 0xffffffb0 0xffffffb0 0xffffffb0 0xffffffb0 0xffffffb0 0xffffffb0 0xffffffb0 0xffffffb0 0xffffffb0 0xffffffb0 0xffffffb0 0xffffffb0 0xffffffb0 0xffffffb0 0xffffffb0 0xffffffb0 0xffffffb0 0xffffffb0 0xffffffb0 0xffffffb0 0xffffffb0 0xffffffb0 0xffffffb0 0xffffffb0 0xffffffb0 0xffffffb0 0xffffffb0 0xffffffb0 0xffffffb0 0xffffffb0 0xffffffb0 0xffffffb0 0xffffffb0 0xffffffb0 0xffffffb0 0xffffffb0 0xffffffb0 0xffffffb0 0xffffffb0 0xffffffb0 0xffffffb0 0xffffffb0 0xffffffb0 0xffffffb0 0xffffffb0 0xffffffb0 0xffffffb0 0xffffffb0 0xffffffb0 0xffffffb0 0xffffffb0 0xffffffb0 0xffffffb0 0xffffffb0 0xffffffb0 0xffffffb0 0xffffffb0 0xffffffb0 0xffffffb0 0xffffffb0 0xffffffb0 0xffffffb0 0xffffffb0 0xffffffb0 0xffffffb0 0xffffffb0 0xffffffb0 0xffffffb0 0xffffffb0 0xffffffb0 0xffffffb0 0xffffffb0 0xffffffb0 0xffffffb0 0xffffffb0 0xffffffb0 0xffffffb0 0xffffffb0 0xffffffb0 0xffffffb0 0xffffffb0 0xffffffb0 0xffffffb0 0xffffffb0 0xffffffb0 0xffffffb0 0xffffffb0 0xffffffb0 0xffffffb0 0xffffffb0 0xffffffb0 0xffffffb0 0xffffffb0 0xffffffb0 0xffffffb0 0xffffffb0 0xffffffb0 0xffffffb0 0xffffffb0 0xffffffb0 0xffffffb0 0xffffffb0 0xffffffb0 0xffffffb0 0xffffffb0 0xffffffb0 0xffffffb0 0xffffffb0 0xffffffb0 0xffffffb0 0xffffffb0 0xffffffb0 0xffffffb0 0xffffffb0 0xffffffb0 0xffffffb0 0xffffffb0 0xffffffb0 0xffffffb0 0xffffffb0 0xffffffb0 0xffffffb0 0xffffffb0 0xffffffb0 0xffffffb0 0xffffffb0 0xffffffb0 0xffffffb0 0xffffffb0 0xffffffb0 0xffffffb0 0xffffffb0 0xffffffb0 0xffffffb0 0xffffffb0 0xffffffb0 0xffffffb0 0xffffffb0 0xffffffb0 0xffffffb0 0xffffffb0 0xffffffb0 0xffffffb0 0xffffffb0 0xffffffb0 0xffffffb0 0xffffffb0 0xffffffb0 0xffffffb0 0xffffffb0 0xffffffb0 0xffffffb0 0xffffffb0 0xffffffb0 0xffffffb0 0xffffffb0 0xffffffb0 0xffffffb0 0xffffffb0 0xffffffb0 0xffffffb0 0xffffffb0 0xffffffb0 0xffffffb0>;
				pt7_hi_limits_row_02 = <0x26>;
				pt7_hi_limits_cols_02 = <0x26>;
				pt7_hi_limits_02 = <0x514 0x514 0x514 0x514 0x514 0x514 0x514 0x514 0x514 0x514 0x514 0x514 0x514 0x514 0x514 0x514 0x514 0x514 0x514 0x514 0x514 0x514 0x514 0x514 0x514 0x514 0x514 0x514 0x514 0x514 0x514 0x514 0x514 0x514 0x514 0x514 0x514 0x514 0x514 0x514 0x514 0x514 0x514 0x514 0x514 0x514 0x514 0x514 0x514 0x514 0x514 0x514 0x514 0x514 0x514 0x514 0x514 0x514 0x514 0x514 0x514 0x514 0x514 0x514 0x514 0x514 0x514 0x514 0x514 0x514 0x514 0x514 0x514 0x514 0x514 0x514 0x514 0x514 0x514 0x514 0x514 0x514 0x514 0x514 0x514 0x514 0x514 0x514 0x514 0x514 0x514 0x514 0x514 0x514 0x514 0x514 0x514 0x514 0x514 0x514 0x514 0x514 0x514 0x514 0x514 0x514 0x514 0x514 0x514 0x514 0x514 0x514 0x514 0x514 0x514 0x514 0x514 0x514 0x514 0x514 0x514 0x514 0x514 0x514 0x514 0x514 0x514 0x514 0x514 0x514 0x514 0x514 0x514 0x514 0x514 0x514 0x514 0x514 0x514 0x514 0x514 0x514 0x514 0x514 0x514 0x514 0x514 0x514 0x514 0x514 0x514 0x514 0x514 0x514 0x514 0x514 0x514 0x514 0x514 0x514 0x514 0x514 0x514 0x514 0x514 0x514 0x514 0x514 0x514 0x514 0x514 0x514 0x514 0x514 0x514 0x514 0x514 0x514 0x514 0x514 0x514 0x514 0x514 0x514 0x514 0x514 0x514 0x514 0x514 0x514 0x514 0x514 0x514 0x514 0x514 0x514 0x514 0x514 0x514 0x514 0x514 0x514 0x514 0x514 0x514 0x514 0x514 0x514 0x514 0x514 0x514 0x514 0x514 0x514 0x514 0x514 0x514 0x514 0x514 0x514 0x514 0x514 0x514 0x514 0x514 0x514 0x514 0x514 0x514 0x514 0x514 0x514 0x514 0x514 0x514 0x514 0x514 0x514 0x514 0x514 0x514 0x514 0x514 0x514 0x514 0x514 0x514 0x514 0x514 0x514 0x514 0x514 0x514 0x514 0x514 0x514 0x514 0x514 0x514 0x514 0x514 0x514 0x514 0x514 0x514 0x514 0x514 0x514 0x514 0x514 0x514 0x514 0x514 0x514 0x514 0x514 0x514 0x514 0x514 0x514 0x514 0x514 0x514 0x514 0x514 0x514 0x514 0x514 0x514 0x514 0x514 0x514 0x514 0x514 0x514 0x514 0x514 0x514 0x514 0x514 0x514 0x514 0x514 0x514 0x514 0x514 0x514 0x514 0x514 0x514 0x514 0x514 0x514 0x514 0x514 0x514 0x514 0x514 0x514 0x514 0x514 0x514 0x514 0x514 0x514 0x514 0x514 0x514 0x514 0x514 0x514 0x514 0x514 0x514 0x514 0x514 0x514 0x514 0x514 0x514 0x514 0x514 0x514 0x514 0x514 0x514 0x514 0x514 0x514 0x514 0x514 0x514 0x514 0x514 0x514 0x514 0x514 0x514 0x514 0x514 0x514 0x514 0x514 0x514 0x514 0x514 0x514 0x514 0x514 0x514 0x514 0x514 0x514 0x514 0x514 0x514 0x514 0x514 0x514 0x514 0x514 0x514 0x514 0x514 0x514 0x514 0x514 0x514 0x514 0x514 0x514 0x514 0x514 0x514 0x514 0x514 0x514 0x514 0x514 0x514 0x514 0x514 0x514 0x514 0x514 0x514 0x514 0x514 0x514 0x514 0x514 0x514 0x514 0x514 0x514 0x514 0x514 0x514 0x514 0x514 0x514 0x514 0x514 0x514 0x514 0x514 0x514 0x514 0x514 0x514 0x514 0x514 0x514 0x514 0x514 0x514 0x514 0x514 0x514 0x514 0x514 0x514 0x514 0x514 0x514 0x514 0x514 0x514 0x514 0x514 0x514 0x514 0x514 0x514 0x514 0x514 0x514 0x514 0x514 0x514 0x514 0x514 0x514 0x514 0x514 0x514 0x514 0x514 0x514 0x514 0x514 0x514 0x514 0x514 0x514 0x514 0x514 0x514 0x514 0x514 0x514 0x514 0x514 0x514 0x514 0x514 0x514 0x514 0x514 0x514 0x514 0x514 0x514 0x514 0x514 0x514 0x514 0x514 0x514 0x514 0x514 0x514 0x514 0x514 0x514 0x514 0x514 0x514 0x514 0x514 0x514 0x514 0x514 0x514 0x514 0x514 0x514 0x514 0x514 0x514 0x514 0x514 0x514 0x514 0x514 0x514 0x514 0x514 0x514 0x514 0x514 0x514 0x514 0x514 0x514 0x514 0x514 0x514 0x514 0x514 0x514 0x514 0x514 0x514 0x514 0x514 0x514 0x514 0x514 0x514 0x514 0x514 0x514 0x514 0x514 0x514 0x514 0x514 0x514 0x514 0x514 0x514 0x514 0x514 0x514 0x514 0x514 0x514 0x514 0x514 0x514 0x514 0x514 0x514 0x514 0x514 0x514 0x514 0x514 0x514 0x514 0x514 0x514 0x514 0x514 0x514 0x514 0x514 0x514 0x514 0x514 0x514 0x514 0x514 0x514 0x514 0x514 0x514 0x514 0x514 0x514 0x514 0x514 0x514 0x514 0x514 0x514 0x514 0x514 0x514 0x514 0x514 0x514 0x514 0x514 0x514 0x514 0x514 0x514 0x514 0x514 0x514 0x514 0x514 0x514 0x514 0x514 0x514 0x514 0x514 0x514 0x514 0x514 0x514 0x514 0x514 0x514 0x514 0x514 0x514 0x514 0x514 0x514 0x514 0x514 0x514 0x514 0x514 0x514 0x514 0x514 0x514 0x514 0x514 0x514 0x514 0x514 0x514 0x514 0x514 0x514 0x514 0x514 0x514 0x514 0x514 0x514 0x514 0x514 0x514 0x514 0x514 0x514 0x514 0x514 0x514 0x514 0x514 0x514 0x514 0x514 0x514 0x514 0x514 0x514 0x514 0x514 0x514 0x514 0x514 0x514 0x514 0x514 0x514 0x514 0x514 0x514 0x514 0x514 0x514 0x514 0x514 0x514 0x514 0x514 0x514 0x514 0x514 0x514 0x514 0x514 0x514 0x514 0x514 0x514 0x514 0x514 0x514 0x514 0x514 0x514 0x514 0x514 0x514 0x514 0x514 0x514 0x514 0x514 0x514 0x514 0x514 0x514 0x514 0x514 0x514 0x514 0x514 0x514 0x514 0x514 0x514 0x514 0x514 0x514 0x514 0x514 0x514 0x514 0x514 0x514 0x514 0x514 0x514 0x514 0x514 0x514 0x514 0x514 0x514 0x514 0x514 0x514 0x514 0x514 0x514 0x514 0x514 0x514 0x514 0x514 0x514 0x514 0x514 0x514 0x514 0x514 0x514 0x514 0x514 0x514 0x514 0x514 0x514 0x514 0x514 0x514 0x514 0x514 0x514 0x514 0x514 0x514 0x514 0x514 0x514 0x514 0x514 0x514 0x514 0x514 0x514 0x514 0x514 0x514 0x514 0x514 0x514 0x514 0x514 0x514 0x514 0x514 0x514 0x514 0x514 0x514 0x514 0x514 0x514 0x514 0x514 0x514 0x514 0x514 0x514 0x514 0x514 0x514 0x514 0x514 0x514 0x514 0x514 0x514 0x514 0x514 0x514 0x514 0x514 0x514 0x514 0x514 0x514 0x514 0x514 0x514 0x514 0x514 0x514 0x514 0x514 0x514 0x514 0x514 0x514 0x514 0x514 0x514 0x514 0x514 0x514 0x514 0x514 0x514 0x514 0x514 0x514 0x514 0x514 0x514 0x514 0x514 0x514 0x514 0x514 0x514 0x514 0x514 0x514 0x514 0x514 0x514 0x514 0x514 0x514 0x514 0x514 0x514 0x514 0x514 0x514 0x514 0x514 0x514 0x514 0x514 0x514 0x514 0x514 0x514 0x514 0x514 0x514 0x514 0x514 0x514 0x514 0x514 0x514 0x514 0x514 0x514 0x514 0x514 0x514 0x514 0x514 0x514 0x514 0x514 0x514 0x514 0x514 0x514 0x514 0x514 0x514 0x514 0x514 0x514 0x514 0x514 0x514 0x514 0x514 0x514 0x514 0x514 0x514 0x514 0x514 0x514 0x514 0x514 0x514 0x514 0x514 0x514 0x514 0x514 0x514 0x514 0x514 0x514 0x514 0x514 0x514 0x514 0x514 0x514 0x514 0x514 0x514 0x514 0x514 0x514 0x514 0x514 0x514 0x514 0x514 0x514 0x514 0x514 0x514 0x514 0x514 0x514 0x514 0x514 0x514 0x514 0x514 0x514 0x514 0x514 0x514 0x514 0x514 0x514 0x514 0x514 0x514 0x514 0x514 0x514 0x514 0x514 0x514 0x514 0x514 0x514 0x514 0x514 0x514 0x514 0x514 0x514 0x514 0x514 0x514 0x514 0x514 0x514 0x514 0x514 0x514 0x514 0x514 0x514 0x514 0x514 0x514 0x514 0x514 0x514 0x514 0x514 0x514 0x514 0x514 0x514 0x514 0x514 0x514 0x514 0x514 0x514 0x514 0x514 0x514 0x514 0x514 0x514 0x514 0x514 0x514 0x514 0x514 0x514 0x514 0x514 0x514 0x514 0x514 0x514 0x514 0x514 0x514 0x514 0x514 0x514 0x514 0x514 0x514 0x514 0x514 0x514 0x514 0x514 0x514 0x514 0x514 0x514 0x514 0x514 0x514 0x514 0x514 0x514 0x514 0x514 0x514 0x514 0x514 0x514 0x514 0x514 0x514 0x514 0x514 0x514 0x514 0x514 0x514 0x514 0x514 0x514 0x514 0x514 0x514 0x514 0x514 0x514 0x514 0x514 0x514 0x514 0x514 0x514 0x514 0x514 0x514 0x514 0x514 0x514 0x514 0x514 0x514 0x514 0x514 0x514 0x514 0x514 0x514 0x514 0x514 0x514 0x514 0x514 0x514 0x514 0x514 0x514 0x514 0x514 0x514 0x514 0x514 0x514 0x514 0x514 0x514 0x514 0x514 0x514 0x514 0x514 0x514 0x514 0x514 0x514 0x514 0x514 0x514 0x514 0x514 0x514 0x514 0x514 0x514 0x514 0x514 0x514 0x514 0x514 0x514 0x514 0x514 0x514 0x514 0x514 0x514 0x514 0x514 0x514 0x514 0x514 0x514 0x514 0x514 0x514 0x514 0x514 0x514 0x514 0x514 0x514 0x514 0x514 0x514 0x514 0x514 0x514 0x514 0x514 0x514 0x514 0x514 0x514 0x514 0x514 0x514 0x514 0x514 0x514 0x514 0x514 0x514 0x514 0x514 0x514 0x514 0x514 0x514 0x514 0x514 0x514 0x514 0x514 0x514 0x514 0x514 0x514 0x514 0x514 0x514 0x514 0x514 0x514 0x514 0x514 0x514 0x514 0x514 0x514 0x514 0x514 0x514 0x514 0x514 0x514 0x514 0x514 0x514 0x514 0x514 0x514 0x514 0x514 0x514 0x514 0x514 0x514 0x514 0x514 0x514 0x514 0x514 0x514 0x514 0x514 0x514 0x514 0x514 0x514 0x514 0x514 0x514 0x514 0x514 0x514 0x514 0x514 0x514 0x514 0x514 0x514 0x514 0x514 0x514 0x514 0x514 0x514 0x514 0x514 0x514 0x514 0x514 0x514 0x514 0x514 0x514 0x514 0x514 0x514 0x514 0x514 0x514 0x514 0x514 0x514 0x514 0x514 0x514 0x514 0x514 0x514 0x514 0x514 0x514 0x514 0x514 0x514 0x514 0x514 0x514 0x514 0x514 0x514 0x514 0x514 0x514 0x514 0x514 0x514 0x514 0x514 0x514 0x514 0x514 0x514 0x514 0x514 0x514 0x514 0x514 0x514 0x514 0x514 0x514 0x514 0x514 0x514 0x514 0x514 0x514 0x514 0x514 0x514 0x514 0x514 0x514 0x514 0x514 0x514 0x514 0x514 0x514 0x514 0x514 0x514 0x514 0x514 0x514 0x514 0x514 0x514 0x514 0x514 0x514 0x514 0x514 0x514 0x514 0x514 0x514 0x514 0x514 0x514 0x514 0x514 0x514 0x514 0x514 0x514 0x514 0x514 0x514 0x514 0x514 0x514 0x514 0x514 0x514 0x514 0x514 0x514 0x514 0x514 0x514 0x514 0x514 0x514 0x514 0x514 0x514 0x514 0x514 0x514 0x514 0x514 0x514 0x514 0x514 0x514 0x514 0x514 0x514 0x514 0x514 0x514 0x514 0x514 0x514 0x514 0x514 0x514 0x514 0x514 0x514 0x514 0x514 0x514 0x514 0x514 0x514 0x514 0x514 0x514 0x514 0x514 0x514>;
				pt7_lo_limits_row_02 = <0x26>;
				pt7_lo_limits_cols_02 = <0x26>;
				pt7_lo_limits_02 = <0x226 0x226 0x226 0x226 0x226 0x226 0x226 0x226 0x226 0x226 0x226 0x226 0x226 0x226 0x226 0x226 0x226 0x226 0x226 0x226 0x226 0x226 0x226 0x226 0x226 0x226 0x226 0x226 0x226 0x226 0x226 0x226 0x226 0x226 0x226 0x226 0x226 0x226 0x226 0x226 0x226 0x226 0x226 0x226 0x226 0x226 0x226 0x226 0x226 0x226 0x226 0x226 0x226 0x226 0x226 0x226 0x226 0x226 0x226 0x226 0x226 0x226 0x226 0x226 0x226 0x226 0x226 0x226 0x226 0x226 0x226 0x226 0x226 0x226 0x226 0x226 0x226 0x226 0x226 0x226 0x226 0x226 0x226 0x226 0x226 0x226 0x226 0x226 0x226 0x226 0x226 0x226 0x226 0x226 0x226 0x226 0x226 0x226 0x226 0x226 0x226 0x226 0x226 0x226 0x226 0x226 0x226 0x226 0x226 0x226 0x226 0x226 0x226 0x226 0x226 0x226 0x226 0x226 0x226 0x226 0x226 0x226 0x226 0x226 0x226 0x226 0x226 0x226 0x226 0x226 0x226 0x226 0x226 0x226 0x226 0x226 0x226 0x226 0x226 0x226 0x226 0x226 0x226 0x226 0x226 0x226 0x226 0x226 0x226 0x226 0x226 0x226 0x226 0x226 0x226 0x226 0x226 0x226 0x226 0x226 0x226 0x226 0x226 0x226 0x226 0x226 0x226 0x226 0x226 0x226 0x226 0x226 0x226 0x226 0x226 0x226 0x226 0x226 0x226 0x226 0x226 0x226 0x226 0x226 0x226 0x226 0x226 0x226 0x226 0x226 0x226 0x226 0x226 0x226 0x226 0x226 0x226 0x226 0x226 0x226 0x226 0x226 0x226 0x226 0x226 0x226 0x226 0x226 0x226 0x226 0x226 0x226 0x226 0x226 0x226 0x226 0x226 0x226 0x226 0x226 0x226 0x226 0x226 0x226 0x226 0x226 0x226 0x226 0x226 0x226 0x226 0x226 0x226 0x226 0x226 0x226 0x226 0x226 0x226 0x226 0x226 0x226 0x226 0x226 0x226 0x226 0x226 0x226 0x226 0x226 0x226 0x226 0x226 0x226 0x226 0x226 0x226 0x226 0x226 0x226 0x226 0x226 0x226 0x226 0x226 0x226 0x226 0x226 0x226 0x226 0x226 0x226 0x226 0x226 0x226 0x226 0x226 0x226 0x226 0x226 0x226 0x226 0x226 0x226 0x226 0x226 0x226 0x226 0x226 0x226 0x226 0x226 0x226 0x226 0x226 0x226 0x226 0x226 0x226 0x226 0x226 0x226 0x226 0x226 0x226 0x226 0x226 0x226 0x226 0x226 0x226 0x226 0x226 0x226 0x226 0x226 0x226 0x226 0x226 0x226 0x226 0x226 0x226 0x226 0x226 0x226 0x226 0x226 0x226 0x226 0x226 0x226 0x226 0x226 0x226 0x226 0x226 0x226 0x226 0x226 0x226 0x226 0x226 0x226 0x226 0x226 0x226 0x226 0x226 0x226 0x226 0x226 0x226 0x226 0x226 0x226 0x226 0x226 0x226 0x226 0x226 0x226 0x226 0x226 0x226 0x226 0x226 0x226 0x226 0x226 0x226 0x226 0x226 0x226 0x226 0x226 0x226 0x226 0x226 0x226 0x226 0x226 0x226 0x226 0x226 0x226 0x226 0x226 0x226 0x226 0x226 0x226 0x226 0x226 0x226 0x226 0x226 0x226 0x226 0x226 0x226 0x226 0x226 0x226 0x226 0x226 0x226 0x226 0x226 0x226 0x226 0x226 0x226 0x226 0x226 0x226 0x226 0x226 0x226 0x226 0x226 0x226 0x226 0x226 0x226 0x226 0x226 0x226 0x226 0x226 0x226 0x226 0x226 0x226 0x226 0x226 0x226 0x226 0x226 0x226 0x226 0x226 0x226 0x226 0x226 0x226 0x226 0x226 0x226 0x226 0x226 0x226 0x226 0x226 0x226 0x226 0x226 0x226 0x226 0x226 0x226 0x226 0x226 0x226 0x226 0x226 0x226 0x226 0x226 0x226 0x226 0x226 0x226 0x226 0x226 0x226 0x226 0x226 0x226 0x226 0x226 0x226 0x226 0x226 0x226 0x226 0x226 0x226 0x226 0x226 0x226 0x226 0x226 0x226 0x226 0x226 0x226 0x226 0x226 0x226 0x226 0x226 0x226 0x226 0x226 0x226 0x226 0x226 0x226 0x226 0x226 0x226 0x226 0x226 0x226 0x226 0x226 0x226 0x226 0x226 0x226 0x226 0x226 0x226 0x226 0x226 0x226 0x226 0x226 0x226 0x226 0x226 0x226 0x226 0x226 0x226 0x226 0x226 0x226 0x226 0x226 0x226 0x226 0x226 0x226 0x226 0x226 0x226 0x226 0x226 0x226 0x226 0x226 0x226 0x226 0x226 0x226 0x226 0x226 0x226 0x226 0x226 0x226 0x226 0x226 0x226 0x226 0x226 0x226 0x226 0x226 0x226 0x226 0x226 0x226 0x226 0x226 0x226 0x226 0x226 0x226 0x226 0x226 0x226 0x226 0x226 0x226 0x226 0x226 0x226 0x226 0x226 0x226 0x226 0x226 0x226 0x226 0x226 0x226 0x226 0x226 0x226 0x226 0x226 0x226 0x226 0x226 0x226 0x226 0x226 0x226 0x226 0x226 0x226 0x226 0x226 0x226 0x226 0x226 0x226 0x226 0x226 0x226 0x226 0x226 0x226 0x226 0x226 0x226 0x226 0x226 0x226 0x226 0x226 0x226 0x226 0x226 0x226 0x226 0x226 0x226 0x226 0x226 0x226 0x226 0x226 0x226 0x226 0x226 0x226 0x226 0x226 0x226 0x226 0x226 0x226 0x226 0x226 0x226 0x226 0x226 0x226 0x226 0x226 0x226 0x226 0x226 0x226 0x226 0x226 0x226 0x226 0x226 0x226 0x226 0x226 0x226 0x226 0x226 0x226 0x226 0x226 0x226 0x226 0x226 0x226 0x226 0x226 0x226 0x226 0x226 0x226 0x226 0x226 0x226 0x226 0x226 0x226 0x226 0x226 0x226 0x226 0x226 0x226 0x226 0x226 0x226 0x226 0x226 0x226 0x226 0x226 0x226 0x226 0x226 0x226 0x226 0x226 0x226 0x226 0x226 0x226 0x226 0x226 0x226 0x226 0x226 0x226 0x226 0x226 0x226 0x226 0x226 0x226 0x226 0x226 0x226 0x226 0x226 0x226 0x226 0x226 0x226 0x226 0x226 0x226 0x226 0x226 0x226 0x226 0x226 0x226 0x226 0x226 0x226 0x226 0x226 0x226 0x226 0x226 0x226 0x226 0x226 0x226 0x226 0x226 0x226 0x226 0x226 0x226 0x226 0x226 0x226 0x226 0x226 0x226 0x226 0x226 0x226 0x226 0x226 0x226 0x226 0x226 0x226 0x226 0x226 0x226 0x226 0x226 0x226 0x226 0x226 0x226 0x226 0x226 0x226 0x226 0x226 0x226 0x226 0x226 0x226 0x226 0x226 0x226 0x226 0x226 0x226 0x226 0x226 0x226 0x226 0x226 0x226 0x226 0x226 0x226 0x226 0x226 0x226 0x226 0x226 0x226 0x226 0x226 0x226 0x226 0x226 0x226 0x226 0x226 0x226 0x226 0x226 0x226 0x226 0x226 0x226 0x226 0x226 0x226 0x226 0x226 0x226 0x226 0x226 0x226 0x226 0x226 0x226 0x226 0x226 0x226 0x226 0x226 0x226 0x226 0x226 0x226 0x226 0x226 0x226 0x226 0x226 0x226 0x226 0x226 0x226 0x226 0x226 0x226 0x226 0x226 0x226 0x226 0x226 0x226 0x226 0x226 0x226 0x226 0x226 0x226 0x226 0x226 0x226 0x226 0x226 0x226 0x226 0x226 0x226 0x226 0x226 0x226 0x226 0x226 0x226 0x226 0x226 0x226 0x226 0x226 0x226 0x226 0x226 0x226 0x226 0x226 0x226 0x226 0x226 0x226 0x226 0x226 0x226 0x226 0x226 0x226 0x226 0x226 0x226 0x226 0x226 0x226 0x226 0x226 0x226 0x226 0x226 0x226 0x226 0x226 0x226 0x226 0x226 0x226 0x226 0x226 0x226 0x226 0x226 0x226 0x226 0x226 0x226 0x226 0x226 0x226 0x226 0x226 0x226 0x226 0x226 0x226 0x226 0x226 0x226 0x226 0x226 0x226 0x226 0x226 0x226 0x226 0x226 0x226 0x226 0x226 0x226 0x226 0x226 0x226 0x226 0x226 0x226 0x226 0x226 0x226 0x226 0x226 0x226 0x226 0x226 0x226 0x226 0x226 0x226 0x226 0x226 0x226 0x226 0x226 0x226 0x226 0x226 0x226 0x226 0x226 0x226 0x226 0x226 0x226 0x226 0x226 0x226 0x226 0x226 0x226 0x226 0x226 0x226 0x226 0x226 0x226 0x226 0x226 0x226 0x226 0x226 0x226 0x226 0x226 0x226 0x226 0x226 0x226 0x226 0x226 0x226 0x226 0x226 0x226 0x226 0x226 0x226 0x226 0x226 0x226 0x226 0x226 0x226 0x226 0x226 0x226 0x226 0x226 0x226 0x226 0x226 0x226 0x226 0x226 0x226 0x226 0x226 0x226 0x226 0x226 0x226 0x226 0x226 0x226 0x226 0x226 0x226 0x226 0x226 0x226 0x226 0x226 0x226 0x226 0x226 0x226 0x226 0x226 0x226 0x226 0x226 0x226 0x226 0x226 0x226 0x226 0x226 0x226 0x226 0x226 0x226 0x226 0x226 0x226 0x226 0x226 0x226 0x226 0x226 0x226 0x226 0x226 0x226 0x226 0x226 0x226 0x226 0x226 0x226 0x226 0x226 0x226 0x226 0x226 0x226 0x226 0x226 0x226 0x226 0x226 0x226 0x226 0x226 0x226 0x226 0x226 0x226 0x226 0x226 0x226 0x226 0x226 0x226 0x226 0x226 0x226 0x226 0x226 0x226 0x226 0x226 0x226 0x226 0x226 0x226 0x226 0x226 0x226 0x226 0x226 0x226 0x226 0x226 0x226 0x226 0x226 0x226 0x226 0x226 0x226 0x226 0x226 0x226 0x226 0x226 0x226 0x226 0x226 0x226 0x226 0x226 0x226 0x226 0x226 0x226 0x226 0x226 0x226 0x226 0x226 0x226 0x226 0x226 0x226 0x226 0x226 0x226 0x226 0x226 0x226 0x226 0x226 0x226 0x226 0x226 0x226 0x226 0x226 0x226 0x226 0x226 0x226 0x226 0x226 0x226 0x226 0x226 0x226 0x226 0x226 0x226 0x226 0x226 0x226 0x226 0x226 0x226 0x226 0x226 0x226 0x226 0x226 0x226 0x226 0x226 0x226 0x226 0x226 0x226 0x226 0x226 0x226 0x226 0x226 0x226 0x226 0x226 0x226 0x226 0x226 0x226 0x226 0x226 0x226 0x226 0x226 0x226 0x226 0x226 0x226 0x226 0x226 0x226 0x226 0x226 0x226 0x226 0x226 0x226 0x226 0x226 0x226 0x226 0x226 0x226 0x226 0x226 0x226 0x226 0x226 0x226 0x226 0x226 0x226 0x226 0x226 0x226 0x226 0x226 0x226 0x226 0x226 0x226 0x226 0x226 0x226 0x226 0x226 0x226 0x226 0x226 0x226 0x226 0x226 0x226 0x226 0x226 0x226 0x226 0x226 0x226 0x226 0x226 0x226 0x226 0x226 0x226 0x226 0x226 0x226 0x226 0x226 0x226 0x226 0x226 0x226 0x226 0x226 0x226 0x226 0x226 0x226 0x226 0x226 0x226 0x226 0x226 0x226 0x226 0x226 0x226 0x226 0x226 0x226 0x226 0x226 0x226 0x226 0x226 0x226 0x226 0x226 0x226 0x226 0x226 0x226 0x226 0x226 0x226 0x226 0x226 0x226 0x226 0x226 0x226 0x226 0x226 0x226 0x226 0x226 0x226 0x226 0x226 0x226 0x226 0x226 0x226 0x226 0x226 0x226 0x226 0x226 0x226 0x226 0x226 0x226 0x226 0x226 0x226 0x226 0x226 0x226 0x226 0x226 0x226 0x226 0x226 0x226 0x226 0x226 0x226 0x226 0x226 0x226 0x226 0x226 0x226 0x226 0x226 0x226 0x226 0x226 0x226 0x226 0x226 0x226 0x226 0x226 0x226 0x226 0x226 0x226 0x226 0x226 0x226 0x226 0x226 0x226 0x226 0x226 0x226 0x226 0x226 0x226 0x226 0x226 0x226 0x226 0x226 0x226 0x226 0x226 0x226 0x226 0x226 0x226 0x226 0x226 0x226 0x226 0x226 0x226 0x226 0x226>;
				pt11_hi_limits_row_02 = <0x26>;
				pt11_hi_limits_cols_02 = <0x26>;
				pt11_hi_limits_02 = <0x3c 0x3c 0x3c 0x3c 0x3c 0x3c 0x3c 0x3c 0x3c 0x3c 0x3c 0x3c 0x3c 0x3c 0x3c 0x3c 0x3c 0x3c 0x3c 0x3c 0x3c 0x3c 0x3c 0x3c 0x3c 0x3c 0x3c 0x3c 0x3c 0x3c 0x3c 0x3c 0x3c 0x3c 0x3c 0x3c 0x3c 0x3c 0x3c 0x3c 0x3c 0x3c 0x3c 0x3c 0x3c 0x3c 0x3c 0x3c 0x3c 0x3c 0x3c 0x3c 0x3c 0x3c 0x3c 0x3c 0x3c 0x3c 0x3c 0x3c 0x3c 0x3c 0x3c 0x3c 0x3c 0x3c 0x3c 0x3c 0x3c 0x3c 0x3c 0x3c 0x3c 0x3c 0x3c 0x3c 0x3c 0x3c 0x3c 0x3c 0x3c 0x3c 0x3c 0x3c 0x3c 0x3c 0x3c 0x3c 0x3c 0x3c 0x3c 0x3c 0x3c 0x3c 0x3c 0x3c 0x3c 0x3c 0x3c 0x3c 0x3c 0x3c 0x3c 0x3c 0x3c 0x3c 0x3c 0x3c 0x3c 0x3c 0x3c 0x3c 0x3c 0x3c 0x3c 0x3c 0x3c 0x3c 0x3c 0x3c 0x3c 0x3c 0x3c 0x3c 0x3c 0x3c 0x3c 0x3c 0x3c 0x3c 0x3c 0x3c 0x3c 0x3c 0x3c 0x3c 0x3c 0x3c 0x3c 0x3c 0x3c 0x3c 0x3c 0x3c 0x3c 0x3c 0x3c 0x3c 0x3c 0x3c 0x3c 0x3c 0x3c 0x3c 0x3c 0x3c 0x3c 0x3c 0x3c 0x3c 0x3c 0x3c 0x3c 0x3c 0x3c 0x3c 0x3c 0x3c 0x3c 0x3c 0x3c 0x3c 0x3c 0x3c 0x3c 0x3c 0x3c 0x3c 0x3c 0x3c 0x3c 0x3c 0x3c 0x3c 0x3c 0x3c 0x3c 0x3c 0x3c 0x3c 0x3c 0x3c 0x3c 0x3c 0x3c 0x3c 0x3c 0x3c 0x3c 0x3c 0x3c 0x3c 0x3c 0x3c 0x3c 0x3c 0x3c 0x3c 0x3c 0x3c 0x3c 0x3c 0x3c 0x3c 0x3c 0x3c 0x3c 0x3c 0x3c 0x3c 0x3c 0x3c 0x3c 0x3c 0x3c 0x3c 0x3c 0x3c 0x3c 0x3c 0x3c 0x3c 0x3c 0x3c 0x3c 0x3c 0x3c 0x3c 0x3c 0x3c 0x3c 0x3c 0x3c 0x3c 0x3c 0x3c 0x3c 0x3c 0x3c 0x3c 0x3c 0x3c 0x3c 0x3c 0x3c 0x3c 0x3c 0x3c 0x3c 0x3c 0x3c 0x3c 0x3c 0x3c 0x3c 0x3c 0x3c 0x3c 0x3c 0x3c 0x3c 0x3c 0x3c 0x3c 0x3c 0x3c 0x3c 0x3c 0x3c 0x3c 0x3c 0x3c 0x3c 0x3c 0x3c 0x3c 0x3c 0x3c 0x3c 0x3c 0x3c 0x3c 0x3c 0x3c 0x3c 0x3c 0x3c 0x3c 0x3c 0x3c 0x3c 0x3c 0x3c 0x3c 0x3c 0x3c 0x3c 0x3c 0x3c 0x3c 0x3c 0x3c 0x3c 0x3c 0x3c 0x3c 0x3c 0x3c 0x3c 0x3c 0x3c 0x3c 0x3c 0x3c 0x3c 0x3c 0x3c 0x3c 0x3c 0x3c 0x3c 0x3c 0x3c 0x3c 0x3c 0x3c 0x3c 0x3c 0x3c 0x3c 0x3c 0x3c 0x3c 0x3c 0x3c 0x3c 0x3c 0x3c 0x3c 0x3c 0x3c 0x3c 0x3c 0x3c 0x3c 0x3c 0x3c 0x3c 0x3c 0x3c 0x3c 0x3c 0x3c 0x3c 0x3c 0x3c 0x3c 0x3c 0x3c 0x3c 0x3c 0x3c 0x3c 0x3c 0x3c 0x3c 0x3c 0x3c 0x3c 0x3c 0x3c 0x3c 0x3c 0x3c 0x3c 0x3c 0x3c 0x3c 0x3c 0x3c 0x3c 0x3c 0x3c 0x3c 0x3c 0x3c 0x3c 0x3c 0x3c 0x3c 0x3c 0x3c 0x3c 0x3c 0x3c 0x3c 0x3c 0x3c 0x3c 0x3c 0x3c 0x3c 0x3c 0x3c 0x3c 0x3c 0x3c 0x3c 0x3c 0x3c 0x3c 0x3c 0x3c 0x3c 0x3c 0x3c 0x3c 0x3c 0x3c 0x3c 0x3c 0x3c 0x3c 0x3c 0x3c 0x3c 0x3c 0x3c 0x3c 0x3c 0x3c 0x3c 0x3c 0x3c 0x3c 0x3c 0x3c 0x3c 0x3c 0x3c 0x3c 0x3c 0x3c 0x3c 0x3c 0x3c 0x3c 0x3c 0x3c 0x3c 0x3c 0x3c 0x3c 0x3c 0x3c 0x3c 0x3c 0x3c 0x3c 0x3c 0x3c 0x3c 0x3c 0x3c 0x3c 0x3c 0x3c 0x3c 0x3c 0x3c 0x3c 0x3c 0x3c 0x3c 0x3c 0x3c 0x3c 0x3c 0x3c 0x3c 0x3c 0x3c 0x3c 0x3c 0x3c 0x3c 0x3c 0x3c 0x3c 0x3c 0x3c 0x3c 0x3c 0x3c 0x3c 0x3c 0x3c 0x3c 0x3c 0x3c 0x3c 0x3c 0x3c 0x3c 0x3c 0x3c 0x3c 0x3c 0x3c 0x3c 0x3c 0x3c 0x3c 0x3c 0x3c 0x3c 0x3c 0x3c 0x3c 0x3c 0x3c 0x3c 0x3c 0x3c 0x3c 0x3c 0x3c 0x3c 0x3c 0x3c 0x3c 0x3c 0x3c 0x3c 0x3c 0x3c 0x3c 0x3c 0x3c 0x3c 0x3c 0x3c 0x3c 0x3c 0x3c 0x3c 0x3c 0x3c 0x3c 0x3c 0x3c 0x3c 0x3c 0x3c 0x3c 0x3c 0x3c 0x3c 0x3c 0x3c 0x3c 0x3c 0x3c 0x3c 0x3c 0x3c 0x3c 0x3c 0x3c 0x3c 0x3c 0x3c 0x3c 0x3c 0x3c 0x3c 0x3c 0x3c 0x3c 0x3c 0x3c 0x3c 0x3c 0x3c 0x3c 0x3c 0x3c 0x3c 0x3c 0x3c 0x3c 0x3c 0x3c 0x3c 0x3c 0x3c 0x3c 0x3c 0x3c 0x3c 0x3c 0x3c 0x3c 0x3c 0x3c 0x3c 0x3c 0x3c 0x3c 0x3c 0x3c 0x3c 0x3c 0x3c 0x3c 0x3c 0x3c 0x3c 0x3c 0x3c 0x3c 0x3c 0x3c 0x3c 0x3c 0x3c 0x3c 0x3c 0x3c 0x3c 0x3c 0x3c 0x3c 0x3c 0x3c 0x3c 0x3c 0x3c 0x3c 0x3c 0x3c 0x3c 0x3c 0x3c 0x3c 0x3c 0x3c 0x3c 0x3c 0x3c 0x3c 0x3c 0x3c 0x3c 0x3c 0x3c 0x3c 0x3c 0x3c 0x3c 0x3c 0x3c 0x3c 0x3c 0x3c 0x3c 0x3c 0x3c 0x3c 0x3c 0x3c 0x3c 0x3c 0x3c 0x3c 0x3c 0x3c 0x3c 0x3c 0x3c 0x3c 0x3c 0x3c 0x3c 0x3c 0x3c 0x3c 0x3c 0x3c 0x3c 0x3c 0x3c 0x3c 0x3c 0x3c 0x3c 0x3c 0x3c 0x3c 0x3c 0x3c 0x3c 0x3c 0x3c 0x3c 0x3c 0x3c 0x3c 0x3c 0x3c 0x3c 0x3c 0x3c 0x3c 0x3c 0x3c 0x3c 0x3c 0x3c 0x3c 0x3c 0x3c 0x3c 0x3c 0x3c 0x3c 0x3c 0x3c 0x3c 0x3c 0x3c 0x3c 0x3c 0x3c 0x3c 0x3c 0x3c 0x3c 0x3c 0x3c 0x3c 0x3c 0x3c 0x3c 0x3c 0x3c 0x3c 0x3c 0x3c 0x3c 0x3c 0x3c 0x3c 0x3c 0x3c 0x3c 0x3c 0x3c 0x3c 0x3c 0x3c 0x3c 0x3c 0x3c 0x3c 0x3c 0x3c 0x3c 0x3c 0x3c 0x3c 0x3c 0x3c 0x3c 0x3c 0x3c 0x3c 0x3c 0x3c 0x3c 0x3c 0x3c 0x3c 0x3c 0x3c 0x3c 0x3c 0x3c 0x3c 0x3c 0x3c 0x3c 0x3c 0x3c 0x3c 0x3c 0x3c 0x3c 0x3c 0x3c 0x3c 0x3c 0x3c 0x3c 0x3c 0x3c 0x3c 0x3c 0x3c 0x3c 0x3c 0x3c 0x3c 0x3c 0x3c 0x3c 0x3c 0x3c 0x3c 0x3c 0x3c 0x3c 0x3c 0x3c 0x3c 0x3c 0x3c 0x3c 0x3c 0x3c 0x3c 0x3c 0x3c 0x3c 0x3c 0x3c 0x3c 0x3c 0x3c 0x3c 0x3c 0x3c 0x3c 0x3c 0x3c 0x3c 0x3c 0x3c 0x3c 0x3c 0x3c 0x3c 0x3c 0x3c 0x3c 0x3c 0x3c 0x3c 0x3c 0x3c 0x3c 0x3c 0x3c 0x3c 0x3c 0x3c 0x3c 0x3c 0x3c 0x3c 0x3c 0x3c 0x3c 0x3c 0x3c 0x3c 0x3c 0x3c 0x3c 0x3c 0x3c 0x3c 0x3c 0x3c 0x3c 0x3c 0x3c 0x3c 0x3c 0x3c 0x3c 0x3c 0x3c 0x3c 0x3c 0x3c 0x3c 0x3c 0x3c 0x3c 0x3c 0x3c 0x3c 0x3c 0x3c 0x3c 0x3c 0x3c 0x3c 0x3c 0x3c 0x3c 0x3c 0x3c 0x3c 0x3c 0x3c 0x3c 0x3c 0x3c 0x3c 0x3c 0x3c 0x3c 0x3c 0x3c 0x3c 0x3c 0x3c 0x3c 0x3c 0x3c 0x3c 0x3c 0x3c 0x3c 0x3c 0x3c 0x3c 0x3c 0x3c 0x3c 0x3c 0x3c 0x3c 0x3c 0x3c 0x3c 0x3c 0x3c 0x3c 0x3c 0x3c 0x3c 0x3c 0x3c 0x3c 0x3c 0x3c 0x3c 0x3c 0x3c 0x3c 0x3c 0x3c 0x3c 0x3c 0x3c 0x3c 0x3c 0x3c 0x3c 0x3c 0x3c 0x3c 0x3c 0x3c 0x3c 0x3c 0x3c 0x3c 0x3c 0x3c 0x3c 0x3c 0x3c 0x3c 0x3c 0x3c 0x3c 0x3c 0x3c 0x3c 0x3c 0x3c 0x3c 0x3c 0x3c 0x3c 0x3c 0x3c 0x3c 0x3c 0x3c 0x3c 0x3c 0x3c 0x3c 0x3c 0x3c 0x3c 0x3c 0x3c 0x3c 0x3c 0x3c 0x3c 0x3c 0x3c 0x3c 0x3c 0x3c 0x3c 0x3c 0x3c 0x3c 0x3c 0x3c 0x3c 0x3c 0x3c 0x3c 0x3c 0x3c 0x3c 0x3c 0x3c 0x3c 0x3c 0x3c 0x3c 0x3c 0x3c 0x3c 0x3c 0x3c 0x3c 0x3c 0x3c 0x3c 0x3c 0x3c 0x3c 0x3c 0x3c 0x3c 0x3c 0x3c 0x3c 0x3c 0x3c 0x3c 0x3c 0x3c 0x3c 0x3c 0x3c 0x3c 0x3c 0x3c 0x3c 0x3c 0x3c 0x3c 0x3c 0x3c 0x3c 0x3c 0x3c 0x3c 0x3c 0x3c 0x3c 0x3c 0x3c 0x3c 0x3c 0x3c 0x3c 0x3c 0x3c 0x3c 0x3c 0x3c 0x3c 0x3c 0x3c 0x3c 0x3c 0x3c 0x3c 0x3c 0x3c 0x3c 0x3c 0x3c 0x3c 0x3c 0x3c 0x3c 0x3c 0x3c 0x3c 0x3c 0x3c 0x3c 0x3c 0x3c 0x3c 0x3c 0x3c 0x3c 0x3c 0x3c 0x3c 0x3c 0x3c 0x3c 0x3c 0x3c 0x3c 0x3c 0x3c 0x3c 0x3c 0x3c 0x3c 0x3c 0x3c 0x3c 0x3c 0x3c 0x3c 0x3c 0x3c 0x3c 0x3c 0x3c 0x3c 0x3c 0x3c 0x3c 0x3c 0x3c 0x3c 0x3c 0x3c 0x3c 0x3c 0x3c 0x3c 0x3c 0x3c 0x3c 0x3c 0x3c 0x3c 0x3c 0x3c 0x3c 0x3c 0x3c 0x3c 0x3c 0x3c 0x3c 0x3c 0x3c 0x3c 0x3c 0x3c 0x3c 0x3c 0x3c 0x3c 0x3c 0x3c 0x3c 0x3c 0x3c 0x3c 0x3c 0x3c 0x3c 0x3c 0x3c 0x3c 0x3c 0x3c 0x3c 0x3c 0x3c 0x3c 0x3c 0x3c 0x3c 0x3c 0x3c 0x3c 0x3c 0x3c 0x3c 0x3c 0x3c 0x3c 0x3c 0x3c 0x3c 0x3c 0x3c 0x3c 0x3c 0x3c 0x3c 0x3c 0x3c 0x3c 0x3c 0x3c 0x3c 0x3c 0x3c 0x3c 0x3c 0x3c 0x3c 0x3c 0x3c 0x3c 0x3c 0x3c 0x3c 0x3c 0x3c 0x3c 0x3c 0x3c 0x3c 0x3c 0x3c 0x3c 0x3c 0x3c 0x3c 0x3c 0x3c 0x3c 0x3c 0x3c 0x3c 0x3c 0x3c 0x3c 0x3c 0x3c 0x3c 0x3c 0x3c 0x3c 0x3c 0x3c 0x3c 0x3c 0x3c 0x3c 0x3c 0x3c 0x3c 0x3c 0x3c 0x3c 0x3c 0x3c 0x3c 0x3c 0x3c 0x3c 0x3c 0x3c 0x3c 0x3c 0x3c 0x3c 0x3c 0x3c 0x3c 0x3c 0x3c 0x3c 0x3c 0x3c 0x3c 0x3c 0x3c 0x3c 0x3c 0x3c 0x3c 0x3c 0x3c 0x3c 0x3c 0x3c 0x3c 0x3c 0x3c 0x3c 0x3c 0x3c 0x3c 0x3c 0x3c 0x3c 0x3c 0x3c 0x3c 0x3c 0x3c 0x3c 0x3c 0x3c 0x3c 0x3c 0x3c 0x3c 0x3c 0x3c 0x3c 0x3c 0x3c 0x3c 0x3c 0x3c 0x3c 0x3c 0x3c 0x3c 0x3c 0x3c 0x3c 0x3c 0x3c 0x3c 0x3c 0x3c 0x3c 0x3c 0x3c 0x3c 0x3c 0x3c 0x3c 0x3c 0x3c 0x3c 0x3c 0x3c 0x3c 0x3c 0x3c 0x3c 0x3c 0x3c 0x3c 0x3c 0x3c 0x3c 0x3c 0x3c 0x3c 0x3c 0x3c 0x3c 0x3c 0x3c 0x3c 0x3c 0x3c 0x3c 0x3c 0x3c 0x3c 0x3c 0x3c 0x3c 0x3c 0x3c 0x3c 0x3c 0x3c 0x3c 0x3c 0x3c 0x3c 0x3c 0x3c 0x3c 0x3c 0x3c 0x3c 0x3c 0x3c 0x3c 0x3c 0x3c 0x3c 0x3c 0x3c 0x3c 0x3c 0x3c 0x3c 0x3c 0x3c 0x3c 0x3c 0x3c 0x3c 0x3c 0x3c 0x3c 0x3c 0x3c 0x3c>;
				pt11_lo_limits_row_02 = <0x26>;
				pt11_lo_limits_cols_02 = <0x26>;
				pt11_lo_limits_02 = <0xffffffc4 0xffffffc4 0xffffffc4 0xffffffc4 0xffffffc4 0xffffffc4 0xffffffc4 0xffffffc4 0xffffffc4 0xffffffc4 0xffffffc4 0xffffffc4 0xffffffc4 0xffffffc4 0xffffffc4 0xffffffc4 0xffffffc4 0xffffffc4 0xffffffc4 0xffffffc4 0xffffffc4 0xffffffc4 0xffffffc4 0xffffffc4 0xffffffc4 0xffffffc4 0xffffffc4 0xffffffc4 0xffffffc4 0xffffffc4 0xffffffc4 0xffffffc4 0xffffffc4 0xffffffc4 0xffffffc4 0xffffffc4 0xffffffc4 0xffffffc4 0xffffffc4 0xffffffc4 0xffffffc4 0xffffffc4 0xffffffc4 0xffffffc4 0xffffffc4 0xffffffc4 0xffffffc4 0xffffffc4 0xffffffc4 0xffffffc4 0xffffffc4 0xffffffc4 0xffffffc4 0xffffffc4 0xffffffc4 0xffffffc4 0xffffffc4 0xffffffc4 0xffffffc4 0xffffffc4 0xffffffc4 0xffffffc4 0xffffffc4 0xffffffc4 0xffffffc4 0xffffffc4 0xffffffc4 0xffffffc4 0xffffffc4 0xffffffc4 0xffffffc4 0xffffffc4 0xffffffc4 0xffffffc4 0xffffffc4 0xffffffc4 0xffffffc4 0xffffffc4 0xffffffc4 0xffffffc4 0xffffffc4 0xffffffc4 0xffffffc4 0xffffffc4 0xffffffc4 0xffffffc4 0xffffffc4 0xffffffc4 0xffffffc4 0xffffffc4 0xffffffc4 0xffffffc4 0xffffffc4 0xffffffc4 0xffffffc4 0xffffffc4 0xffffffc4 0xffffffc4 0xffffffc4 0xffffffc4 0xffffffc4 0xffffffc4 0xffffffc4 0xffffffc4 0xffffffc4 0xffffffc4 0xffffffc4 0xffffffc4 0xffffffc4 0xffffffc4 0xffffffc4 0xffffffc4 0xffffffc4 0xffffffc4 0xffffffc4 0xffffffc4 0xffffffc4 0xffffffc4 0xffffffc4 0xffffffc4 0xffffffc4 0xffffffc4 0xffffffc4 0xffffffc4 0xffffffc4 0xffffffc4 0xffffffc4 0xffffffc4 0xffffffc4 0xffffffc4 0xffffffc4 0xffffffc4 0xffffffc4 0xffffffc4 0xffffffc4 0xffffffc4 0xffffffc4 0xffffffc4 0xffffffc4 0xffffffc4 0xffffffc4 0xffffffc4 0xffffffc4 0xffffffc4 0xffffffc4 0xffffffc4 0xffffffc4 0xffffffc4 0xffffffc4 0xffffffc4 0xffffffc4 0xffffffc4 0xffffffc4 0xffffffc4 0xffffffc4 0xffffffc4 0xffffffc4 0xffffffc4 0xffffffc4 0xffffffc4 0xffffffc4 0xffffffc4 0xffffffc4 0xffffffc4 0xffffffc4 0xffffffc4 0xffffffc4 0xffffffc4 0xffffffc4 0xffffffc4 0xffffffc4 0xffffffc4 0xffffffc4 0xffffffc4 0xffffffc4 0xffffffc4 0xffffffc4 0xffffffc4 0xffffffc4 0xffffffc4 0xffffffc4 0xffffffc4 0xffffffc4 0xffffffc4 0xffffffc4 0xffffffc4 0xffffffc4 0xffffffc4 0xffffffc4 0xffffffc4 0xffffffc4 0xffffffc4 0xffffffc4 0xffffffc4 0xffffffc4 0xffffffc4 0xffffffc4 0xffffffc4 0xffffffc4 0xffffffc4 0xffffffc4 0xffffffc4 0xffffffc4 0xffffffc4 0xffffffc4 0xffffffc4 0xffffffc4 0xffffffc4 0xffffffc4 0xffffffc4 0xffffffc4 0xffffffc4 0xffffffc4 0xffffffc4 0xffffffc4 0xffffffc4 0xffffffc4 0xffffffc4 0xffffffc4 0xffffffc4 0xffffffc4 0xffffffc4 0xffffffc4 0xffffffc4 0xffffffc4 0xffffffc4 0xffffffc4 0xffffffc4 0xffffffc4 0xffffffc4 0xffffffc4 0xffffffc4 0xffffffc4 0xffffffc4 0xffffffc4 0xffffffc4 0xffffffc4 0xffffffc4 0xffffffc4 0xffffffc4 0xffffffc4 0xffffffc4 0xffffffc4 0xffffffc4 0xffffffc4 0xffffffc4 0xffffffc4 0xffffffc4 0xffffffc4 0xffffffc4 0xffffffc4 0xffffffc4 0xffffffc4 0xffffffc4 0xffffffc4 0xffffffc4 0xffffffc4 0xffffffc4 0xffffffc4 0xffffffc4 0xffffffc4 0xffffffc4 0xffffffc4 0xffffffc4 0xffffffc4 0xffffffc4 0xffffffc4 0xffffffc4 0xffffffc4 0xffffffc4 0xffffffc4 0xffffffc4 0xffffffc4 0xffffffc4 0xffffffc4 0xffffffc4 0xffffffc4 0xffffffc4 0xffffffc4 0xffffffc4 0xffffffc4 0xffffffc4 0xffffffc4 0xffffffc4 0xffffffc4 0xffffffc4 0xffffffc4 0xffffffc4 0xffffffc4 0xffffffc4 0xffffffc4 0xffffffc4 0xffffffc4 0xffffffc4 0xffffffc4 0xffffffc4 0xffffffc4 0xffffffc4 0xffffffc4 0xffffffc4 0xffffffc4 0xffffffc4 0xffffffc4 0xffffffc4 0xffffffc4 0xffffffc4 0xffffffc4 0xffffffc4 0xffffffc4 0xffffffc4 0xffffffc4 0xffffffc4 0xffffffc4 0xffffffc4 0xffffffc4 0xffffffc4 0xffffffc4 0xffffffc4 0xffffffc4 0xffffffc4 0xffffffc4 0xffffffc4 0xffffffc4 0xffffffc4 0xffffffc4 0xffffffc4 0xffffffc4 0xffffffc4 0xffffffc4 0xffffffc4 0xffffffc4 0xffffffc4 0xffffffc4 0xffffffc4 0xffffffc4 0xffffffc4 0xffffffc4 0xffffffc4 0xffffffc4 0xffffffc4 0xffffffc4 0xffffffc4 0xffffffc4 0xffffffc4 0xffffffc4 0xffffffc4 0xffffffc4 0xffffffc4 0xffffffc4 0xffffffc4 0xffffffc4 0xffffffc4 0xffffffc4 0xffffffc4 0xffffffc4 0xffffffc4 0xffffffc4 0xffffffc4 0xffffffc4 0xffffffc4 0xffffffc4 0xffffffc4 0xffffffc4 0xffffffc4 0xffffffc4 0xffffffc4 0xffffffc4 0xffffffc4 0xffffffc4 0xffffffc4 0xffffffc4 0xffffffc4 0xffffffc4 0xffffffc4 0xffffffc4 0xffffffc4 0xffffffc4 0xffffffc4 0xffffffc4 0xffffffc4 0xffffffc4 0xffffffc4 0xffffffc4 0xffffffc4 0xffffffc4 0xffffffc4 0xffffffc4 0xffffffc4 0xffffffc4 0xffffffc4 0xffffffc4 0xffffffc4 0xffffffc4 0xffffffc4 0xffffffc4 0xffffffc4 0xffffffc4 0xffffffc4 0xffffffc4 0xffffffc4 0xffffffc4 0xffffffc4 0xffffffc4 0xffffffc4 0xffffffc4 0xffffffc4 0xffffffc4 0xffffffc4 0xffffffc4 0xffffffc4 0xffffffc4 0xffffffc4 0xffffffc4 0xffffffc4 0xffffffc4 0xffffffc4 0xffffffc4 0xffffffc4 0xffffffc4 0xffffffc4 0xffffffc4 0xffffffc4 0xffffffc4 0xffffffc4 0xffffffc4 0xffffffc4 0xffffffc4 0xffffffc4 0xffffffc4 0xffffffc4 0xffffffc4 0xffffffc4 0xffffffc4 0xffffffc4 0xffffffc4 0xffffffc4 0xffffffc4 0xffffffc4 0xffffffc4 0xffffffc4 0xffffffc4 0xffffffc4 0xffffffc4 0xffffffc4 0xffffffc4 0xffffffc4 0xffffffc4 0xffffffc4 0xffffffc4 0xffffffc4 0xffffffc4 0xffffffc4 0xffffffc4 0xffffffc4 0xffffffc4 0xffffffc4 0xffffffc4 0xffffffc4 0xffffffc4 0xffffffc4 0xffffffc4 0xffffffc4 0xffffffc4 0xffffffc4 0xffffffc4 0xffffffc4 0xffffffc4 0xffffffc4 0xffffffc4 0xffffffc4 0xffffffc4 0xffffffc4 0xffffffc4 0xffffffc4 0xffffffc4 0xffffffc4 0xffffffc4 0xffffffc4 0xffffffc4 0xffffffc4 0xffffffc4 0xffffffc4 0xffffffc4 0xffffffc4 0xffffffc4 0xffffffc4 0xffffffc4 0xffffffc4 0xffffffc4 0xffffffc4 0xffffffc4 0xffffffc4 0xffffffc4 0xffffffc4 0xffffffc4 0xffffffc4 0xffffffc4 0xffffffc4 0xffffffc4 0xffffffc4 0xffffffc4 0xffffffc4 0xffffffc4 0xffffffc4 0xffffffc4 0xffffffc4 0xffffffc4 0xffffffc4 0xffffffc4 0xffffffc4 0xffffffc4 0xffffffc4 0xffffffc4 0xffffffc4 0xffffffc4 0xffffffc4 0xffffffc4 0xffffffc4 0xffffffc4 0xffffffc4 0xffffffc4 0xffffffc4 0xffffffc4 0xffffffc4 0xffffffc4 0xffffffc4 0xffffffc4 0xffffffc4 0xffffffc4 0xffffffc4 0xffffffc4 0xffffffc4 0xffffffc4 0xffffffc4 0xffffffc4 0xffffffc4 0xffffffc4 0xffffffc4 0xffffffc4 0xffffffc4 0xffffffc4 0xffffffc4 0xffffffc4 0xffffffc4 0xffffffc4 0xffffffc4 0xffffffc4 0xffffffc4 0xffffffc4 0xffffffc4 0xffffffc4 0xffffffc4 0xffffffc4 0xffffffc4 0xffffffc4 0xffffffc4 0xffffffc4 0xffffffc4 0xffffffc4 0xffffffc4 0xffffffc4 0xffffffc4 0xffffffc4 0xffffffc4 0xffffffc4 0xffffffc4 0xffffffc4 0xffffffc4 0xffffffc4 0xffffffc4 0xffffffc4 0xffffffc4 0xffffffc4 0xffffffc4 0xffffffc4 0xffffffc4 0xffffffc4 0xffffffc4 0xffffffc4 0xffffffc4 0xffffffc4 0xffffffc4 0xffffffc4 0xffffffc4 0xffffffc4 0xffffffc4 0xffffffc4 0xffffffc4 0xffffffc4 0xffffffc4 0xffffffc4 0xffffffc4 0xffffffc4 0xffffffc4 0xffffffc4 0xffffffc4 0xffffffc4 0xffffffc4 0xffffffc4 0xffffffc4 0xffffffc4 0xffffffc4 0xffffffc4 0xffffffc4 0xffffffc4 0xffffffc4 0xffffffc4 0xffffffc4 0xffffffc4 0xffffffc4 0xffffffc4 0xffffffc4 0xffffffc4 0xffffffc4 0xffffffc4 0xffffffc4 0xffffffc4 0xffffffc4 0xffffffc4 0xffffffc4 0xffffffc4 0xffffffc4 0xffffffc4 0xffffffc4 0xffffffc4 0xffffffc4 0xffffffc4 0xffffffc4 0xffffffc4 0xffffffc4 0xffffffc4 0xffffffc4 0xffffffc4 0xffffffc4 0xffffffc4 0xffffffc4 0xffffffc4 0xffffffc4 0xffffffc4 0xffffffc4 0xffffffc4 0xffffffc4 0xffffffc4 0xffffffc4 0xffffffc4 0xffffffc4 0xffffffc4 0xffffffc4 0xffffffc4 0xffffffc4 0xffffffc4 0xffffffc4 0xffffffc4 0xffffffc4 0xffffffc4 0xffffffc4 0xffffffc4 0xffffffc4 0xffffffc4 0xffffffc4 0xffffffc4 0xffffffc4 0xffffffc4 0xffffffc4 0xffffffc4 0xffffffc4 0xffffffc4 0xffffffc4 0xffffffc4 0xffffffc4 0xffffffc4 0xffffffc4 0xffffffc4 0xffffffc4 0xffffffc4 0xffffffc4 0xffffffc4 0xffffffc4 0xffffffc4 0xffffffc4 0xffffffc4 0xffffffc4 0xffffffc4 0xffffffc4 0xffffffc4 0xffffffc4 0xffffffc4 0xffffffc4 0xffffffc4 0xffffffc4 0xffffffc4 0xffffffc4 0xffffffc4 0xffffffc4 0xffffffc4 0xffffffc4 0xffffffc4 0xffffffc4 0xffffffc4 0xffffffc4 0xffffffc4 0xffffffc4 0xffffffc4 0xffffffc4 0xffffffc4 0xffffffc4 0xffffffc4 0xffffffc4 0xffffffc4 0xffffffc4 0xffffffc4 0xffffffc4 0xffffffc4 0xffffffc4 0xffffffc4 0xffffffc4 0xffffffc4 0xffffffc4 0xffffffc4 0xffffffc4 0xffffffc4 0xffffffc4 0xffffffc4 0xffffffc4 0xffffffc4 0xffffffc4 0xffffffc4 0xffffffc4 0xffffffc4 0xffffffc4 0xffffffc4 0xffffffc4 0xffffffc4 0xffffffc4 0xffffffc4 0xffffffc4 0xffffffc4 0xffffffc4 0xffffffc4 0xffffffc4 0xffffffc4 0xffffffc4 0xffffffc4 0xffffffc4 0xffffffc4 0xffffffc4 0xffffffc4 0xffffffc4 0xffffffc4 0xffffffc4 0xffffffc4 0xffffffc4 0xffffffc4 0xffffffc4 0xffffffc4 0xffffffc4 0xffffffc4 0xffffffc4 0xffffffc4 0xffffffc4 0xffffffc4 0xffffffc4 0xffffffc4 0xffffffc4 0xffffffc4 0xffffffc4 0xffffffc4 0xffffffc4 0xffffffc4 0xffffffc4 0xffffffc4 0xffffffc4 0xffffffc4 0xffffffc4 0xffffffc4 0xffffffc4 0xffffffc4 0xffffffc4 0xffffffc4 0xffffffc4 0xffffffc4 0xffffffc4 0xffffffc4 0xffffffc4 0xffffffc4 0xffffffc4 0xffffffc4 0xffffffc4 0xffffffc4 0xffffffc4 0xffffffc4 0xffffffc4 0xffffffc4 0xffffffc4 0xffffffc4 0xffffffc4 0xffffffc4 0xffffffc4 0xffffffc4 0xffffffc4 0xffffffc4 0xffffffc4 0xffffffc4 0xffffffc4 0xffffffc4 0xffffffc4 0xffffffc4 0xffffffc4 0xffffffc4 0xffffffc4 0xffffffc4 0xffffffc4 0xffffffc4 0xffffffc4 0xffffffc4 0xffffffc4 0xffffffc4 0xffffffc4 0xffffffc4 0xffffffc4 0xffffffc4 0xffffffc4 0xffffffc4 0xffffffc4 0xffffffc4 0xffffffc4 0xffffffc4 0xffffffc4 0xffffffc4 0xffffffc4 0xffffffc4 0xffffffc4 0xffffffc4 0xffffffc4 0xffffffc4 0xffffffc4 0xffffffc4 0xffffffc4 0xffffffc4 0xffffffc4 0xffffffc4 0xffffffc4 0xffffffc4 0xffffffc4 0xffffffc4 0xffffffc4 0xffffffc4 0xffffffc4 0xffffffc4 0xffffffc4 0xffffffc4 0xffffffc4 0xffffffc4 0xffffffc4 0xffffffc4 0xffffffc4 0xffffffc4 0xffffffc4 0xffffffc4 0xffffffc4 0xffffffc4 0xffffffc4 0xffffffc4 0xffffffc4 0xffffffc4 0xffffffc4 0xffffffc4 0xffffffc4 0xffffffc4 0xffffffc4 0xffffffc4 0xffffffc4 0xffffffc4 0xffffffc4 0xffffffc4 0xffffffc4 0xffffffc4 0xffffffc4 0xffffffc4 0xffffffc4 0xffffffc4 0xffffffc4 0xffffffc4 0xffffffc4 0xffffffc4 0xffffffc4 0xffffffc4 0xffffffc4 0xffffffc4 0xffffffc4 0xffffffc4 0xffffffc4 0xffffffc4 0xffffffc4 0xffffffc4 0xffffffc4 0xffffffc4 0xffffffc4 0xffffffc4 0xffffffc4 0xffffffc4 0xffffffc4 0xffffffc4 0xffffffc4 0xffffffc4 0xffffffc4 0xffffffc4 0xffffffc4 0xffffffc4 0xffffffc4 0xffffffc4 0xffffffc4 0xffffffc4 0xffffffc4 0xffffffc4 0xffffffc4 0xffffffc4 0xffffffc4 0xffffffc4 0xffffffc4 0xffffffc4 0xffffffc4 0xffffffc4 0xffffffc4 0xffffffc4 0xffffffc4 0xffffffc4 0xffffffc4 0xffffffc4 0xffffffc4 0xffffffc4 0xffffffc4 0xffffffc4 0xffffffc4 0xffffffc4 0xffffffc4 0xffffffc4 0xffffffc4 0xffffffc4 0xffffffc4 0xffffffc4 0xffffffc4 0xffffffc4 0xffffffc4 0xffffffc4 0xffffffc4 0xffffffc4 0xffffffc4 0xffffffc4 0xffffffc4 0xffffffc4 0xffffffc4 0xffffffc4 0xffffffc4 0xffffffc4 0xffffffc4 0xffffffc4 0xffffffc4 0xffffffc4 0xffffffc4 0xffffffc4 0xffffffc4 0xffffffc4 0xffffffc4 0xffffffc4 0xffffffc4 0xffffffc4 0xffffffc4 0xffffffc4 0xffffffc4 0xffffffc4 0xffffffc4 0xffffffc4 0xffffffc4 0xffffffc4 0xffffffc4 0xffffffc4 0xffffffc4 0xffffffc4 0xffffffc4 0xffffffc4 0xffffffc4 0xffffffc4 0xffffffc4 0xffffffc4 0xffffffc4 0xffffffc4 0xffffffc4 0xffffffc4 0xffffffc4 0xffffffc4 0xffffffc4 0xffffffc4 0xffffffc4 0xffffffc4 0xffffffc4 0xffffffc4 0xffffffc4 0xffffffc4 0xffffffc4 0xffffffc4 0xffffffc4 0xffffffc4 0xffffffc4 0xffffffc4 0xffffffc4 0xffffffc4 0xffffffc4 0xffffffc4 0xffffffc4 0xffffffc4 0xffffffc4 0xffffffc4 0xffffffc4 0xffffffc4 0xffffffc4 0xffffffc4 0xffffffc4 0xffffffc4 0xffffffc4 0xffffffc4 0xffffffc4 0xffffffc4 0xffffffc4 0xffffffc4 0xffffffc4 0xffffffc4 0xffffffc4 0xffffffc4 0xffffffc4 0xffffffc4 0xffffffc4 0xffffffc4 0xffffffc4 0xffffffc4 0xffffffc4 0xffffffc4 0xffffffc4 0xffffffc4 0xffffffc4 0xffffffc4 0xffffffc4 0xffffffc4 0xffffffc4 0xffffffc4 0xffffffc4 0xffffffc4 0xffffffc4 0xffffffc4 0xffffffc4 0xffffffc4 0xffffffc4 0xffffffc4 0xffffffc4 0xffffffc4 0xffffffc4 0xffffffc4 0xffffffc4 0xffffffc4 0xffffffc4 0xffffffc4 0xffffffc4 0xffffffc4 0xffffffc4 0xffffffc4 0xffffffc4 0xffffffc4 0xffffffc4 0xffffffc4 0xffffffc4 0xffffffc4 0xffffffc4 0xffffffc4 0xffffffc4 0xffffffc4 0xffffffc4 0xffffffc4 0xffffffc4 0xffffffc4 0xffffffc4 0xffffffc4 0xffffffc4 0xffffffc4 0xffffffc4 0xffffffc4 0xffffffc4 0xffffffc4 0xffffffc4 0xffffffc4 0xffffffc4 0xffffffc4 0xffffffc4 0xffffffc4 0xffffffc4 0xffffffc4 0xffffffc4 0xffffffc4 0xffffffc4 0xffffffc4 0xffffffc4 0xffffffc4 0xffffffc4 0xffffffc4 0xffffffc4 0xffffffc4 0xffffffc4 0xffffffc4 0xffffffc4 0xffffffc4 0xffffffc4 0xffffffc4 0xffffffc4 0xffffffc4 0xffffffc4 0xffffffc4 0xffffffc4 0xffffffc4 0xffffffc4 0xffffffc4 0xffffffc4 0xffffffc4 0xffffffc4 0xffffffc4 0xffffffc4 0xffffffc4 0xffffffc4 0xffffffc4 0xffffffc4 0xffffffc4 0xffffffc4 0xffffffc4 0xffffffc4 0xffffffc4 0xffffffc4 0xffffffc4 0xffffffc4 0xffffffc4 0xffffffc4 0xffffffc4 0xffffffc4 0xffffffc4 0xffffffc4 0xffffffc4 0xffffffc4 0xffffffc4 0xffffffc4 0xffffffc4 0xffffffc4 0xffffffc4 0xffffffc4 0xffffffc4 0xffffffc4 0xffffffc4 0xffffffc4 0xffffffc4 0xffffffc4 0xffffffc4 0xffffffc4 0xffffffc4 0xffffffc4 0xffffffc4 0xffffffc4 0xffffffc4 0xffffffc4 0xffffffc4 0xffffffc4 0xffffffc4 0xffffffc4 0xffffffc4 0xffffffc4 0xffffffc4 0xffffffc4 0xffffffc4 0xffffffc4 0xffffffc4 0xffffffc4 0xffffffc4 0xffffffc4 0xffffffc4 0xffffffc4 0xffffffc4 0xffffffc4 0xffffffc4 0xffffffc4 0xffffffc4 0xffffffc4 0xffffffc4 0xffffffc4 0xffffffc4 0xffffffc4 0xffffffc4 0xffffffc4 0xffffffc4 0xffffffc4 0xffffffc4 0xffffffc4 0xffffffc4 0xffffffc4 0xffffffc4 0xffffffc4 0xffffffc4 0xffffffc4 0xffffffc4 0xffffffc4 0xffffffc4 0xffffffc4 0xffffffc4 0xffffffc4 0xffffffc4 0xffffffc4 0xffffffc4 0xffffffc4 0xffffffc4 0xffffffc4 0xffffffc4 0xffffffc4 0xffffffc4 0xffffffc4 0xffffffc4 0xffffffc4 0xffffffc4 0xffffffc4 0xffffffc4 0xffffffc4 0xffffffc4 0xffffffc4 0xffffffc4 0xffffffc4 0xffffffc4 0xffffffc4 0xffffffc4 0xffffffc4 0xffffffc4 0xffffffc4 0xffffffc4 0xffffffc4 0xffffffc4 0xffffffc4 0xffffffc4 0xffffffc4 0xffffffc4 0xffffffc4 0xffffffc4 0xffffffc4 0xffffffc4 0xffffffc4 0xffffffc4 0xffffffc4 0xffffffc4 0xffffffc4 0xffffffc4 0xffffffc4 0xffffffc4 0xffffffc4 0xffffffc4 0xffffffc4 0xffffffc4 0xffffffc4 0xffffffc4 0xffffffc4 0xffffffc4 0xffffffc4 0xffffffc4 0xffffffc4 0xffffffc4 0xffffffc4 0xffffffc4 0xffffffc4 0xffffffc4 0xffffffc4 0xffffffc4 0xffffffc4 0xffffffc4 0xffffffc4 0xffffffc4 0xffffffc4 0xffffffc4 0xffffffc4 0xffffffc4 0xffffffc4 0xffffffc4 0xffffffc4 0xffffffc4 0xffffffc4 0xffffffc4 0xffffffc4 0xffffffc4 0xffffffc4 0xffffffc4 0xffffffc4 0xffffffc4 0xffffffc4 0xffffffc4 0xffffffc4 0xffffffc4 0xffffffc4 0xffffffc4 0xffffffc4 0xffffffc4 0xffffffc4 0xffffffc4 0xffffffc4 0xffffffc4 0xffffffc4 0xffffffc4 0xffffffc4 0xffffffc4 0xffffffc4 0xffffffc4 0xffffffc4 0xffffffc4 0xffffffc4 0xffffffc4 0xffffffc4 0xffffffc4 0xffffffc4 0xffffffc4 0xffffffc4 0xffffffc4 0xffffffc4 0xffffffc4 0xffffffc4 0xffffffc4 0xffffffc4 0xffffffc4 0xffffffc4 0xffffffc4 0xffffffc4 0xffffffc4 0xffffffc4 0xffffffc4 0xffffffc4 0xffffffc4 0xffffffc4 0xffffffc4 0xffffffc4 0xffffffc4 0xffffffc4 0xffffffc4 0xffffffc4 0xffffffc4 0xffffffc4 0xffffffc4 0xffffffc4 0xffffffc4 0xffffffc4 0xffffffc4 0xffffffc4 0xffffffc4 0xffffffc4 0xffffffc4 0xffffffc4 0xffffffc4 0xffffffc4 0xffffffc4 0xffffffc4 0xffffffc4 0xffffffc4 0xffffffc4 0xffffffc4 0xffffffc4 0xffffffc4 0xffffffc4 0xffffffc4 0xffffffc4 0xffffffc4 0xffffffc4 0xffffffc4 0xffffffc4 0xffffffc4 0xffffffc4 0xffffffc4 0xffffffc4 0xffffffc4 0xffffffc4 0xffffffc4 0xffffffc4 0xffffffc4 0xffffffc4 0xffffffc4 0xffffffc4 0xffffffc4 0xffffffc4 0xffffffc4 0xffffffc4 0xffffffc4 0xffffffc4 0xffffffc4 0xffffffc4 0xffffffc4 0xffffffc4 0xffffffc4 0xffffffc4 0xffffffc4 0xffffffc4 0xffffffc4 0xffffffc4 0xffffffc4 0xffffffc4 0xffffffc4 0xffffffc4 0xffffffc4 0xffffffc4 0xffffffc4 0xffffffc4 0xffffffc4 0xffffffc4 0xffffffc4 0xffffffc4 0xffffffc4 0xffffffc4 0xffffffc4 0xffffffc4 0xffffffc4 0xffffffc4 0xffffffc4 0xffffffc4 0xffffffc4 0xffffffc4 0xffffffc4 0xffffffc4 0xffffffc4 0xffffffc4 0xffffffc4 0xffffffc4 0xffffffc4 0xffffffc4 0xffffffc4 0xffffffc4 0xffffffc4 0xffffffc4 0xffffffc4 0xffffffc4 0xffffffc4 0xffffffc4 0xffffffc4 0xffffffc4 0xffffffc4 0xffffffc4 0xffffffc4 0xffffffc4 0xffffffc4 0xffffffc4 0xffffffc4>;
				phandle = <0x54>;
			};
		};
	};

	fragment@23 {
		target = <0xffffffff>;

		__overlay__ {
			compatible = "mediatek,touch";
			tpd-resolution = <0x2d0 0x64c>;
			use-tpd-button = <0x00>;
			tpd-key-num = <0x03>;
			tpd-key-local = <0x8b 0xac 0x9e 0x00>;
			tpd-key-dim-local = <0x5a 0x373 0x64 0x28 0xe6 0x373 0x64 0x28 0x172 0x373 0x64 0x28 0x00 0x00 0x00 0x00>;
			tpd-max-touch-num = <0x05>;
			tpd-filter-enable = <0x00>;
			tpd-filter-pixel-density = <0x6a>;
			tpd-filter-custom-prameters = <0x00 0x00 0x00 0x00 0x00 0x00 0x00 0x00 0x00 0x00 0x00 0x00>;
			tpd-filter-custom-speed = <0x00 0x00 0x00>;
			pinctrl-names = "default\0state_eint_as_int\0state_eint_output0\0state_eint_output1\0state_rst_output0\0state_rst_output1";
			pinctrl-0 = <0x1f>;
			pinctrl-1 = <0x20>;
			pinctrl-2 = <0x21>;
			pinctrl-3 = <0x22>;
			pinctrl-4 = <0x23>;
			pinctrl-5 = <0x24>;
			status = "okay";
		};
	};

	fragment@24 {
		target = <0xffffffff>;

		__overlay__ {

			eint0default {
				phandle = <0x1f>;
			};

			ctpeint@0 {
				phandle = <0x20>;

				pins_cmd_dat {
					pinmux = <0x100>;
					slew-rate = <0x00>;
				};
			};

			eintoutput0 {
				phandle = <0x21>;

				pins_cmd_dat {
					pinmux = <0x100>;
					slew-rate = <0x01>;
					output-low;
				};
			};

			eintoutput1 {
				phandle = <0x22>;

				pins_cmd_dat {
					pinmux = <0x100>;
					slew-rate = <0x01>;
					output-high;
				};
			};

			rstoutput0 {
				phandle = <0x23>;

				pins_cmd_dat {
					pinmux = <0x00>;
					slew-rate = <0x01>;
					output-low;
				};
			};

			rstoutput1 {
				phandle = <0x24>;

				pins_cmd_dat {
					pinmux = <0x00>;
					slew-rate = <0x01>;
					output-high;
				};
			};
		};
	};

	fragment@25 {
		target = <0xffffffff>;

		__overlay__ {

			otg_dcp_init {
				phandle = <0x1c>;

				pins_cmd_dat {
					pinmux = <0x2800>;
					slew-rate = <0x01>;
				};
			};

			otg_dcp_low {
				phandle = <0x1d>;

				pins_cmd_dat {
					pinmux = <0x2800>;
					slew-rate = <0x01>;
					output-low;
				};
			};

			otg_dcp_high {
				phandle = <0x1e>;

				pins_cmd_dat {
					pinmux = <0x2800>;
					slew-rate = <0x01>;
					output-high;
				};
			};
		};
	};

	fragment@26 {
		target = <0xffffffff>;

		__overlay__ {

			adc_channel@ {
				compatible = "mediatek,adc_channel";
				mediatek,temperature0 = <0x00>;
				mediatek,temperature1 = <0x01>;
				mediatek,adc_fdd_rf_params_dynamic_custom_ch = <0x02>;
				status = "okay";
			};
		};
	};

	fragment@27 {
		target = <0xffffffff>;

		__overlay__ {
			io-channels = <0xffffffff 0x02>;
		};
	};

	fragment@28 {
		target = <0xffffffff>;

		__overlay__ {
			mediatek,clkbuf-quantity = <0x07>;
			mediatek,clkbuf-config = <0x02 0x01 0x01 0x02 0x00 0x00 0x00>;
			mediatek,clkbuf-driving-current = <0x01 0x01 0x01 0x01 0x01 0x01 0x01>;
			status = "okay";
		};
	};

	fragment@29 {
		target = <0xffffffff>;

		__overlay__ {
			#address-cells = <0x01>;
			#size-cells = <0x00>;
			clock-frequency = <0x61a80>;
			mediatek,use-open-drain;
		};
	};

	fragment@30 {
		target = <0xffffffff>;

		__overlay__ {
			#address-cells = <0x01>;
			#size-cells = <0x00>;
			clock-frequency = <0x61a80>;
			mediatek,use-open-drain;
		};
	};

	fragment@31 {
		target = <0xffffffff>;

		__overlay__ {
			#address-cells = <0x01>;
			#size-cells = <0x00>;
			clock-frequency = <0x61a80>;
			mediatek,use-open-drain;

			camera_sub_eeprom@50 {
				compatible = "mediatek,camera_sub_eeprom";
				reg = <0x50>;
				status = "okay";
				phandle = <0x55>;
			};

			camera_main_two@10 {
				compatible = "mediatek,camera_main_two";
				reg = <0x10>;
				status = "okay";
				phandle = <0x56>;
			};

			camera_sub@36 {
				compatible = "mediatek,camera_sub";
				reg = <0x36>;
				status = "okay";
				phandle = <0x57>;
			};

			ccu_sensor_i2c_2_hw@11 {
				compatible = "mediatek,ccu_sensor_i2c_2_hw";
				reg = <0x11>;
				status = "okay";
				phandle = <0x58>;
			};
		};
	};

	fragment@32 {
		target = <0xffffffff>;

		__overlay__ {
			#address-cells = <0x01>;
			#size-cells = <0x00>;
			clock-frequency = <0x61a80>;
			mediatek,use-open-drain;

			camera_sub_two@40 {
				compatible = "mediatek,camera_sub_two";
				reg = <0x40>;
				status = "okay";
				phandle = <0x59>;
			};
		};
	};

	fragment@33 {
		target = <0xffffffff>;

		__overlay__ {
			#address-cells = <0x01>;
			#size-cells = <0x00>;
			clock-frequency = <0x61a80>;
			mediatek,use-open-drain;

			camera_main@10 {
				compatible = "mediatek,camera_main";
				reg = <0x10>;
				status = "okay";
				phandle = <0x5a>;
			};

			camera_main_eeprom@50 {
				compatible = "mediatek,camera_main_eeprom";
				reg = <0x50>;
				status = "okay";
				phandle = <0x5b>;
			};

			camera_main_af@0c {
				compatible = "mediatek,camera_main_af";
				reg = <0x0c>;
				status = "okay";
				phandle = <0x5c>;
			};

			ccu_sensor_i2c_4_hw@12 {
				compatible = "mediatek,ccu_sensor_i2c_4_hw";
				reg = <0x12>;
				status = "okay";
				phandle = <0x5d>;
			};
		};
	};

	fragment@34 {
		target = <0xffffffff>;

		__overlay__ {
			#address-cells = <0x01>;
			#size-cells = <0x00>;
			clock-frequency = <0x61a80>;
			mediatek,use-open-drain;

			subpmic_pmu@34 {
				compatible = "mediatek,subpmic_pmu";
				reg = <0x34>;
				status = "okay";
				phandle = <0x5e>;
			};

			usb_type_c@4e {
				compatible = "mediatek,usb_type_c";
				reg = <0x4e>;
				status = "okay";
				phandle = <0x5f>;
			};
		};
	};

	fragment@35 {
		target = <0xffffffff>;

		__overlay__ {
			#address-cells = <0x01>;
			#size-cells = <0x00>;
			clock-frequency = <0x61a80>;
			mediatek,use-open-drain;

			i2c_lcd_bias@3e {
				compatible = "mediatek,i2c_lcd_bias";
				reg = <0x3e>;
				status = "okay";
				phandle = <0x60>;
			};

			strobe_main@63 {
				compatible = "mediatek,strobe_main";
				reg = <0x63>;
				status = "okay";
				phandle = <0x61>;
			};
		};
	};

	fragment@36 {
		target = <0xffffffff>;

		__overlay__ {
			#address-cells = <0x01>;
			#size-cells = <0x00>;
			clock-frequency = <0x61a80>;
			mediatek,use-open-drain;

			nfc@28 {
				compatible = "mediatek,nfc";
				reg = <0x28>;
				status = "okay";
				phandle = <0x62>;
			};

			slave_charger@4b {
				compatible = "mediatek,slave_charger";
				reg = <0x4b>;
				status = "okay";
				phandle = <0x63>;
			};
		};
	};

	fragment@37 {
		target = <0xffffffff>;

		__overlay__ {
			#address-cells = <0x01>;
			#size-cells = <0x00>;
			clock-frequency = <0x61a80>;
			mediatek,use-open-drain;
		};
	};

	fragment@38 {
		target = <0xffffffff>;

		__overlay__ {
			GPIO_SIM1_HOT_PLUG = <0xffffffff 0x2f 0x00>;
			GPIO_FDD_BAND_SUPPORT_DETECT_1ST_PIN = <0xffffffff 0x42 0x00>;
			GPIO_FDD_BAND_SUPPORT_DETECT_2ND_PIN = <0xffffffff 0x43 0x00>;
			GPIO_FDD_BAND_SUPPORT_DETECT_3RD_PIN = <0xffffffff 0x44 0x00>;
			GPIO_SIM2_SIO = <0xffffffff 0x9b 0x00>;
			GPIO_SIM2_SRST = <0xffffffff 0x9c 0x00>;
			GPIO_SIM2_SCLK = <0xffffffff 0x9d 0x00>;
			GPIO_SIM1_SCLK = <0xffffffff 0xac 0x00>;
			GPIO_SIM1_SRST = <0xffffffff 0xad 0x00>;
			GPIO_SIM1_SIO = <0xffffffff 0xae 0x00>;
		};
	};

	fragment@39 {
		target = <0xffffffff>;

		__overlay__ {
			gpio_init_default = <0x00 0x00 0x01 0x00 0x01 0x01 0x00 0x01 0x00 0x00 0x00 0x01 0x01 0x00 0x02 0x00 0x00 0x00 0x01 0x00 0x01 0x03 0x00 0x00 0x00 0x01 0x00 0x01 0x04 0x00 0x00 0x00 0x01 0x01 0x01 0x05 0x00 0x00 0x00 0x01 0x01 0x00 0x06 0x00 0x01 0x00 0x01 0x00 0x01 0x07 0x00 0x00 0x00 0x01 0x01 0x00 0x08 0x00 0x00 0x00 0x01 0x01 0x00 0x09 0x00 0x00 0x00 0x01 0x01 0x00 0x0a 0x00 0x00 0x00 0x01 0x00 0x00 0x0b 0x01 0x00 0x00 0x01 0x00 0x00 0x0c 0x02 0x00 0x00 0x01 0x00 0x00 0x0d 0x02 0x00 0x00 0x01 0x00 0x00 0x0e 0x02 0x01 0x00 0x00 0x00 0x00 0x0f 0x02 0x01 0x00 0x00 0x00 0x00 0x10 0x02 0x01 0x00 0x00 0x00 0x00 0x11 0x00 0x00 0x00 0x01 0x00 0x01 0x12 0x00 0x00 0x00 0x01 0x01 0x01 0x13 0x00 0x00 0x00 0x01 0x01 0x01 0x14 0x00 0x00 0x00 0x01 0x01 0x01 0x15 0x00 0x00 0x00 0x00 0x00 0x01 0x16 0x05 0x00 0x00 0x01 0x00 0x00 0x17 0x00 0x00 0x00 0x00 0x00 0x00 0x18 0x05 0x00 0x00 0x01 0x00 0x00 0x19 0x02 0x01 0x00 0x01 0x01 0x00 0x1a 0x02 0x01 0x00 0x01 0x00 0x00 0x1b 0x02 0x01 0x00 0x01 0x01 0x00 0x1c 0x02 0x00 0x00 0x01 0x00 0x00 0x1d 0x00 0x00 0x00 0x01 0x00 0x00 0x1e 0x00 0x01 0x00 0x01 0x01 0x00 0x1f 0x00 0x00 0x00 0x01 0x00 0x00 0x20 0x01 0x01 0x00 0x00 0x00 0x00 0x21 0x01 0x00 0x00 0x01 0x00 0x00 0x22 0x01 0x00 0x00 0x01 0x00 0x00 0x23 0x01 0x00 0x00 0x01 0x00 0x00 0x24 0x00 0x01 0x00 0x00 0x00 0x00 0x25 0x00 0x01 0x00 0x00 0x00 0x00 0x26 0x02 0x01 0x00 0x00 0x00 0x00 0x27 0x00 0x00 0x00 0x01 0x01 0x01 0x28 0x00 0x01 0x00 0x00 0x00 0x00 0x29 0x00 0x00 0x00 0x01 0x01 0x01 0x2a 0x00 0x00 0x00 0x01 0x01 0x01 0x2b 0x01 0x01 0x00 0x01 0x00 0x00 0x2c 0x01 0x00 0x00 0x01 0x00 0x00 0x2d 0x00 0x01 0x00 0x01 0x00 0x00 0x2e 0x00 0x00 0x00 0x01 0x00 0x00 0x2f 0x01 0x00 0x00 0x01 0x01 0x00 0x30 0x01 0x00 0x00 0x01 0x01 0x01 0x31 0x01 0x00 0x00 0x01 0x01 0x01 0x32 0x01 0x00 0x00 0x01 0x01 0x01 0x33 0x01 0x00 0x00 0x01 0x01 0x01 0x34 0x01 0x00 0x00 0x01 0x00 0x00 0x35 0x01 0x00 0x00 0x01 0x00 0x00 0x36 0x01 0x00 0x00 0x01 0x00 0x00 0x37 0x01 0x00 0x00 0x01 0x00 0x00 0x38 0x01 0x00 0x00 0x01 0x00 0x00 0x39 0x01 0x00 0x00 0x01 0x00 0x00 0x3a 0x00 0x00 0x00 0x01 0x00 0x00 0x3b 0x01 0x00 0x00 0x01 0x00 0x00 0x3c 0x01 0x00 0x00 0x01 0x00 0x00 0x3d 0x01 0x00 0x00 0x01 0x00 0x00 0x3e 0x01 0x00 0x00 0x01 0x00 0x00 0x3f 0x01 0x00 0x00 0x01 0x00 0x00 0x40 0x01 0x00 0x00 0x01 0x00 0x00 0x41 0x00 0x00 0x00 0x01 0x00 0x00 0x42 0x00 0x00 0x00 0x01 0x00 0x00 0x43 0x00 0x00 0x00 0x01 0x00 0x00 0x44 0x00 0x00 0x00 0x01 0x00 0x00 0x45 0x01 0x00 0x00 0x01 0x00 0x00 0x46 0x01 0x00 0x00 0x01 0x00 0x00 0x47 0x00 0x00 0x00 0x01 0x00 0x00 0x48 0x00 0x00 0x00 0x01 0x00 0x00 0x49 0x01 0x00 0x00 0x01 0x00 0x00 0x4a 0x01 0x00 0x00 0x01 0x00 0x00 0x4b 0x01 0x00 0x00 0x01 0x00 0x00 0x4c 0x01 0x00 0x00 0x01 0x00 0x00 0x4d 0x00 0x00 0x00 0x01 0x00 0x00 0x4e 0x01 0x00 0x00 0x01 0x00 0x00 0x4f 0x00 0x00 0x00 0x01 0x00 0x00 0x50 0x00 0x00 0x00 0x01 0x00 0x00 0x51 0x02 0x00 0x00 0x01 0x01 0x01 0x52 0x01 0x00 0x00 0x01 0x01 0x01 0x53 0x01 0x00 0x00 0x01 0x01 0x01 0x54 0x02 0x00 0x00 0x01 0x01 0x01 0x55 0x02 0x00 0x00 0x01 0x00 0x00 0x56 0x02 0x01 0x00 0x00 0x00 0x00 0x57 0x02 0x01 0x00 0x00 0x00 0x00 0x58 0x02 0x01 0x00 0x00 0x00 0x00 0x59 0x01 0x00 0x00 0x01 0x01 0x01 0x5a 0x01 0x00 0x00 0x01 0x01 0x01 0x5b 0x00 0x01 0x00 0x01 0x00 0x00 0x5c 0x00 0x01 0x00 0x00 0x00 0x00 0x5d 0x01 0x00 0x00 0x01 0x01 0x00 0x5e 0x01 0x00 0x00 0x01 0x01 0x00 0x5f 0x01 0x00 0x00 0x01 0x01 0x00 0x60 0x01 0x01 0x00 0x00 0x00 0x00 0x61 0x00 0x01 0x00 0x00 0x00 0x00 0x62 0x00 0x01 0x00 0x00 0x00 0x00 0x63 0x01 0x01 0x00 0x00 0x00 0x00 0x64 0x01 0x01 0x00 0x00 0x00 0x00 0x65 0x00 0x01 0x00 0x00 0x00 0x00 0x66 0x00 0x01 0x00 0x00 0x00 0x00 0x67 0x01 0x00 0x00 0x01 0x01 0x01 0x68 0x01 0x00 0x00 0x01 0x01 0x01 0x69 0x01 0x00 0x00 0x01 0x01 0x01 0x6a 0x01 0x00 0x00 0x01 0x01 0x01 0x6b 0x00 0x01 0x00 0x00 0x00 0x00 0x6c 0x00 0x00 0x00 0x00 0x00 0x00 0x6d 0x00 0x01 0x00 0x00 0x00 0x00 0x6e 0x00 0x01 0x00 0x00 0x00 0x00 0x6f 0x01 0x01 0x00 0x00 0x00 0x00 0x70 0x00 0x00 0x00 0x00 0x00 0x00 0x71 0x00 0x00 0x00 0x01 0x00 0x00 0x72 0x00 0x00 0x00 0x01 0x00 0x00 0x73 0x00 0x00 0x00 0x01 0x00 0x00 0x74 0x00 0x00 0x00 0x01 0x00 0x00 0x75 0x00 0x00 0x00 0x01 0x00 0x00 0x76 0x00 0x00 0x00 0x01 0x00 0x00 0x77 0x00 0x00 0x00 0x01 0x00 0x00 0x78 0x00 0x00 0x00 0x01 0x00 0x00 0x79 0x00 0x00 0x00 0x01 0x00 0x00 0x86 0x01 0x00 0x00 0x01 0x00 0x01 0x87 0x01 0x01 0x00 0x00 0x00 0x00 0x88 0x01 0x01 0x00 0x00 0x00 0x00 0x89 0x01 0x01 0x00 0x00 0x00 0x00 0x8a 0x01 0x01 0x00 0x00 0x00 0x00 0x8b 0x01 0x01 0x00 0x00 0x00 0x00 0x8c 0x01 0x00 0x00 0x01 0x00 0x00 0x8d 0x01 0x00 0x00 0x01 0x00 0x00 0x8e 0x01 0x00 0x00 0x01 0x00 0x00 0x8f 0x01 0x00 0x00 0x01 0x00 0x00 0x90 0x01 0x00 0x00 0x01 0x00 0x00 0x91 0x01 0x01 0x00 0x00 0x00 0x00 0x92 0x01 0x01 0x00 0x00 0x00 0x00 0x93 0x01 0x01 0x00 0x00 0x00 0x00 0x94 0x01 0x01 0x00 0x00 0x00 0x00 0x95 0x01 0x01 0x00 0x00 0x00 0x00 0x96 0x00 0x01 0x00 0x00 0x00 0x00 0x97 0x00 0x01 0x00 0x01 0x00 0x00 0x98 0x00 0x01 0x00 0x01 0x00 0x00 0x99 0x00 0x01 0x00 0x01 0x00 0x00 0x9a 0x01 0x01 0x00 0x00 0x00 0x00 0x9b 0x01 0x00 0x00 0x01 0x01 0x00 0x9c 0x01 0x01 0x00 0x00 0x00 0x00 0x9d 0x01 0x01 0x00 0x00 0x00 0x00 0x9e 0x00 0x01 0x00 0x01 0x00 0x00 0x9f 0x00 0x01 0x00 0x00 0x00 0x00 0xa0 0x00 0x01 0x00 0x00 0x00 0x00 0xa1 0x01 0x00 0x00 0x01 0x01 0x01 0xa2 0x01 0x00 0x00 0x01 0x01 0x01 0xa3 0x01 0x00 0x00 0x01 0x01 0x01 0xa4 0x01 0x00 0x00 0x01 0x01 0x01 0xa5 0x00 0x01 0x00 0x00 0x00 0x00 0xa6 0x00 0x01 0x00 0x01 0x00 0x00 0xa7 0x01 0x00 0x00 0x01 0x00 0x00 0xa8 0x01 0x00 0x00 0x01 0x00 0x00 0xa9 0x04 0x01 0x00 0x00 0x00 0x00 0xaa 0x01 0x00 0x00 0x01 0x01 0x01 0xab 0x01 0x01 0x00 0x00 0x00 0x01 0xac 0x01 0x01 0x00 0x00 0x00 0x00 0xad 0x01 0x01 0x00 0x00 0x00 0x00 0xae 0x01 0x00 0x00 0x01 0x01 0x00 0xaf 0x01 0x00 0x00 0x01 0x01 0x01 0xb0 0x01 0x00 0x00 0x01 0x01 0x01 0xb2 0x00 0x01 0x00 0x00 0x00 0x00 0xb3 0x00 0x01 0x00 0x00 0x00 0x00 0xb4 0x00 0x00 0x00 0x01 0x00 0x00 0xb5 0x00 0x00 0x00 0x01 0x00 0x00 0xb6 0x00 0x00 0x00 0x01 0x00 0x00 0xb7 0x00 0x00 0x00 0x01 0x00 0x00 0xb8 0x00 0x00 0x00 0x01 0x00 0x00 0xb9 0x00 0x00 0x00 0x01 0x00 0x00 0xba 0x00 0x00 0x00 0x01 0x00 0x00>;
		};
	};

	fragment@40 {
		target = <0xffffffff>;

		__overlay__ {
			interrupt-parent = <0xffffffff>;
			interrupts = <0x01 0x02 0x01 0x00>;
			status = "okay";
		};
	};

	fragment@41 {
		target = <0xffffffff>;

		__overlay__ {
			interrupt-parent = <0xffffffff>;
			interrupts = <0x04 0x04 0x04 0x00>;
			deb-gpios = <0xffffffff 0x04 0x00>;
			debounce = <0x186a0>;
			status = "okay";
		};
	};

	fragment@42 {
		target = <0xffffffff>;

		__overlay__ {
			interrupt-parent = <0xffffffff>;
			interrupts = <0x09 0x01 0x09 0x00>;
			status = "okay";
		};
	};

	fragment@43 {
		target = <0xffffffff>;

		__overlay__ {
			interrupt-parent = <0xffffffff>;
			interrupts = <0x14 0x02 0x14 0x00>;
			status = "okay";
		};
	};

	fragment@44 {
		target = <0xffffffff>;

		__overlay__ {
			interrupt-parent = <0xffffffff>;
			interrupts = <0x27 0x08 0x27 0x00>;
			status = "okay";
		};
	};

	fragment@45 {
		target = <0xffffffff>;

		__overlay__ {
			interrupt-parent = <0xffffffff>;
			interrupts = <0x2a 0x02 0x2a 0x00>;
			status = "okay";
		};
	};

	fragment@46 {
		target = <0xffffffff>;

		__overlay__ {
			interrupt-parent = <0xffffffff>;
			interrupts = <0x2c 0x01 0x2c 0x01>;
			status = "okay";
		};
	};

	fragment@47 {
		target = <0xffffffff>;

		__overlay__ {
			interrupt-parent = <0xffffffff>;
			interrupts = <0x90 0x04 0xb4 0x00>;
			status = "okay";
		};
	};

	fragment@48 {
		target = <0xffffffff>;

		__overlay__ {
			compatible = "mediatek,md1_sim1_hot_plug_eint-eint";
			interrupts = <0x00 0x08>;
			debounce = <0x00 0x2710>;
			dedicated = <0x00 0x00>;
			src_pin = <0x00 0x01>;
			sockettype = <0x00 0x00>;
			status = "okay";
		};
	};

	fragment@49 {
		target = <0xffffffff>;

		__overlay__ {
			regulator-name = "vcama1";
			regulator-default-on = <0x01>;
			status = "okay";
		};
	};

	fragment@50 {
		target = <0xffffffff>;

		__overlay__ {
			regulator-name = "vcama2";
			regulator-default-on = <0x00>;
			status = "okay";
		};
	};

	fragment@51 {
		target = <0xffffffff>;

		__overlay__ {
			regulator-name = "vsim1";
			regulator-default-on = <0x01>;
			status = "okay";
		};
	};

	fragment@52 {
		target = <0xffffffff>;

		__overlay__ {
			regulator-name = "vsim2";
			regulator-default-on = <0x01>;
			status = "okay";
		};
	};

	fragment@53 {
		target = <0xffffffff>;

		__overlay__ {
			regulator-name = "vcamd";
			regulator-default-on = <0x01>;
			status = "okay";
		};
	};

	fragment@54 {
		target = <0xffffffff>;

		__overlay__ {
			regulator-name = "vcamio";
			regulator-default-on = <0x01>;
			status = "okay";
		};
	};

	fragment@55 {
		target = <0xffffffff>;

		__overlay__ {
			regulator-name = "vldo28";
			regulator-default-on = <0x01>;
			status = "okay";
		};
	};

	fragment@56 {
		target = <0xffffffff>;

		__overlay__ {
			vcamd-supply = <0xffffffff>;
			vcamd_sub-supply = <0xffffffff>;
			vcamio-supply = <0xffffffff>;
			vcamio_sub-supply = <0xffffffff>;
			vcamaf-supply = <0xffffffff>;
			status = "okay";
		};
	};

	fragment@57 {
		target = <0xffffffff>;

		__overlay__ {
			vtouch-supply = <0xffffffff>;
			status = "okay";
		};
	};

	fragment@58 {
		target = <0xffffffff>;

		__overlay__ {
			mediatek,kpd-key-debounce = <0x400>;
			mediatek,kpd-sw-pwrkey = <0x74>;
			mediatek,kpd-hw-pwrkey = <0x08>;
			mediatek,kpd-use-extend-type = <0x00>;
			mediatek,kpd-hw-map-num = <0x48>;
			mediatek,kpd-hw-init-map = <0x73 0x72 0x00 0x00 0x00 0x00 0x00 0x00 0x00 0x00 0x00 0x00 0x00 0x00 0x00 0x00 0x00 0x00 0x00 0x00 0x00 0x00 0x00 0x00 0x00 0x00 0x00 0x00 0x00 0x00 0x00 0x00 0x00 0x00 0x00 0x00 0x00 0x00 0x00 0x00 0x00 0x00 0x00 0x00 0x00 0x00 0x00 0x00 0x00 0x00 0x00 0x00 0x00 0x00 0x00 0x00 0x00 0x00 0x00 0x00 0x00 0x00 0x00 0x00 0x00 0x00 0x00 0x00 0x00 0x00 0x00 0x00>;
			mediatek,kpd-pwrkey-eint-gpio = <0x00>;
			mediatek,kpd-pwkey-gpio-din = <0x00>;
			mediatek,kpd-hw-dl-key0 = <0x00>;
			mediatek,kpd-hw-dl-key1 = <0x01>;
			mediatek,kpd-hw-dl-key2 = <0x08>;
			mediatek,kpd-hw-recovery-key = <0x00>;
			mediatek,kpd-hw-factory-key = <0x01>;
			status = "okay";
		};
	};

	fragment@59 {
		target = <0xffffffff>;

		__overlay__ {

			camera0_mclk_2mA@gpio100 {
				phandle = <0x35>;

				pins_cmd_dat {
					pinmux = <0x6401>;
					drive-strength = <0x02>;
				};
			};

			camera0_mclk_4mA@gpio100 {
				phandle = <0x36>;

				pins_cmd_dat {
					pinmux = <0x6401>;
					drive-strength = <0x04>;
				};
			};

			camera0_mclk_6mA@gpio100 {
				phandle = <0x37>;

				pins_cmd_dat {
					pinmux = <0x6401>;
					drive-strength = <0x06>;
				};
			};

			camera0_mclk_8mA@gpio100 {
				phandle = <0x38>;

				pins_cmd_dat {
					pinmux = <0x6401>;
					drive-strength = <0x07>;
				};
			};

			camera0_mclk_gpio_mode@gpio100 {
				phandle = <0x34>;

				pins_cmd_dat {
					pinmux = <0x6400>;
					drive-strength = <0x04>;
				};
			};

			camera1_mclk_2mA@gpio99 {
				phandle = <0x3a>;

				pins_cmd_dat {
					pinmux = <0x6301>;
					drive-strength = <0x02>;
				};
			};

			camera1_mclk_4mA@gpio99 {
				phandle = <0x3b>;

				pins_cmd_dat {
					pinmux = <0x6301>;
					drive-strength = <0x04>;
				};
			};

			camera1_mclk_6mA@gpio99 {
				phandle = <0x3c>;

				pins_cmd_dat {
					pinmux = <0x6301>;
					drive-strength = <0x06>;
				};
			};

			camera1_mclk_8mA@gpio99 {
				phandle = <0x3d>;

				pins_cmd_dat {
					pinmux = <0x6301>;
					drive-strength = <0x07>;
				};
			};

			camera1_mclk_gpio_mode@gpio99 {
				phandle = <0x39>;

				pins_cmd_dat {
					pinmux = <0x6300>;
					drive-strength = <0x04>;
				};
			};

			camera2_mclk_2mA@gpio108 {
				phandle = <0x3f>;

				pins_cmd_dat {
					pinmux = <0x6c01>;
					drive-strength = <0x02>;
				};
			};

			camera2_mclk_4mA@gpio108 {
				phandle = <0x40>;

				pins_cmd_dat {
					pinmux = <0x6c01>;
					drive-strength = <0x04>;
				};
			};

			camera2_mclk_6mA@gpio108 {
				phandle = <0x41>;

				pins_cmd_dat {
					pinmux = <0x6c01>;
					drive-strength = <0x06>;
				};
			};

			camera2_mclk_8mA@gpio108 {
				phandle = <0x42>;

				pins_cmd_dat {
					pinmux = <0x6c01>;
					drive-strength = <0x07>;
				};
			};

			camera2_mclk_gpio_mode@gpio108 {
				phandle = <0x3e>;

				pins_cmd_dat {
					pinmux = <0x6c00>;
					drive-strength = <0x04>;
				};
			};

			camera0_rst_output_low@gpio102 {
				phandle = <0x26>;

				pins_cmd_dat {
					pinmux = <0x6600>;
					output-low;
				};
			};

			camera0_rst_output_high@gpio102 {
				phandle = <0x27>;

				pins_cmd_dat {
					pinmux = <0x6600>;
					output-high;
				};
			};

			camera0_pdn_output_low@gpio98 {
				phandle = <0x28>;

				pins_cmd_dat {
					pinmux = <0x6200>;
					output-low;
				};
			};

			camera0_pdn_output_high@gpio98 {
				phandle = <0x29>;

				pins_cmd_dat {
					pinmux = <0x6200>;
					output-high;
				};
			};

			camera1_rst_output_low@gpio101 {
				phandle = <0x2a>;

				pins_cmd_dat {
					pinmux = <0x6500>;
					output-low;
				};
			};

			camera1_rst_output_high@gpio101 {
				phandle = <0x2b>;

				pins_cmd_dat {
					pinmux = <0x6500>;
					output-high;
				};
			};

			camera1_pdn_output_low@gpio97 {
				phandle = <0x2c>;

				pins_cmd_dat {
					pinmux = <0x6100>;
					slew-rate = <0x01>;
					output-low;
				};
			};

			camera1_pdn_output_high@gpio97 {
				phandle = <0x2d>;

				pins_cmd_dat {
					pinmux = <0x6100>;
					output-high;
				};
			};

			camera2_pdn_output_low@gpio36 {
				phandle = <0x2e>;

				pins_cmd_dat {
					pinmux = <0x2400>;
					output-low;
				};
			};

			camera2_pdn_output_high@gpio36 {
				phandle = <0x2f>;

				pins_cmd_dat {
					pinmux = <0x2400>;
					output-high;
				};
			};

			camera0_vcama_output_low@gpio23 {
				phandle = <0x31>;

				pins_cmd_dat {
					pinmux = <0x1700>;
					output-low;
				};
			};

			camera0_vcama_output_high@gpio23 {
				phandle = <0x30>;

				pins_cmd_dat {
					pinmux = <0x1700>;
					output-high;
				};
			};

			camera1_vcama_output_low@gpio23 {
				phandle = <0x33>;

				pins_cmd_dat {
					pinmux = <0x1700>;
					output-low;
				};
			};

			camera1_vcama_output_high@gpio23 {
				phandle = <0x32>;

				pins_cmd_dat {
					pinmux = <0x1700>;
					output-high;
				};
			};

			camdefault {
				phandle = <0x25>;
			};
		};
	};

	fragment@60 {
		target = <0xffffffff>;

		__overlay__ {
			pinctrl-names = "default\0cam0_rst0\0cam0_rst1\0cam0_pnd0\0cam0_pnd1\0cam1_rst0\0cam1_rst1\0cam1_pnd0\0cam1_pnd1\0cam2_pnd0\0cam2_pnd1\0cam0_vcama_on\0cam0_vcama_off\0cam1_vcama_on\0cam1_vcama_off\0cam0_mclk_off\0cam0_mclk_2mA\0cam0_mclk_4mA\0cam0_mclk_6mA\0cam0_mclk_8mA\0cam1_mclk_off\0cam1_mclk_2mA\0cam1_mclk_4mA\0cam1_mclk_6mA\0cam1_mclk_8mA\0cam2_mclk_off\0cam2_mclk_2mA\0cam2_mclk_4mA\0cam2_mclk_6mA\0cam2_mclk_8mA";
			pinctrl-0 = <0x25>;
			pinctrl-1 = <0x26>;
			pinctrl-2 = <0x27>;
			pinctrl-3 = <0x28>;
			pinctrl-4 = <0x29>;
			pinctrl-5 = <0x2a>;
			pinctrl-6 = <0x2b>;
			pinctrl-7 = <0x2c>;
			pinctrl-8 = <0x2d>;
			pinctrl-9 = <0x2e>;
			pinctrl-10 = <0x2f>;
			pinctrl-11 = <0x30>;
			pinctrl-12 = <0x31>;
			pinctrl-13 = <0x32>;
			pinctrl-14 = <0x33>;
			pinctrl-15 = <0x34>;
			pinctrl-16 = <0x35>;
			pinctrl-17 = <0x36>;
			pinctrl-18 = <0x37>;
			pinctrl-19 = <0x38>;
			pinctrl-20 = <0x39>;
			pinctrl-21 = <0x3a>;
			pinctrl-22 = <0x3b>;
			pinctrl-23 = <0x3c>;
			pinctrl-24 = <0x3d>;
			pinctrl-25 = <0x3e>;
			pinctrl-26 = <0x3f>;
			pinctrl-27 = <0x40>;
			pinctrl-28 = <0x41>;
			pinctrl-29 = <0x42>;
			cam0_vcamd-supply = <0xffffffff>;
			cam1_vcamd-supply = <0xffffffff>;
			cam2_vcama-supply = <0xffffffff>;
			cam0_vcamio-supply = <0xffffffff>;
			cam1_vcamio-supply = <0xffffffff>;
			cam0_vcamaf-supply = <0xffffffff>;
			status = "okay";
		};
	};

	fragment@61 {
		target = <0xffffffff>;

		__overlay__ {

			aw36515default {
				phandle = <0x01>;
			};

			aw36515hwen_high {
				phandle = <0x02>;

				pins_cmd_dat {
					pinmux = <0xa900>;
					slew-rate = <0x01>;
					output-high;
				};
			};

			aw36515hwen_low {
				phandle = <0x03>;

				pins_cmd_dat {
					pinmux = <0xa900>;
					slew-rate = <0x01>;
					output-low;
				};
			};
		};
	};

	fragment@62 {
		target = <0xffffffff>;

		__overlay__ {

			ocp81375default {
				phandle = <0x04>;
			};

			ocp81375hwen_high {
				phandle = <0x05>;

				pins_cmd_dat {
					pinmux = <0xa900>;
					slew-rate = <0x01>;
					output-high;
				};
			};

			ocp81375hwen_low {
				phandle = <0x06>;

				pins_cmd_dat {
					pinmux = <0xa900>;
					slew-rate = <0x01>;
					output-low;
				};
			};
		};
	};

	__symbols__ {
		camera_af_hw_node = "/fragment@3/__overlay__/camera_af_hw_node";
		flashlights_aw36515 = "/fragment@3/__overlay__/flashlights_aw36515";
		flashlights_ocp81375 = "/fragment@3/__overlay__/flashlights_ocp81375";
		led0 = "/fragment@3/__overlay__/led@0";
		led1 = "/fragment@3/__overlay__/led@1";
		led2 = "/fragment@3/__overlay__/led@2";
		led3 = "/fragment@3/__overlay__/led@3";
		led4 = "/fragment@3/__overlay__/led@4";
		led5 = "/fragment@3/__overlay__/led@5";
		led6 = "/fragment@3/__overlay__/led@6";
		vibrator0 = "/fragment@3/__overlay__/vibrator@0";
		tran_audio = "/fragment@3/__overlay__/tran_audio";
		fingerprint = "/fragment@3/__overlay__/fingerprint";
		fingerprint_default = "/fragment@5/__overlay__/fingerprint_default";
		fingerprint_eint = "/fragment@5/__overlay__/gpio7_eint";
		fingerprint_eint_pull_down = "/fragment@5/__overlay__/gpio7_eint_pull_down";
		fingerprint_rst_one = "/fragment@5/__overlay__/rst_out_one";
		fingerprint_rst_zero = "/fragment@5/__overlay__/rst_out_zero";
		irq_nfc = "/fragment@7/__overlay__/irq_nfc";
		kpd_pins_default = "/fragment@10/__overlay__/kpdgpiodefault";
		consys_pins_default = "/fragment@11/__overlay__/consys_default";
		gpslna_pins_init = "/fragment@11/__overlay__/gpslna@0";
		gpslna_pins_oh = "/fragment@11/__overlay__/gpslna@1";
		gpslna_pins_ol = "/fragment@11/__overlay__/gpslna@2";
		fmgpio_pins_1 = "/fragment@11/__overlay__/fmgpio@3";
		fmgpio_pins_0 = "/fragment@11/__overlay__/fmgpio@4";
		irtx_gpio_led_default = "/fragment@14/__overlay__/irtx_gpio_led_def@gpio12";
		irtx_gpio_led_set = "/fragment@14/__overlay__/irtx_gpio_led_set@gpio12";
		mtkfb_pins_lcd_bias_enp1 = "/fragment@15/__overlay__/lcd_bias_enp1_gpio";
		mtkfb_pins_lcd_bias_enp0 = "/fragment@15/__overlay__/lcd_bias_enp0_gpio";
		mtkfb_pins_lcd_bias_enn1 = "/fragment@15/__overlay__/lcd_bias_enn1_gpio";
		mtkfb_pins_lcd_bias_enn0 = "/fragment@15/__overlay__/lcd_bias_enn0_gpio";
		mtkfb_pins_lcm_rst_out1_gpio = "/fragment@15/__overlay__/lcm_rst_out1_gpio";
		mtkfb_pins_lcm_rst_out0_gpio = "/fragment@15/__overlay__/lcm_rst_out0_gpio";
		mtkfb_pins_lcm_dsi_te = "/fragment@15/__overlay__/lcm_dsi_te";
		otg_iddig = "/fragment@17/__overlay__/otg_iddig";
		tran_battery = "/fragment@17/__overlay__/tran_battery";
		tran_battery_aging = "/fragment@17/__overlay__/tran_battery_aging";
		tran_touch = "/fragment@22/__overlay__/touch@0";
		ctp_pins_default = "/fragment@24/__overlay__/eint0default";
		ctp_pins_eint_as_int = "/fragment@24/__overlay__/ctpeint@0";
		ctp_pins_eint_output0 = "/fragment@24/__overlay__/eintoutput0";
		ctp_pins_eint_output1 = "/fragment@24/__overlay__/eintoutput1";
		ctp_pins_rst_output0 = "/fragment@24/__overlay__/rstoutput0";
		ctp_pins_rst_output1 = "/fragment@24/__overlay__/rstoutput1";
		gpio40_otg_dcp_init = "/fragment@25/__overlay__/otg_dcp_init";
		gpio40_otg_dcp_low = "/fragment@25/__overlay__/otg_dcp_low";
		gpio40_otg_dcp_high = "/fragment@25/__overlay__/otg_dcp_high";
		camera_sub_eeprom_mtk = "/fragment@31/__overlay__/camera_sub_eeprom@50";
		camera_main_two_mtk = "/fragment@31/__overlay__/camera_main_two@10";
		camera_sub_mtk = "/fragment@31/__overlay__/camera_sub@36";
		ccu_sensor_i2c_2_hw_mtk = "/fragment@31/__overlay__/ccu_sensor_i2c_2_hw@11";
		camera_sub_two_mtk = "/fragment@32/__overlay__/camera_sub_two@40";
		camera_main_mtk = "/fragment@33/__overlay__/camera_main@10";
		camera_main_eeprom_mtk = "/fragment@33/__overlay__/camera_main_eeprom@50";
		camera_main_af_mtk = "/fragment@33/__overlay__/camera_main_af@0c";
		ccu_sensor_i2c_4_hw_mtk = "/fragment@33/__overlay__/ccu_sensor_i2c_4_hw@12";
		subpmic_pmu_mtk = "/fragment@34/__overlay__/subpmic_pmu@34";
		usb_type_c_mtk = "/fragment@34/__overlay__/usb_type_c@4e";
		i2c_lcd_bias_mtk = "/fragment@35/__overlay__/i2c_lcd_bias@3e";
		strobe_main_mtk = "/fragment@35/__overlay__/strobe_main@63";
		nfc_mtk = "/fragment@36/__overlay__/nfc@28";
		slave_charger_mtk = "/fragment@36/__overlay__/slave_charger@4b";
		camera0_mclk_2mA = "/fragment@59/__overlay__/camera0_mclk_2mA@gpio100";
		camera0_mclk_4mA = "/fragment@59/__overlay__/camera0_mclk_4mA@gpio100";
		camera0_mclk_6mA = "/fragment@59/__overlay__/camera0_mclk_6mA@gpio100";
		camera0_mclk_8mA = "/fragment@59/__overlay__/camera0_mclk_8mA@gpio100";
		camera0_mclk_off = "/fragment@59/__overlay__/camera0_mclk_gpio_mode@gpio100";
		camera1_mclk_2mA = "/fragment@59/__overlay__/camera1_mclk_2mA@gpio99";
		camera1_mclk_4mA = "/fragment@59/__overlay__/camera1_mclk_4mA@gpio99";
		camera1_mclk_6mA = "/fragment@59/__overlay__/camera1_mclk_6mA@gpio99";
		camera1_mclk_8mA = "/fragment@59/__overlay__/camera1_mclk_8mA@gpio99";
		camera1_mclk_off = "/fragment@59/__overlay__/camera1_mclk_gpio_mode@gpio99";
		camera2_mclk_2mA = "/fragment@59/__overlay__/camera2_mclk_2mA@gpio108";
		camera2_mclk_4mA = "/fragment@59/__overlay__/camera2_mclk_4mA@gpio108";
		camera2_mclk_6mA = "/fragment@59/__overlay__/camera2_mclk_6mA@gpio108";
		camera2_mclk_8mA = "/fragment@59/__overlay__/camera2_mclk_8mA@gpio108";
		camera2_mclk_off = "/fragment@59/__overlay__/camera2_mclk_gpio_mode@gpio108";
		camera0_rst_low = "/fragment@59/__overlay__/camera0_rst_output_low@gpio102";
		camera0_rst_high = "/fragment@59/__overlay__/camera0_rst_output_high@gpio102";
		camera0_pdn_low = "/fragment@59/__overlay__/camera0_pdn_output_low@gpio98";
		camera0_pdn_high = "/fragment@59/__overlay__/camera0_pdn_output_high@gpio98";
		camera1_rst_low = "/fragment@59/__overlay__/camera1_rst_output_low@gpio101";
		camera1_rst_high = "/fragment@59/__overlay__/camera1_rst_output_high@gpio101";
		camera1_pdn_low = "/fragment@59/__overlay__/camera1_pdn_output_low@gpio97";
		camera1_pdn_high = "/fragment@59/__overlay__/camera1_pdn_output_high@gpio97";
		camera2_pdn_low = "/fragment@59/__overlay__/camera2_pdn_output_low@gpio36";
		camera2_pdn_high = "/fragment@59/__overlay__/camera2_pdn_output_high@gpio36";
		camera0_vcama_off = "/fragment@59/__overlay__/camera0_vcama_output_low@gpio23";
		camera0_vcama_on = "/fragment@59/__overlay__/camera0_vcama_output_high@gpio23";
		camera1_vcama_off = "/fragment@59/__overlay__/camera1_vcama_output_low@gpio23";
		camera1_vcama_on = "/fragment@59/__overlay__/camera1_vcama_output_high@gpio23";
		camera_pins_default = "/fragment@59/__overlay__/camdefault";
		flashlights_aw36515_pins_default = "/fragment@61/__overlay__/aw36515default";
		flashlights_aw36515_pins_hwen_high = "/fragment@61/__overlay__/aw36515hwen_high";
		flashlights_aw36515_pins_hwen_low = "/fragment@61/__overlay__/aw36515hwen_low";
		flashlights_ocp81375_pins_default = "/fragment@62/__overlay__/ocp81375default";
		flashlights_ocp81375_pins_hwen_high = "/fragment@62/__overlay__/ocp81375hwen_high";
		flashlights_ocp81375_pins_hwen_low = "/fragment@62/__overlay__/ocp81375hwen_low";
	};

	__fixups__ {
		reserved_memory = "/fragment@0:target:0";
		chosen = "/fragment@1:target:0";
		kd_camera_hw1 = "/fragment@2:target:0\0/fragment@56:target:0\0/fragment@60:target:0";
		main_pmic = "/fragment@2/__overlay__:pmic:0\0/fragment@47:target:0";
		pio = "/fragment@2/__overlay__:camera_input_gpio:0\0/fragment@3/__overlay__/tran_audio:extamp_gpio:0\0/fragment@3/__overlay__/tran_audio:dual_speaker_gpio:0\0/fragment@3/__overlay__/fingerprint:interrupt-parent:0\0/fragment@4/__overlay__/fingerprint@0:interrupt-parent:0\0/fragment@4/__overlay__/fingerprint@0:irq-gpio-std:0\0/fragment@4/__overlay__/fingerprint@0:reset-gpio-std:0\0/fragment@4/__overlay__/fingerprint@0:tran,gpio_pwr-std:0\0/fragment@5:target:0\0/fragment@7/__overlay__/nfc_nxp@28:nxp,pn544-irq:0\0/fragment@7/__overlay__/nfc_nxp@28:nxp,pn544-ven:0\0/fragment@7/__overlay__/nfc_nxp@28:nxp,pn544-fw-dwnld:0\0/fragment@7/__overlay__/irq_nfc:interrupt-parent:0\0/fragment@10:target:0\0/fragment@11:target:0\0/fragment@14:target:0\0/fragment@15:target:0\0/fragment@17/__overlay__/otg_iddig:interrupt-parent:0\0/fragment@18/__overlay__:id-gpios:0\0/fragment@21/__overlay__/rt-swchg@53:rt,intr_gpio:0\0/fragment@21/__overlay__/rt-swchg@53:hvdcp20_dp_gpio:0\0/fragment@21/__overlay__/rt-swchg@53:tc30_dm_gpio:0\0/fragment@21/__overlay__/rt-swchg@53:led_ctl_gpio:0\0/fragment@24:target:0\0/fragment@25:target:0\0/fragment@38/__overlay__:GPIO_SIM1_HOT_PLUG:0\0/fragment@38/__overlay__:GPIO_FDD_BAND_SUPPORT_DETECT_1ST_PIN:0\0/fragment@38/__overlay__:GPIO_FDD_BAND_SUPPORT_DETECT_2ND_PIN:0\0/fragment@38/__overlay__:GPIO_FDD_BAND_SUPPORT_DETECT_3RD_PIN:0\0/fragment@38/__overlay__:GPIO_SIM2_SIO:0\0/fragment@38/__overlay__:GPIO_SIM2_SRST:0\0/fragment@38/__overlay__:GPIO_SIM2_SCLK:0\0/fragment@38/__overlay__:GPIO_SIM1_SCLK:0\0/fragment@38/__overlay__:GPIO_SIM1_SRST:0\0/fragment@38/__overlay__:GPIO_SIM1_SIO:0\0/fragment@40/__overlay__:interrupt-parent:0\0/fragment@41/__overlay__:interrupt-parent:0\0/fragment@41/__overlay__:deb-gpios:0\0/fragment@42/__overlay__:interrupt-parent:0\0/fragment@43/__overlay__:interrupt-parent:0\0/fragment@44/__overlay__:interrupt-parent:0\0/fragment@45/__overlay__:interrupt-parent:0\0/fragment@46/__overlay__:interrupt-parent:0\0/fragment@47/__overlay__:interrupt-parent:0\0/fragment@59:target:0\0/fragment@61:target:0\0/fragment@62:target:0";
		odm = "/fragment@3:target:0\0/fragment@17:target:0";
		mt_pmic_vldo28_ldo_reg = "/fragment@3/__overlay__/camera_af_hw_node:camaf_m1_pmic-supply:0\0/fragment@55:target:0\0/fragment@56/__overlay__:vcamaf-supply:0\0/fragment@57/__overlay__:vtouch-supply:0\0/fragment@60/__overlay__:cam0_vcamaf-supply:0";
		spi0 = "/fragment@4:target:0";
		i2c2 = "/fragment@6:target:0\0/fragment@31:target:0";
		i2c7 = "/fragment@7:target:0\0/fragment@36:target:0";
		accdet = "/fragment@8:target:0";
		keypad = "/fragment@9:target:0\0/fragment@58:target:0";
		consys = "/fragment@12:target:0";
		irtx_pwm = "/fragment@13:target:0";
		mtkfb = "/fragment@16:target:0";
		extcon_usb = "/fragment@18:target:0";
		mt_charger = "/fragment@18/__overlay__:charger:0";
		auxadc = "/fragment@18/__overlay__:io-channels:0\0/fragment@26:target:0\0/fragment@27/__overlay__:io-channels:0";
		charger = "/fragment@19:target:0";
		lk_charger = "/fragment@20:target:0";
		i2c5 = "/fragment@21:target:0\0/fragment@34:target:0";
		spi2 = "/fragment@22:target:0";
		touch = "/fragment@23:target:0\0/fragment@40:target:0\0/fragment@57:target:0";
		md_auxadc = "/fragment@27:target:0";
		pmic_clock_buffer_ctrl = "/fragment@28:target:0";
		i2c0 = "/fragment@29:target:0";
		i2c1 = "/fragment@30:target:0";
		i2c3 = "/fragment@32:target:0";
		i2c4 = "/fragment@33:target:0";
		i2c6 = "/fragment@35:target:0";
		i2c8 = "/fragment@37:target:0";
		gpio_usage_mapping = "/fragment@38:target:0";
		gpio = "/fragment@39:target:0";
		msdc1_ins = "/fragment@41:target:0";
		goodix_fp = "/fragment@42:target:0";
		subpmic_pmu_eint = "/fragment@43:target:0";
		smart_pa = "/fragment@44:target:0";
		rt9465_slave_chr = "/fragment@45:target:0";
		dsi_te = "/fragment@46:target:0";
		md1_sim1_hot_plug_eint = "/fragment@48:target:0";
		mt_pmic_vcama1_ldo_reg = "/fragment@49:target:0";
		mt_pmic_vcama2_ldo_reg = "/fragment@50:target:0\0/fragment@60/__overlay__:cam2_vcama-supply:0";
		mt_pmic_vsim1_ldo_reg = "/fragment@51:target:0";
		mt_pmic_vsim2_ldo_reg = "/fragment@52:target:0";
		mt_pmic_vcamd_ldo_reg = "/fragment@53:target:0\0/fragment@56/__overlay__:vcamd-supply:0\0/fragment@56/__overlay__:vcamd_sub-supply:0\0/fragment@60/__overlay__:cam0_vcamd-supply:0\0/fragment@60/__overlay__:cam1_vcamd-supply:0";
		mt_pmic_vcamio_ldo_reg = "/fragment@54:target:0\0/fragment@56/__overlay__:vcamio-supply:0\0/fragment@56/__overlay__:vcamio_sub-supply:0\0/fragment@60/__overlay__:cam0_vcamio-supply:0\0/fragment@60/__overlay__:cam1_vcamio-supply:0";
	};

	__local_fixups__ {

		fragment@3 {

			__overlay__ {

				flashlights_aw36515 {
					pinctrl-0 = <0x00>;
					pinctrl-1 = <0x00>;
					pinctrl-2 = <0x00>;
				};

				flashlights_ocp81375 {
					pinctrl-0 = <0x00>;
					pinctrl-1 = <0x00>;
					pinctrl-2 = <0x00>;
				};

				fingerprint {
					pinctrl-0 = <0x00>;
					pinctrl-1 = <0x00>;
					pinctrl-2 = <0x00>;
					pinctrl-3 = <0x00>;
					pinctrl-4 = <0x00>;
				};
			};
		};

		fragment@4 {

			__overlay__ {

				fingerprint@0 {
					pinctrl-0 = <0x00>;
					pinctrl-1 = <0x00>;
					pinctrl-2 = <0x00>;
					pinctrl-3 = <0x00>;
					pinctrl-4 = <0x00>;
				};
			};
		};

		fragment@9 {

			__overlay__ {
				pinctrl-0 = <0x00>;
			};
		};

		fragment@12 {

			__overlay__ {
				pinctrl-0 = <0x00>;
				pinctrl-1 = <0x00>;
				pinctrl-2 = <0x00>;
				pinctrl-3 = <0x00>;
				pinctrl-4 = <0x00>;
				pinctrl-5 = <0x00>;
			};
		};

		fragment@13 {

			__overlay__ {
				pinctrl-0 = <0x00>;
				pinctrl-1 = <0x00>;
			};
		};

		fragment@16 {

			__overlay__ {
				pinctrl-0 = <0x00>;
				pinctrl-1 = <0x00>;
				pinctrl-2 = <0x00>;
				pinctrl-3 = <0x00>;
				pinctrl-4 = <0x00>;
				pinctrl-5 = <0x00>;
				pinctrl-6 = <0x00>;
			};
		};

		fragment@18 {

			__overlay__ {
				pinctrl-0 = <0x00>;
				pinctrl-1 = <0x00>;
				pinctrl-2 = <0x00>;
			};
		};

		fragment@23 {

			__overlay__ {
				pinctrl-0 = <0x00>;
				pinctrl-1 = <0x00>;
				pinctrl-2 = <0x00>;
				pinctrl-3 = <0x00>;
				pinctrl-4 = <0x00>;
				pinctrl-5 = <0x00>;
			};
		};

		fragment@60 {

			__overlay__ {
				pinctrl-0 = <0x00>;
				pinctrl-1 = <0x00>;
				pinctrl-2 = <0x00>;
				pinctrl-3 = <0x00>;
				pinctrl-4 = <0x00>;
				pinctrl-5 = <0x00>;
				pinctrl-6 = <0x00>;
				pinctrl-7 = <0x00>;
				pinctrl-8 = <0x00>;
				pinctrl-9 = <0x00>;
				pinctrl-10 = <0x00>;
				pinctrl-11 = <0x00>;
				pinctrl-12 = <0x00>;
				pinctrl-13 = <0x00>;
				pinctrl-14 = <0x00>;
				pinctrl-15 = <0x00>;
				pinctrl-16 = <0x00>;
				pinctrl-17 = <0x00>;
				pinctrl-18 = <0x00>;
				pinctrl-19 = <0x00>;
				pinctrl-20 = <0x00>;
				pinctrl-21 = <0x00>;
				pinctrl-22 = <0x00>;
				pinctrl-23 = <0x00>;
				pinctrl-24 = <0x00>;
				pinctrl-25 = <0x00>;
				pinctrl-26 = <0x00>;
				pinctrl-27 = <0x00>;
				pinctrl-28 = <0x00>;
				pinctrl-29 = <0x00>;
			};
		};
	};
};
